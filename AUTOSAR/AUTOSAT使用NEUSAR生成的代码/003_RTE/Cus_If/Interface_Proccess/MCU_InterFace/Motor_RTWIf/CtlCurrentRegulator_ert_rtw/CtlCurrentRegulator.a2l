/******************************************************************************
* ASAP2 file: CtlCurrentRegulator.a2l
* Code generation for model "CtlCurrentRegulator".
* Model version : 1.19
* Simulink Coder version : 10.6 R2022b
* C source code generated on : Thu May 28 16:46:10 2026
* Target selection: ert.tlc
* Embedded hardware selection: Infineon->TriCore
* Code generation objectives: Unspecified
* Validation result: Not run
* (add additional file header information here)
******************************************************************************/ ASAP2_VERSION 1 31
/* Version 1.31 */
/begin PROJECT ProjectName "Project Comment Goes Here"
/begin HEADER "Header Comments go here" /end HEADER
/begin MODULE ModuleName "Module Comment Goes Here"
/begin MOD_PAR "MOD PAR Comment Goes Here" /end MOD_PAR
/begin MOD_COMMON "Mod Common Comment Here" BYTE_ORDER MSB_LAST ALIGNMENT_BYTE 1 ALIGNMENT_WORD 2 ALIGNMENT_LONG 4 ALIGNMENT_FLOAT32_IEEE 4 ALIGNMENT_FLOAT64_IEEE 4 /end MOD_COMMON
/begin CHARACTERISTIC CTCR_DAxisInductDecoupEna_C "Enable d-axis inductance term for decoupling" VALUE 0x0000 /* @ECU_Address@CTCR_DAxisInductDecoupEna_C@ */ Record_UBYTE 0 CtlCurrentRegulator_CM_uint8_dash_ 0.000000 1.000000 /end CHARACTERISTIC
/begin CHARACTERISTIC CTCR_DAxisInductance_C "D-axis inductance nominal value" VALUE 0x0000 /* @ECU_Address@CTCR_DAxisInductance_C@ */ Record_FLOAT32_IEEE 0 CtlCurrentRegulator_CM_single_H -100.000000 100.000000 /end CHARACTERISTIC
/begin CHARACTERISTIC CTCR_DAxisKi_C "D-axis current controller integral gain" VALUE 0x0000 /* @ECU_Address@CTCR_DAxisKi_C@ */ Record_FLOAT32_IEEE 0 CtlCurrentRegulator_CM_single_dash_ 0.000000 100.000000 /end CHARACTERISTIC
/begin CHARACTERISTIC CTCR_DAxisKp_C "D-axis current controller proportional gain" VALUE 0x0000 /* @ECU_Address@CTCR_DAxisKp_C@ */ Record_FLOAT32_IEEE 0 CtlCurrentRegulator_CM_single_dash_ 0.000000 100.000000 /end CHARACTERISTIC
/begin CHARACTERISTIC CTCR_DecoupUseSetpointEna_C "Enable use setpoint current for decoupling calculation" VALUE 0x0000 /* @ECU_Address@CTCR_DecoupUseSetpointEna_C@ */ Record_UBYTE 0 CtlCurrentRegulator_CM_uint8_dash_ 0.000000 255.000000 /end CHARACTERISTIC
/begin CHARACTERISTIC CTCR_PmFluxLinkage_C "Permanent magnet flux linkage nominal value" VALUE 0x0000 /* @ECU_Address@CTCR_PmFluxLinkage_C@ */ Record_FLOAT32_IEEE 0 CtlCurrentRegulator_CM_single_V_per_s -100.000000 100.000000 /end CHARACTERISTIC
/begin CHARACTERISTIC CTCR_QAxisFluxDecoupEna_C "Enable permanent magnet flux term for decoupling" VALUE 0x0000 /* @ECU_Address@CTCR_QAxisFluxDecoupEna_C@ */ Record_UBYTE 0 CtlCurrentRegulator_CM_uint8_dash_ 0.000000 1.000000 /end CHARACTERISTIC
/begin CHARACTERISTIC CTCR_QAxisInductDecoupEna_C "Enable q-axis inductance term for decoupling" VALUE 0x0000 /* @ECU_Address@CTCR_QAxisInductDecoupEna_C@ */ Record_UBYTE 0 CtlCurrentRegulator_CM_uint8_dash_ 0.000000 1.000000 /end CHARACTERISTIC
/begin CHARACTERISTIC CTCR_QAxisInductance_C "Q-axis inductance nominal value" VALUE 0x0000 /* @ECU_Address@CTCR_QAxisInductance_C@ */ Record_FLOAT32_IEEE 0 CtlCurrentRegulator_CM_single -100.000000 100.000000 /end CHARACTERISTIC
/begin CHARACTERISTIC CTCR_QAxisKi_C "Q-axis current controller integral gain" VALUE 0x0000 /* @ECU_Address@CTCR_QAxisKi_C@ */ Record_FLOAT32_IEEE 0 CtlCurrentRegulator_CM_single_dash_ 0.000000 10000.000000 /end CHARACTERISTIC
/begin CHARACTERISTIC CTCR_QAxisKp_C "Q-axis current controller proportional gain" VALUE 0x0000 /* @ECU_Address@CTCR_QAxisKp_C@ */ Record_FLOAT32_IEEE 0 CtlCurrentRegulator_CM_single_dash_ 0.000000 100.000000 /end CHARACTERISTIC
/begin CHARACTERISTIC CTCR_ResistDecoupEna_C "Enable resistance term for decoupling" VALUE 0x0000 /* @ECU_Address@CTCR_ResistDecoupEna_C@ */ Record_UBYTE 0 CtlCurrentRegulator_CM_uint8_dash_ 0.000000 1.000000 /end CHARACTERISTIC
/begin CHARACTERISTIC CTCR_StatorResistance_C "Stator winding resistance nominal value" VALUE 0x0000 /* @ECU_Address@CTCR_StatorResistance_C@ */ Record_FLOAT32_IEEE 0 CtlCurrentRegulator_CM_single_Ohm -100.000000 100.000000 /end CHARACTERISTIC
/begin CHARACTERISTIC CTCR_VSFilterFreq_C "Voltage vector magnitude filter frequency" VALUE 0x0000 /* @ECU_Address@CTCR_VSFilterFreq_C@ */ Record_FLOAT32_IEEE 0 CtlCurrentRegulator_CM_single 0.000000 10000.000000 /end CHARACTERISTIC
/begin CHARACTERISTIC CTCR_VoltLimitFactor_C "DC-link voltage limitation factor (typically 1/√3)" VALUE 0x0000 /* @ECU_Address@CTCR_VoltLimitFactor_C@ */ Record_FLOAT32_IEEE 0 CtlCurrentRegulator_CM_single_dash_ -3.4E+38 3.4E+38 /end CHARACTERISTIC
/begin CHARACTERISTIC CTCR_VoltVectorMagFilterFreq_C "Voltage vector magnitude filter frequency" VALUE 0x0000 /* @ECU_Address@CTCR_VoltVectorMagFilterFreq_C@ */ Record_FLOAT32_IEEE 0 CtlCurrentRegulator_CM_single 0.000000 10000.000000 /end CHARACTERISTIC
/begin MEASUREMENT CTCR_CurrentVs "" FLOAT32_IEEE CtlCurrentRegulator_CM_single_V 0 0 -3.4E+38 3.4E+38 ECU_ADDRESS 0x0000 /* @ECU_Address@CTCR_CurrentVs@ */ /end MEASUREMENT
/begin MEASUREMENT CTCR_DAxisAntiWindupEna "D-axis anti-windup enable flag" UBYTE CtlCurrentRegulator_CM_uint8_dash_ 0 0 0.000000 1.000000 ECU_ADDRESS 0x0000 /* @ECU_Address@CTCR_DAxisAntiWindupEna@ */ /end MEASUREMENT
/begin MEASUREMENT CTCR_Ki_Out_Ud "D-axis voltage setpoint output from current controller" FLOAT32_IEEE CtlCurrentRegulator_CM_single_V 0 0 -3.4E+38 3.4E+38 ECU_ADDRESS 0x0000 /* @ECU_Address@CTCR_Ki_Out_Ud@ */ /end MEASUREMENT
/begin MEASUREMENT CTCR_Ki_Out_Uq "D-axis voltage setpoint output from current controller" FLOAT32_IEEE CtlCurrentRegulator_CM_single_V 0 0 -3.4E+38 3.4E+38 ECU_ADDRESS 0x0000 /* @ECU_Address@CTCR_Ki_Out_Uq@ */ /end MEASUREMENT
/begin MEASUREMENT CTCR_Kp_Out_Ud "D-axis voltage setpoint output from current controller" FLOAT32_IEEE CtlCurrentRegulator_CM_single_V 0 0 -3.4E+38 3.4E+38 ECU_ADDRESS 0x0000 /* @ECU_Address@CTCR_Kp_Out_Ud@ */ /end MEASUREMENT
/begin MEASUREMENT CTCR_Kp_Out_Uq "D-axis voltage setpoint output from current controller" FLOAT32_IEEE CtlCurrentRegulator_CM_single_V 0 0 -3.4E+38 3.4E+38 ECU_ADDRESS 0x0000 /* @ECU_Address@CTCR_Kp_Out_Uq@ */ /end MEASUREMENT
/begin MEASUREMENT CTCR_LimitVs "" FLOAT32_IEEE CtlCurrentRegulator_CM_single_V 0 0 -3.4E+38 3.4E+38 ECU_ADDRESS 0x0000 /* @ECU_Address@CTCR_LimitVs@ */ /end MEASUREMENT
/begin MEASUREMENT CTCR_Pi_Out_Ud "D-axis voltage setpoint output from current controller" FLOAT32_IEEE CtlCurrentRegulator_CM_single_V 0 0 -3.4E+38 3.4E+38 ECU_ADDRESS 0x0000 /* @ECU_Address@CTCR_Pi_Out_Ud@ */ /end MEASUREMENT
/begin MEASUREMENT CTCR_Pi_Out_Uq "D-axis voltage setpoint output from current controller" FLOAT32_IEEE CtlCurrentRegulator_CM_single_V 0 0 -3.4E+38 3.4E+38 ECU_ADDRESS 0x0000 /* @ECU_Address@CTCR_Pi_Out_Uq@ */ /end MEASUREMENT
/begin MEASUREMENT CTCR_QAxisAntiWindupEna "Q-axis anti-windup enable flag" UBYTE CtlCurrentRegulator_CM_uint8_dash_ 0 0 0.000000 1.000000 ECU_ADDRESS 0x0000 /* @ECU_Address@CTCR_QAxisAntiWindupEna@ */ /end MEASUREMENT
/begin MEASUREMENT CTCR_UdSp "D-axis voltage setpoint output from current controller" FLOAT32_IEEE CtlCurrentRegulator_CM_single_V 0 0 -1500.000000 1500.000000 ARRAY_SIZE 1 ECU_ADDRESS 0x0000 /* @ECU_Address@CTCR_UdSp@ */ /end MEASUREMENT
/begin MEASUREMENT CTCR_UqSp "Q-axis voltage setpoint output from current controller" FLOAT32_IEEE CtlCurrentRegulator_CM_single_V 0 0 -1500.000000 1500.000000 ARRAY_SIZE 1 ECU_ADDRESS 0x0000 /* @ECU_Address@CTCR_UqSp@ */ /end MEASUREMENT
/begin MEASUREMENT CTCR_Uq_Err "D-axis voltage setpoint output from current controller" FLOAT32_IEEE CtlCurrentRegulator_CM_single_V 0 0 -3.4E+38 3.4E+38 ECU_ADDRESS 0x0000 /* @ECU_Address@CTCR_Uq_Err@ */ /end MEASUREMENT
/begin MEASUREMENT CTCR_VoltVectorMagFiltered "" FLOAT32_IEEE CtlCurrentRegulator_CM_single 0 0 -1500.000000 1500.000000 ARRAY_SIZE 1 ECU_ADDRESS 0x0000 /* @ECU_Address@CTCR_VoltVectorMagFiltered@ */ /end MEASUREMENT
/begin MEASUREMENT CTCR_VsLpfVal "" FLOAT32_IEEE CtlCurrentRegulator_CM_single_percent_ 0 0 0.000000 1000.000000 ECU_ADDRESS 0x0000 /* @ECU_Address@CTCR_VsLpfVal@ */ /end MEASUREMENT
/begin MEASUREMENT CTLC_IdSpLimited "" FLOAT32_IEEE CtlCurrentRegulator_CM_single 0 0 -3.4E+38 3.4E+38 ECU_ADDRESS 0x0000 /* @ECU_Address@CTLC_IdSpLimited@ */ /end MEASUREMENT
/begin MEASUREMENT CTLC_IqSpLimited "" FLOAT32_IEEE CtlCurrentRegulator_CM_single 0 0 -3.4E+38 3.4E+38 ECU_ADDRESS 0x0000 /* @ECU_Address@CTLC_IqSpLimited@ */ /end MEASUREMENT
/begin MEASUREMENT CTSO_CurrentIntegralDisable "" UBYTE CtlCurrentRegulator_CM_uint8 0 0 0 255 ECU_ADDRESS 0x0000 /* @ECU_Address@CTSO_CurrentIntegralDisable@ */ /end MEASUREMENT
/begin MEASUREMENT CTSO_CurrentIntegralReset "" UBYTE CtlCurrentRegulator_CM_uint8 0 0 0 255 ECU_ADDRESS 0x0000 /* @ECU_Address@CTSO_CurrentIntegralReset@ */ /end MEASUREMENT
/begin MEASUREMENT CtlCurrentRegulator_DW.Delay1_DSTATE "" FLOAT32_IEEE CtlCurrentRegulator_CM_single 0 0 -3.4E+38 3.4E+38 ECU_ADDRESS 0x0000 /* @ECU_Address@CtlCurrentRegulator_DW.Delay1_DSTATE@ */ /end MEASUREMENT
/begin MEASUREMENT CtlCurrentRegulator_DW.Delay1_DSTATE_a "" UBYTE CtlCurrentRegulator_CM_uint8 0 0 0 255 ECU_ADDRESS 0x0000 /* @ECU_Address@CtlCurrentRegulator_DW.Delay1_DSTATE_a@ */ /end MEASUREMENT
/begin MEASUREMENT CtlCurrentRegulator_DW.Delay1_DSTATE_j "" FLOAT32_IEEE CtlCurrentRegulator_CM_single 0 0 -3.4E+38 3.4E+38 ECU_ADDRESS 0x0000 /* @ECU_Address@CtlCurrentRegulator_DW.Delay1_DSTATE_j@ */ /end MEASUREMENT
/begin MEASUREMENT CtlCurrentRegulator_DW.Delay_DSTATE "" FLOAT32_IEEE CtlCurrentRegulator_CM_single 0 0 -3.4E+38 3.4E+38 ECU_ADDRESS 0x0000 /* @ECU_Address@CtlCurrentRegulator_DW.Delay_DSTATE@ */ /end MEASUREMENT
/begin MEASUREMENT CtlCurrentRegulator_DW.Delay_DSTATE_b "" UBYTE CtlCurrentRegulator_CM_uint8 0 0 0 255 ECU_ADDRESS 0x0000 /* @ECU_Address@CtlCurrentRegulator_DW.Delay_DSTATE_b@ */ /end MEASUREMENT
/begin MEASUREMENT CtlCurrentRegulator_DW.Delay_DSTATE_c "" FLOAT32_IEEE CtlCurrentRegulator_CM_single 0 0 -3.4E+38 3.4E+38 ECU_ADDRESS 0x0000 /* @ECU_Address@CtlCurrentRegulator_DW.Delay_DSTATE_c@ */ /end MEASUREMENT
/begin MEASUREMENT CtlCurrentRegulator_DW.Delay_DSTATE_h "" FLOAT32_IEEE CtlCurrentRegulator_CM_single 0 0 -3.4E+38 3.4E+38 ECU_ADDRESS 0x0000 /* @ECU_Address@CtlCurrentRegulator_DW.Delay_DSTATE_h@ */ /end MEASUREMENT
/begin MEASUREMENT CtlCurrentRegulator_DW.icLoad "" UBYTE CtlCurrentRegulator_CM_logical 0 0 0 1 ECU_ADDRESS 0x0000 /* @ECU_Address@CtlCurrentRegulator_DW.icLoad@ */ /end MEASUREMENT
/begin MEASUREMENT CtlCurrentRegulator_DW.icLoad_d "" UBYTE CtlCurrentRegulator_CM_logical 0 0 0 1 ECU_ADDRESS 0x0000 /* @ECU_Address@CtlCurrentRegulator_DW.icLoad_d@ */ /end MEASUREMENT
/begin MEASUREMENT CtlCurrentRegulator_DW.icLoad_f "" UBYTE CtlCurrentRegulator_CM_logical 0 0 0 1 ECU_ADDRESS 0x0000 /* @ECU_Address@CtlCurrentRegulator_DW.icLoad_f@ */ /end MEASUREMENT
/begin MEASUREMENT CtlCurrentRegulator_DW.icLoad_g "" UBYTE CtlCurrentRegulator_CM_logical 0 0 0 1 ECU_ADDRESS 0x0000 /* @ECU_Address@CtlCurrentRegulator_DW.icLoad_g@ */ /end MEASUREMENT
/begin MEASUREMENT CtlCurrentRegulator_DW.icLoad_j "" UBYTE CtlCurrentRegulator_CM_logical 0 0 0 1 ECU_ADDRESS 0x0000 /* @ECU_Address@CtlCurrentRegulator_DW.icLoad_j@ */ /end MEASUREMENT
/begin MEASUREMENT CtlCurrentRegulator_DW.icLoad_p "" UBYTE CtlCurrentRegulator_CM_logical 0 0 0 1 ECU_ADDRESS 0x0000 /* @ECU_Address@CtlCurrentRegulator_DW.icLoad_p@ */ /end MEASUREMENT
/begin MEASUREMENT SGPP_DcLinkVoltMeas "" FLOAT32_IEEE CtlCurrentRegulator_CM_single 0 0 -3.4E+38 3.4E+38 ECU_ADDRESS 0x0000 /* @ECU_Address@SGPP_DcLinkVoltMeas@ */ /end MEASUREMENT
/begin MEASUREMENT SGPP_ElecSpeed "" FLOAT32_IEEE CtlCurrentRegulator_CM_single 0 0 -3.4E+38 3.4E+38 ECU_ADDRESS 0x0000 /* @ECU_Address@SGPP_ElecSpeed@ */ /end MEASUREMENT
/begin MEASUREMENT SGPP_SampleTime1 "" FLOAT32_IEEE CtlCurrentRegulator_CM_single 0 0 -3.4E+38 3.4E+38 ECU_ADDRESS 0x0000 /* @ECU_Address@SGPP_SampleTime1@ */ /end MEASUREMENT
/begin MEASUREMENT TFPD_IdMeasured "" FLOAT32_IEEE CtlCurrentRegulator_CM_single 0 0 -3.4E+38 3.4E+38 ECU_ADDRESS 0x0000 /* @ECU_Address@TFPD_IdMeasured@ */ /end MEASUREMENT
/begin MEASUREMENT TFPD_IqMeasured "" FLOAT32_IEEE CtlCurrentRegulator_CM_single 0 0 -3.4E+38 3.4E+38 ECU_ADDRESS 0x0000 /* @ECU_Address@TFPD_IqMeasured@ */ /end MEASUREMENT
/begin COMPU_METHOD CtlCurrentRegulator_CM_logical "Q = V" RAT_FUNC "%1.0" "" COEFFS 0 1 0 0 0 1 /end COMPU_METHOD
/begin COMPU_METHOD CtlCurrentRegulator_CM_single "Q = V" RAT_FUNC "%8.6" "" COEFFS 0 1 0 0 0 1 /end COMPU_METHOD
/begin COMPU_METHOD CtlCurrentRegulator_CM_single_H "Q = V" RAT_FUNC "%8.6" "H" COEFFS 0 1 0 0 0 1 /end COMPU_METHOD
/begin COMPU_METHOD CtlCurrentRegulator_CM_single_Ohm "Q = V" RAT_FUNC "%8.6" "Ohm" COEFFS 0 1 0 0 0 1 /end COMPU_METHOD
/begin COMPU_METHOD CtlCurrentRegulator_CM_single_V "Q = V" RAT_FUNC "%8.6" "V" COEFFS 0 1 0 0 0 1 /end COMPU_METHOD
/begin COMPU_METHOD CtlCurrentRegulator_CM_single_V_per_s "Q = V" RAT_FUNC "%8.6" "V/s" COEFFS 0 1 0 0 0 1 /end COMPU_METHOD
/begin COMPU_METHOD CtlCurrentRegulator_CM_single_dash_ "Q = V" RAT_FUNC "%8.6" "-" COEFFS 0 1 0 0 0 1 /end COMPU_METHOD
/begin COMPU_METHOD CtlCurrentRegulator_CM_single_percent_ "Q = V" RAT_FUNC "%8.6" "%" COEFFS 0 1 0 0 0 1 /end COMPU_METHOD
/begin COMPU_METHOD CtlCurrentRegulator_CM_uint8 "Q = V" RAT_FUNC "%3.0" "" COEFFS 0 1 0 0 0 1 /end COMPU_METHOD
/begin COMPU_METHOD CtlCurrentRegulator_CM_uint8_dash_ "Q = V" RAT_FUNC "%3.0" "-" COEFFS 0 1 0 0 0 1 /end COMPU_METHOD
/begin RECORD_LAYOUT Record_BOOLEAN FNC_VALUES 1 UBYTE COLUMN_DIR DIRECT /end RECORD_LAYOUT
/begin RECORD_LAYOUT Record_FLOAT32_IEEE FNC_VALUES 1 FLOAT32_IEEE COLUMN_DIR DIRECT /end RECORD_LAYOUT
/begin RECORD_LAYOUT Record_UBYTE FNC_VALUES 1 UBYTE COLUMN_DIR DIRECT /end RECORD_LAYOUT
/begin GROUP CtlCurrentRegulator "CtlCurrentRegulator" /* Root */ ROOT /begin SUB_GROUP CtlCurrentRegulator_CTCR_RegulateCurrent_100us_sys /end SUB_GROUP
 /begin REF_MEASUREMENT CTLC_IdSpLimited CTLC_IqSpLimited CTSO_CurrentIntegralDisable CTSO_CurrentIntegralReset SGPP_DcLinkVoltMeas SGPP_ElecSpeed SGPP_SampleTime1 TFPD_IdMeasured TFPD_IqMeasured /end REF_MEASUREMENT
/end GROUP
/begin GROUP CtlCurrentRegulator_CTCR_RegulateCurrent_100us_sys "CtlCurrentRegulator/CTCR_RegulateCurrent_100us_sys"
 /begin SUB_GROUP CtlCurrentRegulator_CTCR_RegulateCurrent_100us_sys_DecoupleFeedforward CtlCurrentRegulator_CTCR_RegulateCurrent_100us_sys_EnAwUp CtlCurrentRegulator_CTCR_RegulateCurrent_100us_sys_Local_Variable_Storage CtlCurrentRegulator_CTCR_RegulateCurrent_100us_sys_Local_Variable_Storage1 CtlCurrentRegulator_CTCR_RegulateCurrent_100us_sys_PI_DAxis CtlCurrentRegulator_CTCR_RegulateCurrent_100us_sys_PI_QAxis CtlCurrentRegulator_CTCR_RegulateCurrent_100us_sys_Parameter1 CtlCurrentRegulator_CTCR_RegulateCurrent_100us_sys_Parameter2 CtlCurrentRegulator_CTCR_RegulateCurrent_100us_sys_Parameter3 CtlCurrentRegulator_CTCR_RegulateCurrent_100us_sys_Parameter7 CtlCurrentRegulator_CTCR_RegulateCurrent_100us_sys__VoltageSaturation /end SUB_GROUP
/end GROUP
/begin GROUP CtlCurrentRegulator_CTCR_RegulateCurrent_100us_sys_DecoupleFeedforward "CtlCurrentRegulator/CTCR_RegulateCurrent_100us_sys/DecoupleFeedforward"
 /begin SUB_GROUP CtlCurrentRegulator_CTCR_RegulateCurrent_100us_sys_DecoupleFeedforward_Parameter CtlCurrentRegulator_CTCR_RegulateCurrent_100us_sys_DecoupleFeedforward_Parameter10 CtlCurrentRegulator_CTCR_RegulateCurrent_100us_sys_DecoupleFeedforward_Parameter11 CtlCurrentRegulator_CTCR_RegulateCurrent_100us_sys_DecoupleFeedforward_Parameter2 CtlCurrentRegulator_CTCR_RegulateCurrent_100us_sys_DecoupleFeedforward_Parameter3 CtlCurrentRegulator_CTCR_RegulateCurrent_100us_sys_DecoupleFeedforward_Parameter4 CtlCurrentRegulator_CTCR_RegulateCurrent_100us_sys_DecoupleFeedforward_Parameter5 CtlCurrentRegulator_CTCR_RegulateCurrent_100us_sys_DecoupleFeedforward_Parameter6 CtlCurrentRegulator_CTCR_RegulateCurrent_100us_sys_DecoupleFeedforward_Parameter7 CtlCurrentRegulator_CTCR_RegulateCurrent_100us_sys_DecoupleFeedforward_Parameter8 CtlCurrentRegulator_CTCR_RegulateCurrent_100us_sys_DecoupleFeedforward_Parameter9 /end SUB_GROUP
 /begin REF_MEASUREMENT CTLC_IdSpLimited CTLC_IqSpLimited SGPP_ElecSpeed TFPD_IdMeasured TFPD_IqMeasured /end REF_MEASUREMENT
/end GROUP
/begin GROUP CtlCurrentRegulator_CTCR_RegulateCurrent_100us_sys_DecoupleFeedforward_Parameter "CtlCurrentRegulator/CTCR_RegulateCurrent_100us_sys/DecoupleFeedforward/Parameter" /begin REF_CHARACTERISTIC CTCR_DecoupUseSetpointEna_C /end REF_CHARACTERISTIC /end GROUP
/begin GROUP CtlCurrentRegulator_CTCR_RegulateCurrent_100us_sys_DecoupleFeedforward_Parameter10 "CtlCurrentRegulator/CTCR_RegulateCurrent_100us_sys/DecoupleFeedforward/Parameter10" /begin REF_CHARACTERISTIC CTCR_QAxisInductDecoupEna_C /end REF_CHARACTERISTIC /end GROUP
/begin GROUP CtlCurrentRegulator_CTCR_RegulateCurrent_100us_sys_DecoupleFeedforward_Parameter11 "CtlCurrentRegulator/CTCR_RegulateCurrent_100us_sys/DecoupleFeedforward/Parameter11" /begin REF_CHARACTERISTIC CTCR_QAxisFluxDecoupEna_C /end REF_CHARACTERISTIC /end GROUP
/begin GROUP CtlCurrentRegulator_CTCR_RegulateCurrent_100us_sys_DecoupleFeedforward_Parameter2 "CtlCurrentRegulator/CTCR_RegulateCurrent_100us_sys/DecoupleFeedforward/Parameter2" /begin REF_CHARACTERISTIC CTCR_QAxisInductance_C /end REF_CHARACTERISTIC /end GROUP
/begin GROUP CtlCurrentRegulator_CTCR_RegulateCurrent_100us_sys_DecoupleFeedforward_Parameter3 "CtlCurrentRegulator/CTCR_RegulateCurrent_100us_sys/DecoupleFeedforward/Parameter3" /begin REF_CHARACTERISTIC CTCR_StatorResistance_C /end REF_CHARACTERISTIC /end GROUP
/begin GROUP CtlCurrentRegulator_CTCR_RegulateCurrent_100us_sys_DecoupleFeedforward_Parameter4 "CtlCurrentRegulator/CTCR_RegulateCurrent_100us_sys/DecoupleFeedforward/Parameter4" /begin REF_CHARACTERISTIC CTCR_PmFluxLinkage_C /end REF_CHARACTERISTIC /end GROUP
/begin GROUP CtlCurrentRegulator_CTCR_RegulateCurrent_100us_sys_DecoupleFeedforward_Parameter5 "CtlCurrentRegulator/CTCR_RegulateCurrent_100us_sys/DecoupleFeedforward/Parameter5" /begin REF_CHARACTERISTIC CTCR_ResistDecoupEna_C /end REF_CHARACTERISTIC /end GROUP
/begin GROUP CtlCurrentRegulator_CTCR_RegulateCurrent_100us_sys_DecoupleFeedforward_Parameter6 "CtlCurrentRegulator/CTCR_RegulateCurrent_100us_sys/DecoupleFeedforward/Parameter6" /begin REF_CHARACTERISTIC CTCR_DAxisInductDecoupEna_C /end REF_CHARACTERISTIC /end GROUP
/begin GROUP CtlCurrentRegulator_CTCR_RegulateCurrent_100us_sys_DecoupleFeedforward_Parameter7 "CtlCurrentRegulator/CTCR_RegulateCurrent_100us_sys/DecoupleFeedforward/Parameter7" /begin REF_CHARACTERISTIC CTCR_StatorResistance_C /end REF_CHARACTERISTIC /end GROUP
/begin GROUP CtlCurrentRegulator_CTCR_RegulateCurrent_100us_sys_DecoupleFeedforward_Parameter8 "CtlCurrentRegulator/CTCR_RegulateCurrent_100us_sys/DecoupleFeedforward/Parameter8" /begin REF_CHARACTERISTIC CTCR_ResistDecoupEna_C /end REF_CHARACTERISTIC /end GROUP
/begin GROUP CtlCurrentRegulator_CTCR_RegulateCurrent_100us_sys_DecoupleFeedforward_Parameter9 "CtlCurrentRegulator/CTCR_RegulateCurrent_100us_sys/DecoupleFeedforward/Parameter9" /begin REF_CHARACTERISTIC CTCR_DAxisInductance_C /end REF_CHARACTERISTIC /end GROUP
/begin GROUP CtlCurrentRegulator_CTCR_RegulateCurrent_100us_sys_EnAwUp "CtlCurrentRegulator/CTCR_RegulateCurrent_100us_sys/EnAwUp"
 /begin SUB_GROUP CtlCurrentRegulator_CTCR_RegulateCurrent_100us_sys_EnAwUp_Local_Variable_Storage CtlCurrentRegulator_CTCR_RegulateCurrent_100us_sys_EnAwUp_Local_Variable_Storage1 /end SUB_GROUP
 /begin REF_MEASUREMENT CTSO_CurrentIntegralReset CtlCurrentRegulator_DW.Delay1_DSTATE_a CtlCurrentRegulator_DW.Delay_DSTATE_b CtlCurrentRegulator_DW.icLoad_f CtlCurrentRegulator_DW.icLoad_j /end REF_MEASUREMENT
/end GROUP
/begin GROUP CtlCurrentRegulator_CTCR_RegulateCurrent_100us_sys_EnAwUp_Local_Variable_Storage "CtlCurrentRegulator/CTCR_RegulateCurrent_100us_sys/EnAwUp/Local Variable Storage" /begin REF_MEASUREMENT CTCR_QAxisAntiWindupEna /end REF_MEASUREMENT /end GROUP
/begin GROUP CtlCurrentRegulator_CTCR_RegulateCurrent_100us_sys_EnAwUp_Local_Variable_Storage1 "CtlCurrentRegulator/CTCR_RegulateCurrent_100us_sys/EnAwUp/Local Variable Storage1" /begin REF_MEASUREMENT CTCR_DAxisAntiWindupEna /end REF_MEASUREMENT /end GROUP
/begin GROUP CtlCurrentRegulator_CTCR_RegulateCurrent_100us_sys_Local_Variable_Storage "CtlCurrentRegulator/CTCR_RegulateCurrent_100us_sys/Local Variable Storage" /begin REF_MEASUREMENT CTCR_Pi_Out_Ud /end REF_MEASUREMENT /end GROUP
/begin GROUP CtlCurrentRegulator_CTCR_RegulateCurrent_100us_sys_Local_Variable_Storage1 "CtlCurrentRegulator/CTCR_RegulateCurrent_100us_sys/Local Variable Storage1" /begin REF_MEASUREMENT CTCR_Pi_Out_Uq /end REF_MEASUREMENT /end GROUP
/begin GROUP CtlCurrentRegulator_CTCR_RegulateCurrent_100us_sys_PI_DAxis "CtlCurrentRegulator/CTCR_RegulateCurrent_100us_sys/PI_DAxis"
 /begin SUB_GROUP CtlCurrentRegulator_CTCR_RegulateCurrent_100us_sys_PI_DAxis_Local_Variable_Storage CtlCurrentRegulator_CTCR_RegulateCurrent_100us_sys_PI_DAxis_Local_Variable_Storage1 /end SUB_GROUP
 /begin REF_MEASUREMENT CTLC_IdSpLimited CTSO_CurrentIntegralDisable CTSO_CurrentIntegralReset CtlCurrentRegulator_DW.Delay1_DSTATE CtlCurrentRegulator_DW.Delay_DSTATE CtlCurrentRegulator_DW.icLoad CtlCurrentRegulator_DW.icLoad_d SGPP_SampleTime1 TFPD_IdMeasured /end REF_MEASUREMENT
/end GROUP
/begin GROUP CtlCurrentRegulator_CTCR_RegulateCurrent_100us_sys_PI_DAxis_Local_Variable_Storage "CtlCurrentRegulator/CTCR_RegulateCurrent_100us_sys/PI_DAxis/Local Variable Storage" /begin REF_MEASUREMENT CTCR_Kp_Out_Ud /end REF_MEASUREMENT /end GROUP
/begin GROUP CtlCurrentRegulator_CTCR_RegulateCurrent_100us_sys_PI_DAxis_Local_Variable_Storage1 "CtlCurrentRegulator/CTCR_RegulateCurrent_100us_sys/PI_DAxis/Local Variable Storage1" /begin REF_MEASUREMENT CTCR_Ki_Out_Ud /end REF_MEASUREMENT /end GROUP
/begin GROUP CtlCurrentRegulator_CTCR_RegulateCurrent_100us_sys_PI_QAxis "CtlCurrentRegulator/CTCR_RegulateCurrent_100us_sys/PI_QAxis"
 /begin SUB_GROUP CtlCurrentRegulator_CTCR_RegulateCurrent_100us_sys_PI_QAxis_Local_Variable_Storage CtlCurrentRegulator_CTCR_RegulateCurrent_100us_sys_PI_QAxis_Local_Variable_Storage1 CtlCurrentRegulator_CTCR_RegulateCurrent_100us_sys_PI_QAxis_Local_Variable_Storage2 /end SUB_GROUP
 /begin REF_MEASUREMENT CTLC_IqSpLimited CTSO_CurrentIntegralDisable CTSO_CurrentIntegralReset CtlCurrentRegulator_DW.Delay1_DSTATE_j CtlCurrentRegulator_DW.Delay_DSTATE_c CtlCurrentRegulator_DW.icLoad_g CtlCurrentRegulator_DW.icLoad_p SGPP_SampleTime1 TFPD_IqMeasured /end REF_MEASUREMENT
/end GROUP
/begin GROUP CtlCurrentRegulator_CTCR_RegulateCurrent_100us_sys_PI_QAxis_Local_Variable_Storage "CtlCurrentRegulator/CTCR_RegulateCurrent_100us_sys/PI_QAxis/Local Variable Storage" /begin REF_MEASUREMENT CTCR_Kp_Out_Uq /end REF_MEASUREMENT /end GROUP
/begin GROUP CtlCurrentRegulator_CTCR_RegulateCurrent_100us_sys_PI_QAxis_Local_Variable_Storage1 "CtlCurrentRegulator/CTCR_RegulateCurrent_100us_sys/PI_QAxis/Local Variable Storage1" /begin REF_MEASUREMENT CTCR_Ki_Out_Uq /end REF_MEASUREMENT /end GROUP
/begin GROUP CtlCurrentRegulator_CTCR_RegulateCurrent_100us_sys_PI_QAxis_Local_Variable_Storage2 "CtlCurrentRegulator/CTCR_RegulateCurrent_100us_sys/PI_QAxis/Local Variable Storage2" /begin REF_MEASUREMENT CTCR_Uq_Err /end REF_MEASUREMENT /end GROUP
/begin GROUP CtlCurrentRegulator_CTCR_RegulateCurrent_100us_sys_Parameter1 "CtlCurrentRegulator/CTCR_RegulateCurrent_100us_sys/Parameter1" /begin REF_CHARACTERISTIC CTCR_DAxisKi_C /end REF_CHARACTERISTIC /end GROUP
/begin GROUP CtlCurrentRegulator_CTCR_RegulateCurrent_100us_sys_Parameter2 "CtlCurrentRegulator/CTCR_RegulateCurrent_100us_sys/Parameter2" /begin REF_CHARACTERISTIC CTCR_QAxisKp_C /end REF_CHARACTERISTIC /end GROUP
/begin GROUP CtlCurrentRegulator_CTCR_RegulateCurrent_100us_sys_Parameter3 "CtlCurrentRegulator/CTCR_RegulateCurrent_100us_sys/Parameter3" /begin REF_CHARACTERISTIC CTCR_QAxisKi_C /end REF_CHARACTERISTIC /end GROUP
/begin GROUP CtlCurrentRegulator_CTCR_RegulateCurrent_100us_sys_Parameter7 "CtlCurrentRegulator/CTCR_RegulateCurrent_100us_sys/Parameter7" /begin REF_CHARACTERISTIC CTCR_DAxisKp_C /end REF_CHARACTERISTIC /end GROUP
/begin GROUP CtlCurrentRegulator_CTCR_RegulateCurrent_100us_sys__VoltageSaturation "CtlCurrentRegulator/CTCR_RegulateCurrent_100us_sys/ VoltageSaturation"
 /begin SUB_GROUP CtlCurrentRegulator_CTCR_RegulateCurrent_100us_sys__VoltageSaturation_LowPassFilter CtlCurrentRegulator_CTCR_RegulateCurrent_100us_sys__VoltageSaturation_Parameter1 CtlCurrentRegulator_CTCR_RegulateCurrent_100us_sys__VoltageSaturation_Parameter8 CtlCurrentRegulator_CTCR_RegulateCurrent_100us_sys__VoltageSaturation_Subsystem /end SUB_GROUP
 /begin REF_MEASUREMENT SGPP_DcLinkVoltMeas /end REF_MEASUREMENT
/end GROUP
/begin GROUP CtlCurrentRegulator_CTCR_RegulateCurrent_100us_sys__VoltageSaturation_LowPassFilter "CtlCurrentRegulator/CTCR_RegulateCurrent_100us_sys/ VoltageSaturation/LowPassFilter" /begin REF_MEASUREMENT SGPP_SampleTime1 /end REF_MEASUREMENT /end GROUP
/begin GROUP CtlCurrentRegulator_CTCR_RegulateCurrent_100us_sys__VoltageSaturation_Parameter1 "CtlCurrentRegulator/CTCR_RegulateCurrent_100us_sys/ VoltageSaturation/Parameter1" /begin REF_CHARACTERISTIC CTCR_VoltVectorMagFilterFreq_C /end REF_CHARACTERISTIC /end GROUP
/begin GROUP CtlCurrentRegulator_CTCR_RegulateCurrent_100us_sys__VoltageSaturation_Parameter8 "CtlCurrentRegulator/CTCR_RegulateCurrent_100us_sys/ VoltageSaturation/Parameter8" /begin REF_CHARACTERISTIC CTCR_VoltLimitFactor_C /end REF_CHARACTERISTIC /end GROUP
/begin GROUP CtlCurrentRegulator_CTCR_RegulateCurrent_100us_sys__VoltageSaturation_Subsystem "CtlCurrentRegulator/CTCR_RegulateCurrent_100us_sys/ VoltageSaturation/Subsystem"
 /begin SUB_GROUP CtlCurrentRegulator_CTCR_RegulateCurrent_100us_sys__VoltageSaturation_Subsystem_Local_Variable_Storage CtlCurrentRegulator_CTCR_RegulateCurrent_100us_sys__VoltageSaturation_Subsystem_Local_Variable_Storage1 CtlCurrentRegulator_CTCR_RegulateCurrent_100us_sys__VoltageSaturation_Subsystem_Local_Variable_Storage2 CtlCurrentRegulator_CTCR_RegulateCurrent_100us_sys__VoltageSaturation_Subsystem_LowPassFilter CtlCurrentRegulator_CTCR_RegulateCurrent_100us_sys__VoltageSaturation_Subsystem_Parameter1 /end SUB_GROUP
/end GROUP
/begin GROUP CtlCurrentRegulator_CTCR_RegulateCurrent_100us_sys__VoltageSaturation_Subsystem_Local_Variable_Storage "CtlCurrentRegulator/CTCR_RegulateCurrent_100us_sys/ VoltageSaturation/Subsystem/Local Variable Storage" /begin REF_MEASUREMENT CTCR_CurrentVs /end REF_MEASUREMENT /end GROUP
/begin GROUP CtlCurrentRegulator_CTCR_RegulateCurrent_100us_sys__VoltageSaturation_Subsystem_Local_Variable_Storage1 "CtlCurrentRegulator/CTCR_RegulateCurrent_100us_sys/ VoltageSaturation/Subsystem/Local Variable Storage1" /begin REF_MEASUREMENT CTCR_LimitVs /end REF_MEASUREMENT /end GROUP
/begin GROUP CtlCurrentRegulator_CTCR_RegulateCurrent_100us_sys__VoltageSaturation_Subsystem_Local_Variable_Storage2 "CtlCurrentRegulator/CTCR_RegulateCurrent_100us_sys/ VoltageSaturation/Subsystem/Local Variable Storage2" /begin REF_MEASUREMENT CTCR_VsLpfVal /end REF_MEASUREMENT /end GROUP
/begin GROUP CtlCurrentRegulator_CTCR_RegulateCurrent_100us_sys__VoltageSaturation_Subsystem_LowPassFilter "CtlCurrentRegulator/CTCR_RegulateCurrent_100us_sys/ VoltageSaturation/Subsystem/LowPassFilter" /begin REF_MEASUREMENT CtlCurrentRegulator_DW.Delay_DSTATE_h SGPP_SampleTime1 /end REF_MEASUREMENT /end GROUP
/begin GROUP CtlCurrentRegulator_CTCR_RegulateCurrent_100us_sys__VoltageSaturation_Subsystem_Parameter1 "CtlCurrentRegulator/CTCR_RegulateCurrent_100us_sys/ VoltageSaturation/Subsystem/Parameter1" /begin REF_CHARACTERISTIC CTCR_VSFilterFreq_C /end REF_CHARACTERISTIC /end GROUP
/end MODULE
/end PROJECT
/* (add any file trailer comments here) */
/* EOF CtlCurrentRegulator.a2l*/
