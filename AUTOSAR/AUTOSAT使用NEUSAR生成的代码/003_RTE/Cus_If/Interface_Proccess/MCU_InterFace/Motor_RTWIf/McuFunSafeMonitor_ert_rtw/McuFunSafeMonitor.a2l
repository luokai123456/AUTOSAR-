/******************************************************************************
* ASAP2 file: McuFunSafeMonitor.a2l
* Code generation for model "McuFunSafeMonitor".
* Model version : 1.993
* Simulink Coder version : 10.6 R2022b
* C source code generated on : Sat Sep 05 08:35:24 2026
* Target selection: ert.tlc
* Embedded hardware selection: Infineon->TriCore
* Code generation objectives: Unspecified
* Validation result: Not run
* (add additional file header information here)
******************************************************************************/ ASAP2_VERSION 1 71
/* Version 1.71 */
/begin PROJECT ProjectName "Project Comment Goes Here"
/begin HEADER "Header Comments go here" /end HEADER
/begin MODULE ModuleName "Module Comment Goes Here"
/begin MOD_PAR "MOD PAR Comment Goes Here" /end MOD_PAR
/begin MOD_COMMON "Mod Common Comment Here" BYTE_ORDER MSB_LAST ALIGNMENT_BYTE 1 ALIGNMENT_WORD 2 ALIGNMENT_LONG 4 ALIGNMENT_FLOAT32_IEEE 4 ALIGNMENT_FLOAT64_IEEE 8 ALIGNMENT_INT64 8 /end MOD_COMMON
/begin CHARACTERISTIC MFSM_AmpHigh_C "" VALUE 0x0000 /* @ECU_Address@MFSM_AmpHigh_C@ */ Record_FLOAT32_IEEE 0 McuFunSafeMonitor_CM_single_dash_ 0.000000 3.4E+38 /end CHARACTERISTIC
/begin CHARACTERISTIC MFSM_AmpLow_C "" VALUE 0x0000 /* @ECU_Address@MFSM_AmpLow_C@ */ Record_FLOAT32_IEEE 0 McuFunSafeMonitor_CM_single 0.000000 3.4E+38 /end CHARACTERISTIC
/begin CHARACTERISTIC MFSM_BusCurDiff_C "" VALUE 0x0000 /* @ECU_Address@MFSM_BusCurDiff_C@ */ Record_FLOAT32_IEEE 0 McuFunSafeMonitor_CM_single_dash_ 0.000000 3.4E+38 /end CHARACTERISTIC
/begin CHARACTERISTIC MFSM_BusCurrentCalCoeffSel_C "" VALUE 0x0000 /* @ECU_Address@MFSM_BusCurrentCalCoeffSel_C@ */ Record_UBYTE 0 McuFunSafeMonitor_CM_uint8_dash_ 0.000000 255.000000 /end CHARACTERISTIC
/begin CHARACTERISTIC MFSM_BusCurrentCalCoeff_C "" VALUE 0x0000 /* @ECU_Address@MFSM_BusCurrentCalCoeff_C@ */ Record_FLOAT32_IEEE 0 McuFunSafeMonitor_CM_single 0.000000 3.4E+38 /end CHARACTERISTIC
/begin CHARACTERISTIC MFSM_BusCurrentCompCoeff_M "" CURVE 0x0000 /* @ECU_Address@MFSM_BusCurrentCompCoeff_M@ */ Record_FLOAT32_IEEE 0 McuFunSafeMonitor_CM_single_N_per_m -3.4E+38 3.4E+38
 /begin AXIS_DESCR COM_AXIS NO_INPUT_QUANTITY McuFunSafeMonitor_CM_single_Rpm 3 -3.4E+38 3.4E+38 AXIS_PTS_REF MFSM_MechSpd_A /end AXIS_DESCR
/end CHARACTERISTIC
/begin CHARACTERISTIC MFSM_BusCurrentCompEna_C "" VALUE 0x0000 /* @ECU_Address@MFSM_BusCurrentCompEna_C@ */ Record_UBYTE 0 McuFunSafeMonitor_CM_uint8_dash_ 0.000000 255.000000 /end CHARACTERISTIC
/begin CHARACTERISTIC MFSM_BusCurrentComp_M "" CURVE 0x0000 /* @ECU_Address@MFSM_BusCurrentComp_M@ */ Record_FLOAT32_IEEE 0 McuFunSafeMonitor_CM_single_N_per_m -3.4E+38 3.4E+38
 /begin AXIS_DESCR COM_AXIS NO_INPUT_QUANTITY McuFunSafeMonitor_CM_single_Rpm 3 -3.4E+38 3.4E+38 AXIS_PTS_REF MFSM_LpfBusCurrent_A /end AXIS_DESCR
/end CHARACTERISTIC
/begin CHARACTERISTIC MFSM_BusCurrentFilterFreq_C "" VALUE 0x0000 /* @ECU_Address@MFSM_BusCurrentFilterFreq_C@ */ Record_FLOAT32_IEEE 0 McuFunSafeMonitor_CM_single 0.000000 3.4E+38 /end CHARACTERISTIC
/begin CHARACTERISTIC MFSM_CosShortGndValue_C "" VALUE 0x0000 /* @ECU_Address@MFSM_CosShortGndValue_C@ */ Record_FLOAT32_IEEE 0 McuFunSafeMonitor_CM_single_dash_ 0.000000 3.4E+38 /end CHARACTERISTIC
/begin CHARACTERISTIC MFSM_CosShortPwrValue_C "" VALUE 0x0000 /* @ECU_Address@MFSM_CosShortPwrValue_C@ */ Record_FLOAT32_IEEE 0 McuFunSafeMonitor_CM_single_dash_ 0.000000 3.4E+38 /end CHARACTERISTIC
/begin CHARACTERISTIC MFSM_DebounceDecrBusCurDiff_C "" VALUE 0x0000 /* @ECU_Address@MFSM_DebounceDecrBusCurDiff_C@ */ Record_UBYTE 0 McuFunSafeMonitor_CM_uint8_dash_ 0.000000 255.000000 /end CHARACTERISTIC
/begin CHARACTERISTIC MFSM_DebounceDecrCosOpen_C "" VALUE 0x0000 /* @ECU_Address@MFSM_DebounceDecrCosOpen_C@ */ Record_UBYTE 0 McuFunSafeMonitor_CM_uint8_dash_ 0.000000 255.000000 /end CHARACTERISTIC
/begin CHARACTERISTIC MFSM_DebounceDecrCosShortGnd_C "" VALUE 0x0000 /* @ECU_Address@MFSM_DebounceDecrCosShortGnd_C@ */ Record_UBYTE 0 McuFunSafeMonitor_CM_uint8_dash_ 0.000000 255.000000 /end CHARACTERISTIC
/begin CHARACTERISTIC MFSM_DebounceDecrCosShortPwr_C "" VALUE 0x0000 /* @ECU_Address@MFSM_DebounceDecrCosShortPwr_C@ */ Record_UBYTE 0 McuFunSafeMonitor_CM_uint8_dash_ 0.000000 255.000000 /end CHARACTERISTIC
/begin CHARACTERISTIC MFSM_DebounceDecrExcAmp_C "" VALUE 0x0000 /* @ECU_Address@MFSM_DebounceDecrExcAmp_C@ */ Record_UBYTE 0 McuFunSafeMonitor_CM_uint8_dash_ 0.000000 255.000000 /end CHARACTERISTIC
/begin CHARACTERISTIC MFSM_DebounceDecrExcOpen_C "" VALUE 0x0000 /* @ECU_Address@MFSM_DebounceDecrExcOpen_C@ */ Record_UBYTE 0 McuFunSafeMonitor_CM_uint8_dash_ 0.000000 255.000000 /end CHARACTERISTIC
/begin CHARACTERISTIC MFSM_DebounceDecrExcShortGnd_C "" VALUE 0x0000 /* @ECU_Address@MFSM_DebounceDecrExcShortGnd_C@ */ Record_UBYTE 0 McuFunSafeMonitor_CM_uint8_dash_ 0.000000 255.000000 /end CHARACTERISTIC
/begin CHARACTERISTIC MFSM_DebounceDecrHighVolt_C "" VALUE 0x0000 /* @ECU_Address@MFSM_DebounceDecrHighVolt_C@ */ Record_UBYTE 0 McuFunSafeMonitor_CM_uint8_dash_ 0.000000 255.000000 /end CHARACTERISTIC
/begin CHARACTERISTIC MFSM_DebounceDecrMtrTempShortGnd_C "" VALUE 0x0000 /* @ECU_Address@MFSM_DebounceDecrMtrTempShortGnd_C@ */ Record_UBYTE 0 McuFunSafeMonitor_CM_uint8_dash_ 0.000000 255.000000 /end CHARACTERISTIC
/begin CHARACTERISTIC MFSM_DebounceDecrMtrTempShortPwr_C "" VALUE 0x0000 /* @ECU_Address@MFSM_DebounceDecrMtrTempShortPwr_C@ */ Record_UBYTE 0 McuFunSafeMonitor_CM_uint8_dash_ 0.000000 255.000000 /end CHARACTERISTIC
/begin CHARACTERISTIC MFSM_DebounceDecrMtrTemp_C "" VALUE 0x0000 /* @ECU_Address@MFSM_DebounceDecrMtrTemp_C@ */ Record_UBYTE 0 McuFunSafeMonitor_CM_uint8_dash_ 0.000000 255.000000 /end CHARACTERISTIC
/begin CHARACTERISTIC MFSM_DebounceDecrOpen_C "" VALUE 0x0000 /* @ECU_Address@MFSM_DebounceDecrOpen_C@ */ Record_UBYTE 0 McuFunSafeMonitor_CM_uint8_dash_ 0.000000 255.000000 /end CHARACTERISTIC
/begin CHARACTERISTIC MFSM_DebounceDecrPhaCurrDiff_C "" VALUE 0x0000 /* @ECU_Address@MFSM_DebounceDecrPhaCurrDiff_C@ */ Record_UBYTE 0 McuFunSafeMonitor_CM_uint8_dash_ 0.000000 255.000000 /end CHARACTERISTIC
/begin CHARACTERISTIC MFSM_DebounceDecrPhaCurrOpen_C "" VALUE 0x0000 /* @ECU_Address@MFSM_DebounceDecrPhaCurrOpen_C@ */ Record_UBYTE 0 McuFunSafeMonitor_CM_uint8_dash_ 0.000000 255.000000 /end CHARACTERISTIC
/begin CHARACTERISTIC MFSM_DebounceDecrPhaCurrShortPwr_C "" VALUE 0x0000 /* @ECU_Address@MFSM_DebounceDecrPhaCurrShortPwr_C@ */ Record_UBYTE 0 McuFunSafeMonitor_CM_uint8_dash_ 0.000000 255.000000 /end CHARACTERISTIC
/begin CHARACTERISTIC MFSM_DebounceDecrRslvrAmp_C "" VALUE 0x0000 /* @ECU_Address@MFSM_DebounceDecrRslvrAmp_C@ */ Record_UBYTE 0 McuFunSafeMonitor_CM_uint8_dash_ 0.000000 255.000000 /end CHARACTERISTIC
/begin CHARACTERISTIC MFSM_DebounceDecrSensorVolt_C "" VALUE 0x0000 /* @ECU_Address@MFSM_DebounceDecrSensorVolt_C@ */ Record_UBYTE 0 McuFunSafeMonitor_CM_uint8_dash_ 0.000000 255.000000 /end CHARACTERISTIC
/begin CHARACTERISTIC MFSM_DebounceDecrSinOpen_C "" VALUE 0x0000 /* @ECU_Address@MFSM_DebounceDecrSinOpen_C@ */ Record_UBYTE 0 McuFunSafeMonitor_CM_uint8_dash_ 0.000000 255.000000 /end CHARACTERISTIC
/begin CHARACTERISTIC MFSM_DebounceDecrSinShortGnd_C "" VALUE 0x0000 /* @ECU_Address@MFSM_DebounceDecrSinShortGnd_C@ */ Record_UBYTE 0 McuFunSafeMonitor_CM_uint8_dash_ 0.000000 255.000000 /end CHARACTERISTIC
/begin CHARACTERISTIC MFSM_DebounceDecrSinShortPwr_C "" VALUE 0x0000 /* @ECU_Address@MFSM_DebounceDecrSinShortPwr_C@ */ Record_UBYTE 0 McuFunSafeMonitor_CM_uint8_dash_ 0.000000 255.000000 /end CHARACTERISTIC
/begin CHARACTERISTIC MFSM_DebounceDecrTqDiff_C "" VALUE 0x0000 /* @ECU_Address@MFSM_DebounceDecrTqDiff_C@ */ Record_UBYTE 0 McuFunSafeMonitor_CM_uint8_dash_ 0.000000 255.000000 /end CHARACTERISTIC
/begin CHARACTERISTIC MFSM_DebounceIncrBusCurDiff_C "" VALUE 0x0000 /* @ECU_Address@MFSM_DebounceIncrBusCurDiff_C@ */ Record_UBYTE 0 McuFunSafeMonitor_CM_uint8_dash_ 0.000000 255.000000 /end CHARACTERISTIC
/begin CHARACTERISTIC MFSM_DebounceIncrCosOpen_C "" VALUE 0x0000 /* @ECU_Address@MFSM_DebounceIncrCosOpen_C@ */ Record_UBYTE 0 McuFunSafeMonitor_CM_uint8_dash_ 0.000000 255.000000 /end CHARACTERISTIC
/begin CHARACTERISTIC MFSM_DebounceIncrCosShortGnd_C "" VALUE 0x0000 /* @ECU_Address@MFSM_DebounceIncrCosShortGnd_C@ */ Record_UBYTE 0 McuFunSafeMonitor_CM_uint8_dash_ 0.000000 255.000000 /end CHARACTERISTIC
/begin CHARACTERISTIC MFSM_DebounceIncrCosShortPwr_C "" VALUE 0x0000 /* @ECU_Address@MFSM_DebounceIncrCosShortPwr_C@ */ Record_UBYTE 0 McuFunSafeMonitor_CM_uint8_dash_ 0.000000 255.000000 /end CHARACTERISTIC
/begin CHARACTERISTIC MFSM_DebounceIncrExcAmp_C "" VALUE 0x0000 /* @ECU_Address@MFSM_DebounceIncrExcAmp_C@ */ Record_UBYTE 0 McuFunSafeMonitor_CM_uint8_dash_ 0.000000 255.000000 /end CHARACTERISTIC
/begin CHARACTERISTIC MFSM_DebounceIncrExcOpen_C "" VALUE 0x0000 /* @ECU_Address@MFSM_DebounceIncrExcOpen_C@ */ Record_UBYTE 0 McuFunSafeMonitor_CM_uint8_dash_ 0.000000 255.000000 /end CHARACTERISTIC
/begin CHARACTERISTIC MFSM_DebounceIncrExcShortGnd_C "" VALUE 0x0000 /* @ECU_Address@MFSM_DebounceIncrExcShortGnd_C@ */ Record_UBYTE 0 McuFunSafeMonitor_CM_uint8_dash_ 0.000000 255.000000 /end CHARACTERISTIC
/begin CHARACTERISTIC MFSM_DebounceIncrHighVolt_C "" VALUE 0x0000 /* @ECU_Address@MFSM_DebounceIncrHighVolt_C@ */ Record_UBYTE 0 McuFunSafeMonitor_CM_uint8_dash_ 0.000000 255.000000 /end CHARACTERISTIC
/begin CHARACTERISTIC MFSM_DebounceIncrMtrTempShortGnd_C "" VALUE 0x0000 /* @ECU_Address@MFSM_DebounceIncrMtrTempShortGnd_C@ */ Record_UBYTE 0 McuFunSafeMonitor_CM_uint8_dash_ 0.000000 255.000000 /end CHARACTERISTIC
/begin CHARACTERISTIC MFSM_DebounceIncrMtrTempShortPwr_C "" VALUE 0x0000 /* @ECU_Address@MFSM_DebounceIncrMtrTempShortPwr_C@ */ Record_UBYTE 0 McuFunSafeMonitor_CM_uint8_dash_ 0.000000 255.000000 /end CHARACTERISTIC
/begin CHARACTERISTIC MFSM_DebounceIncrMtrTemp_C "" VALUE 0x0000 /* @ECU_Address@MFSM_DebounceIncrMtrTemp_C@ */ Record_UBYTE 0 McuFunSafeMonitor_CM_uint8_dash_ 0.000000 255.000000 /end CHARACTERISTIC
/begin CHARACTERISTIC MFSM_DebounceIncrOpen_C "" VALUE 0x0000 /* @ECU_Address@MFSM_DebounceIncrOpen_C@ */ Record_UBYTE 0 McuFunSafeMonitor_CM_uint8_dash_ 0.000000 255.000000 /end CHARACTERISTIC
/begin CHARACTERISTIC MFSM_DebounceIncrPhaCurrDiff_C "" VALUE 0x0000 /* @ECU_Address@MFSM_DebounceIncrPhaCurrDiff_C@ */ Record_UBYTE 0 McuFunSafeMonitor_CM_uint8_dash_ 0.000000 255.000000 /end CHARACTERISTIC
/begin CHARACTERISTIC MFSM_DebounceIncrPhaCurrOpen_C "" VALUE 0x0000 /* @ECU_Address@MFSM_DebounceIncrPhaCurrOpen_C@ */ Record_UBYTE 0 McuFunSafeMonitor_CM_uint8_dash_ 0.000000 255.000000 /end CHARACTERISTIC
/begin CHARACTERISTIC MFSM_DebounceIncrPhaCurrShortPwr_C "" VALUE 0x0000 /* @ECU_Address@MFSM_DebounceIncrPhaCurrShortPwr_C@ */ Record_UBYTE 0 McuFunSafeMonitor_CM_uint8_dash_ 0.000000 255.000000 /end CHARACTERISTIC
/begin CHARACTERISTIC MFSM_DebounceIncrRslvrAmp_C "" VALUE 0x0000 /* @ECU_Address@MFSM_DebounceIncrRslvrAmp_C@ */ Record_UBYTE 0 McuFunSafeMonitor_CM_uint8_dash_ 0.000000 255.000000 /end CHARACTERISTIC
/begin CHARACTERISTIC MFSM_DebounceIncrSensorVolt_C "" VALUE 0x0000 /* @ECU_Address@MFSM_DebounceIncrSensorVolt_C@ */ Record_UBYTE 0 McuFunSafeMonitor_CM_uint8_dash_ 0.000000 255.000000 /end CHARACTERISTIC
/begin CHARACTERISTIC MFSM_DebounceIncrSinOpen_C "" VALUE 0x0000 /* @ECU_Address@MFSM_DebounceIncrSinOpen_C@ */ Record_UBYTE 0 McuFunSafeMonitor_CM_uint8_dash_ 0.000000 255.000000 /end CHARACTERISTIC
/begin CHARACTERISTIC MFSM_DebounceIncrSinShortGnd_C "" VALUE 0x0000 /* @ECU_Address@MFSM_DebounceIncrSinShortGnd_C@ */ Record_UBYTE 0 McuFunSafeMonitor_CM_uint8_dash_ 0.000000 255.000000 /end CHARACTERISTIC
/begin CHARACTERISTIC MFSM_DebounceIncrSinShortPwr_C "" VALUE 0x0000 /* @ECU_Address@MFSM_DebounceIncrSinShortPwr_C@ */ Record_UBYTE 0 McuFunSafeMonitor_CM_uint8_dash_ 0.000000 255.000000 /end CHARACTERISTIC
/begin CHARACTERISTIC MFSM_DebounceIncrTqDiff_C "" VALUE 0x0000 /* @ECU_Address@MFSM_DebounceIncrTqDiff_C@ */ Record_UBYTE 0 McuFunSafeMonitor_CM_uint8_dash_ 0.000000 255.000000 /end CHARACTERISTIC
/begin CHARACTERISTIC MFSM_DebounceMaxBusCurDiff_C "" VALUE 0x0000 /* @ECU_Address@MFSM_DebounceMaxBusCurDiff_C@ */ Record_UBYTE 0 McuFunSafeMonitor_CM_uint8_dash_ 0.000000 255.000000 /end CHARACTERISTIC
/begin CHARACTERISTIC MFSM_DebounceMaxCosOpen_C "" VALUE 0x0000 /* @ECU_Address@MFSM_DebounceMaxCosOpen_C@ */ Record_UBYTE 0 McuFunSafeMonitor_CM_uint8_dash_ 0.000000 255.000000 /end CHARACTERISTIC
/begin CHARACTERISTIC MFSM_DebounceMaxCosShortGnd_C "" VALUE 0x0000 /* @ECU_Address@MFSM_DebounceMaxCosShortGnd_C@ */ Record_UBYTE 0 McuFunSafeMonitor_CM_uint8_dash_ 0.000000 255.000000 /end CHARACTERISTIC
/begin CHARACTERISTIC MFSM_DebounceMaxCosShortPwr_C "" VALUE 0x0000 /* @ECU_Address@MFSM_DebounceMaxCosShortPwr_C@ */ Record_UBYTE 0 McuFunSafeMonitor_CM_uint8_dash_ 0.000000 255.000000 /end CHARACTERISTIC
/begin CHARACTERISTIC MFSM_DebounceMaxExcAmp_C "" VALUE 0x0000 /* @ECU_Address@MFSM_DebounceMaxExcAmp_C@ */ Record_UBYTE 0 McuFunSafeMonitor_CM_uint8_dash_ 0.000000 255.000000 /end CHARACTERISTIC
/begin CHARACTERISTIC MFSM_DebounceMaxExcOpen_C "" VALUE 0x0000 /* @ECU_Address@MFSM_DebounceMaxExcOpen_C@ */ Record_UBYTE 0 McuFunSafeMonitor_CM_uint8_dash_ 0.000000 255.000000 /end CHARACTERISTIC
/begin CHARACTERISTIC MFSM_DebounceMaxExcShortGnd_C "" VALUE 0x0000 /* @ECU_Address@MFSM_DebounceMaxExcShortGnd_C@ */ Record_UBYTE 0 McuFunSafeMonitor_CM_uint8_dash_ 0.000000 255.000000 /end CHARACTERISTIC
/begin CHARACTERISTIC MFSM_DebounceMaxHighVolt_C "" VALUE 0x0000 /* @ECU_Address@MFSM_DebounceMaxHighVolt_C@ */ Record_UBYTE 0 McuFunSafeMonitor_CM_uint8_dash_ 0.000000 255.000000 /end CHARACTERISTIC
/begin CHARACTERISTIC MFSM_DebounceMaxMtrTempShortGnd_C "" VALUE 0x0000 /* @ECU_Address@MFSM_DebounceMaxMtrTempShortGnd_C@ */ Record_UBYTE 0 McuFunSafeMonitor_CM_uint8_dash_ 0.000000 255.000000 /end CHARACTERISTIC
/begin CHARACTERISTIC MFSM_DebounceMaxMtrTempShortPwr_C "" VALUE 0x0000 /* @ECU_Address@MFSM_DebounceMaxMtrTempShortPwr_C@ */ Record_UBYTE 0 McuFunSafeMonitor_CM_uint8_dash_ 0.000000 255.000000 /end CHARACTERISTIC
/begin CHARACTERISTIC MFSM_DebounceMaxMtrTemp_C "" VALUE 0x0000 /* @ECU_Address@MFSM_DebounceMaxMtrTemp_C@ */ Record_UBYTE 0 McuFunSafeMonitor_CM_uint8_dash_ 0.000000 255.000000 /end CHARACTERISTIC
/begin CHARACTERISTIC MFSM_DebounceMaxOpen_C "" VALUE 0x0000 /* @ECU_Address@MFSM_DebounceMaxOpen_C@ */ Record_UBYTE 0 McuFunSafeMonitor_CM_uint8_dash_ 0.000000 255.000000 /end CHARACTERISTIC
/begin CHARACTERISTIC MFSM_DebounceMaxPhaCurrDiff_C "" VALUE 0x0000 /* @ECU_Address@MFSM_DebounceMaxPhaCurrDiff_C@ */ Record_UBYTE 0 McuFunSafeMonitor_CM_uint8_dash_ 0.000000 255.000000 /end CHARACTERISTIC
/begin CHARACTERISTIC MFSM_DebounceMaxPhaCurrOpen_C "" VALUE 0x0000 /* @ECU_Address@MFSM_DebounceMaxPhaCurrOpen_C@ */ Record_UBYTE 0 McuFunSafeMonitor_CM_uint8_dash_ 0.000000 255.000000 /end CHARACTERISTIC
/begin CHARACTERISTIC MFSM_DebounceMaxPhaCurrShortPwr_C "" VALUE 0x0000 /* @ECU_Address@MFSM_DebounceMaxPhaCurrShortPwr_C@ */ Record_UBYTE 0 McuFunSafeMonitor_CM_uint8_dash_ 0.000000 255.000000 /end CHARACTERISTIC
/begin CHARACTERISTIC MFSM_DebounceMaxRslvrAmp_C "" VALUE 0x0000 /* @ECU_Address@MFSM_DebounceMaxRslvrAmp_C@ */ Record_UBYTE 0 McuFunSafeMonitor_CM_uint8_dash_ 0.000000 255.000000 /end CHARACTERISTIC
/begin CHARACTERISTIC MFSM_DebounceMaxSensorVolt_C "" VALUE 0x0000 /* @ECU_Address@MFSM_DebounceMaxSensorVolt_C@ */ Record_UBYTE 0 McuFunSafeMonitor_CM_uint8_dash_ 0.000000 255.000000 /end CHARACTERISTIC
/begin CHARACTERISTIC MFSM_DebounceMaxSinOpen_C "" VALUE 0x0000 /* @ECU_Address@MFSM_DebounceMaxSinOpen_C@ */ Record_UBYTE 0 McuFunSafeMonitor_CM_uint8_dash_ 0.000000 255.000000 /end CHARACTERISTIC
/begin CHARACTERISTIC MFSM_DebounceMaxSinShortGnd_C "" VALUE 0x0000 /* @ECU_Address@MFSM_DebounceMaxSinShortGnd_C@ */ Record_UBYTE 0 McuFunSafeMonitor_CM_uint8_dash_ 0.000000 255.000000 /end CHARACTERISTIC
/begin CHARACTERISTIC MFSM_DebounceMaxSinShortPwr_C "" VALUE 0x0000 /* @ECU_Address@MFSM_DebounceMaxSinShortPwr_C@ */ Record_UBYTE 0 McuFunSafeMonitor_CM_uint8_dash_ 0.000000 255.000000 /end CHARACTERISTIC
/begin CHARACTERISTIC MFSM_DebounceMaxTqDiff_C "" VALUE 0x0000 /* @ECU_Address@MFSM_DebounceMaxTqDiff_C@ */ Record_UBYTE 0 McuFunSafeMonitor_CM_uint8_dash_ 0.000000 255.000000 /end CHARACTERISTIC
/begin CHARACTERISTIC MFSM_DebounceMinBusCurDiff_C "" VALUE 0x0000 /* @ECU_Address@MFSM_DebounceMinBusCurDiff_C@ */ Record_UBYTE 0 McuFunSafeMonitor_CM_uint8_dash_ 0.000000 255.000000 /end CHARACTERISTIC
/begin CHARACTERISTIC MFSM_DebounceMinCosOpen_C "" VALUE 0x0000 /* @ECU_Address@MFSM_DebounceMinCosOpen_C@ */ Record_UBYTE 0 McuFunSafeMonitor_CM_uint8_dash_ 0.000000 255.000000 /end CHARACTERISTIC
/begin CHARACTERISTIC MFSM_DebounceMinCosShortGnd_C "" VALUE 0x0000 /* @ECU_Address@MFSM_DebounceMinCosShortGnd_C@ */ Record_UBYTE 0 McuFunSafeMonitor_CM_uint8_dash_ 0.000000 255.000000 /end CHARACTERISTIC
/begin CHARACTERISTIC MFSM_DebounceMinCosShortPwr_C "" VALUE 0x0000 /* @ECU_Address@MFSM_DebounceMinCosShortPwr_C@ */ Record_UBYTE 0 McuFunSafeMonitor_CM_uint8_dash_ 0.000000 255.000000 /end CHARACTERISTIC
/begin CHARACTERISTIC MFSM_DebounceMinExcAmp_C "" VALUE 0x0000 /* @ECU_Address@MFSM_DebounceMinExcAmp_C@ */ Record_UBYTE 0 McuFunSafeMonitor_CM_uint8_dash_ 0.000000 255.000000 /end CHARACTERISTIC
/begin CHARACTERISTIC MFSM_DebounceMinExcOpen_C "" VALUE 0x0000 /* @ECU_Address@MFSM_DebounceMinExcOpen_C@ */ Record_UBYTE 0 McuFunSafeMonitor_CM_uint8_dash_ 0.000000 255.000000 /end CHARACTERISTIC
/begin CHARACTERISTIC MFSM_DebounceMinExcShortGnd_C "" VALUE 0x0000 /* @ECU_Address@MFSM_DebounceMinExcShortGnd_C@ */ Record_UBYTE 0 McuFunSafeMonitor_CM_uint8_dash_ 0.000000 255.000000 /end CHARACTERISTIC
/begin CHARACTERISTIC MFSM_DebounceMinHighVolt_C "" VALUE 0x0000 /* @ECU_Address@MFSM_DebounceMinHighVolt_C@ */ Record_UBYTE 0 McuFunSafeMonitor_CM_uint8_dash_ 0.000000 255.000000 /end CHARACTERISTIC
/begin CHARACTERISTIC MFSM_DebounceMinMtrTempShortGnd_C "" VALUE 0x0000 /* @ECU_Address@MFSM_DebounceMinMtrTempShortGnd_C@ */ Record_UBYTE 0 McuFunSafeMonitor_CM_uint8_dash_ 0.000000 255.000000 /end CHARACTERISTIC
/begin CHARACTERISTIC MFSM_DebounceMinMtrTempShortPwr_C "" VALUE 0x0000 /* @ECU_Address@MFSM_DebounceMinMtrTempShortPwr_C@ */ Record_UBYTE 0 McuFunSafeMonitor_CM_uint8_dash_ 0.000000 255.000000 /end CHARACTERISTIC
/begin CHARACTERISTIC MFSM_DebounceMinMtrTemp_C "" VALUE 0x0000 /* @ECU_Address@MFSM_DebounceMinMtrTemp_C@ */ Record_UBYTE 0 McuFunSafeMonitor_CM_uint8_dash_ 0.000000 255.000000 /end CHARACTERISTIC
/begin CHARACTERISTIC MFSM_DebounceMinOpen_C "" VALUE 0x0000 /* @ECU_Address@MFSM_DebounceMinOpen_C@ */ Record_UBYTE 0 McuFunSafeMonitor_CM_uint8_dash_ 0.000000 255.000000 /end CHARACTERISTIC
/begin CHARACTERISTIC MFSM_DebounceMinPhaCurrDiff_C "" VALUE 0x0000 /* @ECU_Address@MFSM_DebounceMinPhaCurrDiff_C@ */ Record_UBYTE 0 McuFunSafeMonitor_CM_uint8_dash_ 0.000000 255.000000 /end CHARACTERISTIC
/begin CHARACTERISTIC MFSM_DebounceMinPhaCurrOpen_C "" VALUE 0x0000 /* @ECU_Address@MFSM_DebounceMinPhaCurrOpen_C@ */ Record_UBYTE 0 McuFunSafeMonitor_CM_uint8_dash_ 0.000000 255.000000 /end CHARACTERISTIC
/begin CHARACTERISTIC MFSM_DebounceMinPhaCurrShortPwr_C "" VALUE 0x0000 /* @ECU_Address@MFSM_DebounceMinPhaCurrShortPwr_C@ */ Record_UBYTE 0 McuFunSafeMonitor_CM_uint8_dash_ 0.000000 255.000000 /end CHARACTERISTIC
/begin CHARACTERISTIC MFSM_DebounceMinRslvrAmp_C "" VALUE 0x0000 /* @ECU_Address@MFSM_DebounceMinRslvrAmp_C@ */ Record_UBYTE 0 McuFunSafeMonitor_CM_uint8_dash_ 0.000000 255.000000 /end CHARACTERISTIC
/begin CHARACTERISTIC MFSM_DebounceMinSensorVolt_C "" VALUE 0x0000 /* @ECU_Address@MFSM_DebounceMinSensorVolt_C@ */ Record_UBYTE 0 McuFunSafeMonitor_CM_uint8_dash_ 0.000000 255.000000 /end CHARACTERISTIC
/begin CHARACTERISTIC MFSM_DebounceMinSinOpen_C "" VALUE 0x0000 /* @ECU_Address@MFSM_DebounceMinSinOpen_C@ */ Record_UBYTE 0 McuFunSafeMonitor_CM_uint8_dash_ 0.000000 255.000000 /end CHARACTERISTIC
/begin CHARACTERISTIC MFSM_DebounceMinSinShortGnd_C "" VALUE 0x0000 /* @ECU_Address@MFSM_DebounceMinSinShortGnd_C@ */ Record_UBYTE 0 McuFunSafeMonitor_CM_uint8_dash_ 0.000000 255.000000 /end CHARACTERISTIC
/begin CHARACTERISTIC MFSM_DebounceMinSinShortPwr_C "" VALUE 0x0000 /* @ECU_Address@MFSM_DebounceMinSinShortPwr_C@ */ Record_UBYTE 0 McuFunSafeMonitor_CM_uint8_dash_ 0.000000 255.000000 /end CHARACTERISTIC
/begin CHARACTERISTIC MFSM_DebounceMinTqDiff_C "" VALUE 0x0000 /* @ECU_Address@MFSM_DebounceMinTqDiff_C@ */ Record_UBYTE 0 McuFunSafeMonitor_CM_uint8_dash_ 0.000000 255.000000 /end CHARACTERISTIC
/begin CHARACTERISTIC MFSM_ExcMaxHighValue_C "" VALUE 0x0000 /* @ECU_Address@MFSM_ExcMaxHighValue_C@ */ Record_FLOAT32_IEEE 0 McuFunSafeMonitor_CM_single_dash_ 0.000000 3.4E+38 /end CHARACTERISTIC
/begin CHARACTERISTIC MFSM_ExcMaxLowValue_C "" VALUE 0x0000 /* @ECU_Address@MFSM_ExcMaxLowValue_C@ */ Record_FLOAT32_IEEE 0 McuFunSafeMonitor_CM_single_dash_ 0.000000 3.4E+38 /end CHARACTERISTIC
/begin CHARACTERISTIC MFSM_ExcMinHighValue_C "" VALUE 0x0000 /* @ECU_Address@MFSM_ExcMinHighValue_C@ */ Record_FLOAT32_IEEE 0 McuFunSafeMonitor_CM_single_dash_ 0.000000 3.4E+38 /end CHARACTERISTIC
/begin CHARACTERISTIC MFSM_ExcMinLowValue_C "" VALUE 0x0000 /* @ECU_Address@MFSM_ExcMinLowValue_C@ */ Record_FLOAT32_IEEE 0 McuFunSafeMonitor_CM_single_dash_ 0.000000 3.4E+38 /end CHARACTERISTIC
/begin CHARACTERISTIC MFSM_ExcOpenValue_C "" VALUE 0x0000 /* @ECU_Address@MFSM_ExcOpenValue_C@ */ Record_FLOAT32_IEEE 0 McuFunSafeMonitor_CM_single_dash_ 0.000000 3.4E+38 /end CHARACTERISTIC
/begin CHARACTERISTIC MFSM_ExcShortGndValue_C "" VALUE 0x0000 /* @ECU_Address@MFSM_ExcShortGndValue_C@ */ Record_FLOAT32_IEEE 0 McuFunSafeMonitor_CM_single_dash_ 0.000000 3.4E+38 /end CHARACTERISTIC
/begin CHARACTERISTIC MFSM_ExcShortPwrValue_C "" VALUE 0x0000 /* @ECU_Address@MFSM_ExcShortPwrValue_C@ */ Record_FLOAT32_IEEE 0 McuFunSafeMonitor_CM_single_dash_ 0.000000 3.4E+38 /end CHARACTERISTIC
/begin CHARACTERISTIC MFSM_FastDiagInitTimeCount_C "" VALUE 0x0000 /* @ECU_Address@MFSM_FastDiagInitTimeCount_C@ */ Record_UWORD 0 McuFunSafeMonitor_CM_uint16_dash_ 0.000000 65535.000000 /end CHARACTERISTIC
/begin CHARACTERISTIC MFSM_HighVoltDiff_C "" VALUE 0x0000 /* @ECU_Address@MFSM_HighVoltDiff_C@ */ Record_FLOAT32_IEEE 0 McuFunSafeMonitor_CM_single_dash_ 0.000000 3.4E+38 /end CHARACTERISTIC
/begin CHARACTERISTIC MFSM_MaxCosOpenValue_C "" VALUE 0x0000 /* @ECU_Address@MFSM_MaxCosOpenValue_C@ */ Record_FLOAT32_IEEE 0 McuFunSafeMonitor_CM_single_dash_ 0.000000 3.4E+38 /end CHARACTERISTIC
/begin CHARACTERISTIC MFSM_MaxSinOpenValue_C "" VALUE 0x0000 /* @ECU_Address@MFSM_MaxSinOpenValue_C@ */ Record_FLOAT32_IEEE 0 McuFunSafeMonitor_CM_single_dash_ 0.000000 3.4E+38 /end CHARACTERISTIC
/begin CHARACTERISTIC MFSM_MinCosOpenValue_C "" VALUE 0x0000 /* @ECU_Address@MFSM_MinCosOpenValue_C@ */ Record_FLOAT32_IEEE 0 McuFunSafeMonitor_CM_single_dash_ 0.000000 3.4E+38 /end CHARACTERISTIC
/begin CHARACTERISTIC MFSM_MinSinOpenValue_C "" VALUE 0x0000 /* @ECU_Address@MFSM_MinSinOpenValue_C@ */ Record_FLOAT32_IEEE 0 McuFunSafeMonitor_CM_single_dash_ 0.000000 3.4E+38 /end CHARACTERISTIC
/begin CHARACTERISTIC MFSM_MtrEfficiency_M "" CURVE 0x0000 /* @ECU_Address@MFSM_MtrEfficiency_M@ */ Record_FLOAT32_IEEE 0 McuFunSafeMonitor_CM_single_N_per_m -3.4E+38 3.4E+38
 /begin AXIS_DESCR COM_AXIS SGPP_BSW_f32_nRotateSpd_rpm McuFunSafeMonitor_CM_single_Rpm 3 -3.4E+38 3.4E+38 AXIS_PTS_REF MFSM_ElecSpd_A /end AXIS_DESCR
/end CHARACTERISTIC
/begin CHARACTERISTIC MFSM_MtrTempSensorNShortGnd_C "" VALUE 0x0000 /* @ECU_Address@MFSM_MtrTempSensorNShortGnd_C@ */ Record_FLOAT32_IEEE 0 McuFunSafeMonitor_CM_single_dash_ 0.000000 3.4E+38 /end CHARACTERISTIC
/begin CHARACTERISTIC MFSM_MtrTempSensorNShortPwr_C "" VALUE 0x0000 /* @ECU_Address@MFSM_MtrTempSensorNShortPwr_C@ */ Record_FLOAT32_IEEE 0 McuFunSafeMonitor_CM_single_dash_ 0.000000 3.4E+38 /end CHARACTERISTIC
/begin CHARACTERISTIC MFSM_MtrTempSensorPShortGnd_C "" VALUE 0x0000 /* @ECU_Address@MFSM_MtrTempSensorPShortGnd_C@ */ Record_FLOAT32_IEEE 0 McuFunSafeMonitor_CM_single_dash_ 0.000000 3.4E+38 /end CHARACTERISTIC
/begin CHARACTERISTIC MFSM_MtrTempSensorPShortPwr_C "" VALUE 0x0000 /* @ECU_Address@MFSM_MtrTempSensorPShortPwr_C@ */ Record_FLOAT32_IEEE 0 McuFunSafeMonitor_CM_single_dash_ 0.000000 3.4E+38 /end CHARACTERISTIC
/begin CHARACTERISTIC MFSM_MtrTempSensorShortGnd_C "" VALUE 0x0000 /* @ECU_Address@MFSM_MtrTempSensorShortGnd_C@ */ Record_FLOAT32_IEEE 0 McuFunSafeMonitor_CM_single_dash_ 0.000000 3.4E+38 /end CHARACTERISTIC
/begin CHARACTERISTIC MFSM_MtrTempSensorShortPwr_C "" VALUE 0x0000 /* @ECU_Address@MFSM_MtrTempSensorShortPwr_C@ */ Record_FLOAT32_IEEE 0 McuFunSafeMonitor_CM_single_dash_ 0.000000 3.4E+38 /end CHARACTERISTIC
/begin CHARACTERISTIC MFSM_PhaCurrDiffValue_C "" VALUE 0x0000 /* @ECU_Address@MFSM_PhaCurrDiffValue_C@ */ Record_FLOAT32_IEEE 0 McuFunSafeMonitor_CM_single_dash_ 0.000000 3.4E+38 /end CHARACTERISTIC
/begin CHARACTERISTIC MFSM_PhaCurrOpenDiffValue_C "" VALUE 0x0000 /* @ECU_Address@MFSM_PhaCurrOpenDiffValue_C@ */ Record_FLOAT32_IEEE 0 McuFunSafeMonitor_CM_single_dash_ 0.000000 3.4E+38 /end CHARACTERISTIC
/begin CHARACTERISTIC MFSM_PhaCurrOpenValue_C "" VALUE 0x0000 /* @ECU_Address@MFSM_PhaCurrOpenValue_C@ */ Record_FLOAT32_IEEE 0 McuFunSafeMonitor_CM_single_dash_ 0.000000 3.4E+38 /end CHARACTERISTIC
/begin CHARACTERISTIC MFSM_PhaCurrShortGndValue_C "" VALUE 0x0000 /* @ECU_Address@MFSM_PhaCurrShortGndValue_C@ */ Record_FLOAT32_IEEE 0 McuFunSafeMonitor_CM_single_dash_ 0.000000 3.4E+38 /end CHARACTERISTIC
/begin CHARACTERISTIC MFSM_PhaCurrShortPwrValue_C "" VALUE 0x0000 /* @ECU_Address@MFSM_PhaCurrShortPwrValue_C@ */ Record_FLOAT32_IEEE 0 McuFunSafeMonitor_CM_single_dash_ 0.000000 3.4E+38 /end CHARACTERISTIC
/begin CHARACTERISTIC MFSM_SensorVoltDiff_C "" VALUE 0x0000 /* @ECU_Address@MFSM_SensorVoltDiff_C@ */ Record_FLOAT32_IEEE 0 McuFunSafeMonitor_CM_single_dash_ 0.000000 3.4E+38 /end CHARACTERISTIC
/begin CHARACTERISTIC MFSM_SinShortGndValue_C "" VALUE 0x0000 /* @ECU_Address@MFSM_SinShortGndValue_C@ */ Record_FLOAT32_IEEE 0 McuFunSafeMonitor_CM_single_dash_ 0.000000 3.4E+38 /end CHARACTERISTIC
/begin CHARACTERISTIC MFSM_SinShortPwrValue_C "" VALUE 0x0000 /* @ECU_Address@MFSM_SinShortPwrValue_C@ */ Record_FLOAT32_IEEE 0 McuFunSafeMonitor_CM_single_dash_ 0.000000 3.4E+38 /end CHARACTERISTIC
/begin CHARACTERISTIC MFSM_SlowDiagInitTimeCount_C "" VALUE 0x0000 /* @ECU_Address@MFSM_SlowDiagInitTimeCount_C@ */ Record_UWORD 0 McuFunSafeMonitor_CM_uint16_dash_ 0.000000 65535.000000 /end CHARACTERISTIC
/begin CHARACTERISTIC MFSM_TorqueDiff_C "" VALUE 0x0000 /* @ECU_Address@MFSM_TorqueDiff_C@ */ Record_FLOAT32_IEEE 0 McuFunSafeMonitor_CM_single_dash_ 0.000000 3.4E+38 /end CHARACTERISTIC
/begin CHARACTERISTIC MFSM_TorqueFilterFreq_C "" VALUE 0x0000 /* @ECU_Address@MFSM_TorqueFilterFreq_C@ */ Record_FLOAT32_IEEE 0 McuFunSafeMonitor_CM_single_dash_ 0.000000 3.4E+38 /end CHARACTERISTIC
/begin MEASUREMENT IPU_IsgTqActIsgTqAct "" UWORD McuFunSafeMonitor_CM_uint16 0 0 0 65535 ECU_ADDRESS 0x0000 /* @ECU_Address@IPU_IsgTqActIsgTqAct@ */ /end MEASUREMENT
/begin MEASUREMENT MFSM_BusCurDiff "" FLOAT32_IEEE McuFunSafeMonitor_CM_single 0 0 -3.4E+38 3.4E+38 ECU_ADDRESS 0x0000 /* @ECU_Address@MFSM_BusCurDiff@ */ /end MEASUREMENT
/begin MEASUREMENT MFSM_BusCurrentDiffFualt "" UBYTE McuFunSafeMonitor_CM_uint8 0 0 0.000000 1.000000 ECU_ADDRESS 0x0000 /* @ECU_Address@MFSM_BusCurrentDiffFualt@ */ /end MEASUREMENT
/begin MEASUREMENT MFSM_BusCurrentLpfVal "" FLOAT32_IEEE McuFunSafeMonitor_CM_single 0 0 -3.4E+38 3.4E+38 MATRIX_DIM 1 1 ECU_ADDRESS 0x0000 /* @ECU_Address@MFSM_BusCurrentLpfVal@ */ /end MEASUREMENT
/begin MEASUREMENT MFSM_CosDiff "" FLOAT32_IEEE McuFunSafeMonitor_CM_single 0 0 0.000000 3.4E+38 ECU_ADDRESS 0x0000 /* @ECU_Address@MFSM_CosDiff@ */ /end MEASUREMENT
/begin MEASUREMENT MFSM_CosDiffFault "" UBYTE McuFunSafeMonitor_CM_uint8 0 0 0.000000 1.000000 ECU_ADDRESS 0x0000 /* @ECU_Address@MFSM_CosDiffFault@ */ /end MEASUREMENT
/begin MEASUREMENT MFSM_CosNegHigh "" FLOAT32_IEEE McuFunSafeMonitor_CM_single 0 0 -3.4E+38 3.4E+38 ECU_ADDRESS 0x0000 /* @ECU_Address@MFSM_CosNegHigh@ */ /end MEASUREMENT
/begin MEASUREMENT MFSM_CosNegLow "" FLOAT32_IEEE McuFunSafeMonitor_CM_single 0 0 -3.4E+38 3.4E+38 ECU_ADDRESS 0x0000 /* @ECU_Address@MFSM_CosNegLow@ */ /end MEASUREMENT
/begin MEASUREMENT MFSM_CosOpenFault "" UBYTE McuFunSafeMonitor_CM_uint8 0 0 0.000000 1.000000 ECU_ADDRESS 0x0000 /* @ECU_Address@MFSM_CosOpenFault@ */ /end MEASUREMENT
/begin MEASUREMENT MFSM_CosPosHigh "" FLOAT32_IEEE McuFunSafeMonitor_CM_single 0 0 -3.4E+38 3.4E+38 ECU_ADDRESS 0x0000 /* @ECU_Address@MFSM_CosPosHigh@ */ /end MEASUREMENT
/begin MEASUREMENT MFSM_CosPosLow "" FLOAT32_IEEE McuFunSafeMonitor_CM_single 0 0 -3.4E+38 3.4E+38 ECU_ADDRESS 0x0000 /* @ECU_Address@MFSM_CosPosLow@ */ /end MEASUREMENT
/begin MEASUREMENT MFSM_CosShortGndFault "" UBYTE McuFunSafeMonitor_CM_uint8 0 0 0.000000 1.000000 ECU_ADDRESS 0x0000 /* @ECU_Address@MFSM_CosShortGndFault@ */ /end MEASUREMENT
/begin MEASUREMENT MFSM_CosShortPwrFault "" UBYTE McuFunSafeMonitor_CM_uint8 0 0 0.000000 1.000000 ECU_ADDRESS 0x0000 /* @ECU_Address@MFSM_CosShortPwrFault@ */ /end MEASUREMENT
/begin MEASUREMENT MFSM_CosSum "" FLOAT32_IEEE McuFunSafeMonitor_CM_single 0 0 -3.4E+38 3.4E+38 ECU_ADDRESS 0x0000 /* @ECU_Address@MFSM_CosSum@ */ /end MEASUREMENT
/begin MEASUREMENT MFSM_DcVolt "" FLOAT32_IEEE McuFunSafeMonitor_CM_single 0 0 -3.4E+38 3.4E+38 ECU_ADDRESS 0x0000 /* @ECU_Address@MFSM_DcVolt@ */ /end MEASUREMENT
/begin MEASUREMENT MFSM_DcVoltDiff "" FLOAT32_IEEE McuFunSafeMonitor_CM_single 0 0 -3.4E+38 3.4E+38 ECU_ADDRESS 0x0000 /* @ECU_Address@MFSM_DcVoltDiff@ */ /end MEASUREMENT
/begin MEASUREMENT MFSM_ExcAmpAve "" FLOAT32_IEEE McuFunSafeMonitor_CM_single 0 0 -3.4E+38 3.4E+38 ECU_ADDRESS 0x0000 /* @ECU_Address@MFSM_ExcAmpAve@ */ /end MEASUREMENT
/begin MEASUREMENT MFSM_ExcAmpFault "" UBYTE McuFunSafeMonitor_CM_uint8 0 0 0.000000 1.000000 ECU_ADDRESS 0x0000 /* @ECU_Address@MFSM_ExcAmpFault@ */ /end MEASUREMENT
/begin MEASUREMENT MFSM_ExcAveVal "" FLOAT32_IEEE McuFunSafeMonitor_CM_single 0 0 -3.4E+38 3.4E+38 ECU_ADDRESS 0x0000 /* @ECU_Address@MFSM_ExcAveVal@ */ /end MEASUREMENT
/begin MEASUREMENT MFSM_ExcDiffHigh "" FLOAT32_IEEE McuFunSafeMonitor_CM_single 0 0 -3.4E+38 3.4E+38 ECU_ADDRESS 0x0000 /* @ECU_Address@MFSM_ExcDiffHigh@ */ /end MEASUREMENT
/begin MEASUREMENT MFSM_ExcDiffLow "" FLOAT32_IEEE McuFunSafeMonitor_CM_single 0 0 -3.4E+38 3.4E+38 ECU_ADDRESS 0x0000 /* @ECU_Address@MFSM_ExcDiffLow@ */ /end MEASUREMENT
/begin MEASUREMENT MFSM_ExcNegHigh "" FLOAT32_IEEE McuFunSafeMonitor_CM_single 0 0 -3.4E+38 3.4E+38 ECU_ADDRESS 0x0000 /* @ECU_Address@MFSM_ExcNegHigh@ */ /end MEASUREMENT
/begin MEASUREMENT MFSM_ExcNegLow "" FLOAT32_IEEE McuFunSafeMonitor_CM_single 0 0 -3.4E+38 3.4E+38 ECU_ADDRESS 0x0000 /* @ECU_Address@MFSM_ExcNegLow@ */ /end MEASUREMENT
/begin MEASUREMENT MFSM_ExcOpenFault "" UBYTE McuFunSafeMonitor_CM_uint8 0 0 0.000000 1.000000 ECU_ADDRESS 0x0000 /* @ECU_Address@MFSM_ExcOpenFault@ */ /end MEASUREMENT
/begin MEASUREMENT MFSM_ExcPosHigh "" FLOAT32_IEEE McuFunSafeMonitor_CM_single 0 0 -3.4E+38 3.4E+38 ECU_ADDRESS 0x0000 /* @ECU_Address@MFSM_ExcPosHigh@ */ /end MEASUREMENT
/begin MEASUREMENT MFSM_ExcPosLow "" FLOAT32_IEEE McuFunSafeMonitor_CM_single 0 0 -3.4E+38 3.4E+38 ECU_ADDRESS 0x0000 /* @ECU_Address@MFSM_ExcPosLow@ */ /end MEASUREMENT
/begin MEASUREMENT MFSM_ExcShortGndFault "" UBYTE McuFunSafeMonitor_CM_uint8 0 0 0.000000 1.000000 ECU_ADDRESS 0x0000 /* @ECU_Address@MFSM_ExcShortGndFault@ */ /end MEASUREMENT
/begin MEASUREMENT MFSM_ExcShortPwrFault "" UBYTE McuFunSafeMonitor_CM_uint8 0 0 0.000000 1.000000 ECU_ADDRESS 0x0000 /* @ECU_Address@MFSM_ExcShortPwrFault@ */ /end MEASUREMENT
/begin MEASUREMENT MFSM_ExcShortPwr_Max "" FLOAT32_IEEE McuFunSafeMonitor_CM_single 0 0 -3.4E+38 3.4E+38 ECU_ADDRESS 0x0000 /* @ECU_Address@MFSM_ExcShortPwr_Max@ */ /end MEASUREMENT
/begin MEASUREMENT MFSM_ExcShortPwr_Min "" FLOAT32_IEEE McuFunSafeMonitor_CM_single 0 0 -3.4E+38 3.4E+38 ECU_ADDRESS 0x0000 /* @ECU_Address@MFSM_ExcShortPwr_Min@ */ /end MEASUREMENT
/begin MEASUREMENT MFSM_FunSafetyTorque "" FLOAT32_IEEE McuFunSafeMonitor_CM_single 0 0 -3.4E+38 3.4E+38 ECU_ADDRESS 0x0000 /* @ECU_Address@MFSM_FunSafetyTorque@ */ /end MEASUREMENT
/begin MEASUREMENT MFSM_HighVoltFault "" UBYTE McuFunSafeMonitor_CM_uint8 0 0 0.000000 1.000000 ECU_ADDRESS 0x0000 /* @ECU_Address@MFSM_HighVoltFault@ */ /end MEASUREMENT
/begin MEASUREMENT MFSM_MtrTempFault "" UBYTE McuFunSafeMonitor_CM_uint8 0 0 0.000000 1.000000 ECU_ADDRESS 0x0000 /* @ECU_Address@MFSM_MtrTempFault@ */ /end MEASUREMENT
/begin MEASUREMENT MFSM_MtrTempNVolt "" FLOAT32_IEEE McuFunSafeMonitor_CM_single 0 0 0.000000 3.4E+38 ECU_ADDRESS 0x0000 /* @ECU_Address@MFSM_MtrTempNVolt@ */ /end MEASUREMENT
/begin MEASUREMENT MFSM_MtrTempPVolt "" FLOAT32_IEEE McuFunSafeMonitor_CM_single 0 0 0.000000 3.4E+38 ECU_ADDRESS 0x0000 /* @ECU_Address@MFSM_MtrTempPVolt@ */ /end MEASUREMENT
/begin MEASUREMENT MFSM_MtrTempShortGndFault "" UBYTE McuFunSafeMonitor_CM_uint8 0 0 0.000000 1.000000 ECU_ADDRESS 0x0000 /* @ECU_Address@MFSM_MtrTempShortGndFault@ */ /end MEASUREMENT
/begin MEASUREMENT MFSM_MtrTempShortPwrFault "" UBYTE McuFunSafeMonitor_CM_uint8 0 0 0.000000 1.000000 ECU_ADDRESS 0x0000 /* @ECU_Address@MFSM_MtrTempShortPwrFault@ */ /end MEASUREMENT
/begin MEASUREMENT MFSM_PhaCurrDiffFault "" UBYTE McuFunSafeMonitor_CM_uint8 0 0 0.000000 1.000000 ECU_ADDRESS 0x0000 /* @ECU_Address@MFSM_PhaCurrDiffFault@ */ /end MEASUREMENT
/begin MEASUREMENT MFSM_PhaCurrOpenFault "" UBYTE McuFunSafeMonitor_CM_uint8 0 0 0.000000 1.000000 ECU_ADDRESS 0x0000 /* @ECU_Address@MFSM_PhaCurrOpenFault@ */ /end MEASUREMENT
/begin MEASUREMENT MFSM_PhaCurrShortGndFault "" UBYTE McuFunSafeMonitor_CM_uint8 0 0 0.000000 1.000000 ECU_ADDRESS 0x0000 /* @ECU_Address@MFSM_PhaCurrShortGndFault@ */ /end MEASUREMENT
/begin MEASUREMENT MFSM_PhaCurrShortPwrFault "" UBYTE McuFunSafeMonitor_CM_uint8 0 0 0.000000 1.000000 ECU_ADDRESS 0x0000 /* @ECU_Address@MFSM_PhaCurrShortPwrFault@ */ /end MEASUREMENT
/begin MEASUREMENT MFSM_PhaseA "" FLOAT32_IEEE McuFunSafeMonitor_CM_single 0 0 -3.4E+38 3.4E+38 ECU_ADDRESS 0x0000 /* @ECU_Address@MFSM_PhaseA@ */ /end MEASUREMENT
/begin MEASUREMENT MFSM_PhaseACurrentDiff "" FLOAT32_IEEE McuFunSafeMonitor_CM_single 0 0 -3.4E+38 3.4E+38 ECU_ADDRESS 0x0000 /* @ECU_Address@MFSM_PhaseACurrentDiff@ */ /end MEASUREMENT
/begin MEASUREMENT MFSM_PhaseADiff "" FLOAT32_IEEE McuFunSafeMonitor_CM_single 0 0 -3.4E+38 3.4E+38 ECU_ADDRESS 0x0000 /* @ECU_Address@MFSM_PhaseADiff@ */ /end MEASUREMENT
/begin MEASUREMENT MFSM_PhaseBCurrent "" FLOAT32_IEEE McuFunSafeMonitor_CM_single 0 0 -3.4E+38 3.4E+38 ECU_ADDRESS 0x0000 /* @ECU_Address@MFSM_PhaseBCurrent@ */ /end MEASUREMENT
/begin MEASUREMENT MFSM_PhaseC "" FLOAT32_IEEE McuFunSafeMonitor_CM_single 0 0 -3.4E+38 3.4E+38 ECU_ADDRESS 0x0000 /* @ECU_Address@MFSM_PhaseC@ */ /end MEASUREMENT
/begin MEASUREMENT MFSM_PhaseCCurrentDiff "" FLOAT32_IEEE McuFunSafeMonitor_CM_single 0 0 -3.4E+38 3.4E+38 ECU_ADDRESS 0x0000 /* @ECU_Address@MFSM_PhaseCCurrentDiff@ */ /end MEASUREMENT
/begin MEASUREMENT MFSM_PhaseCDiff "" FLOAT32_IEEE McuFunSafeMonitor_CM_single 0 0 -3.4E+38 3.4E+38 ECU_ADDRESS 0x0000 /* @ECU_Address@MFSM_PhaseCDiff@ */ /end MEASUREMENT
/begin MEASUREMENT MFSM_PwrChipVoltDiff "" FLOAT32_IEEE McuFunSafeMonitor_CM_single 0 0 0.000000 3.4E+38 ECU_ADDRESS 0x0000 /* @ECU_Address@MFSM_PwrChipVoltDiff@ */ /end MEASUREMENT
/begin MEASUREMENT MFSM_PwrChipVoltValue "" FLOAT32_IEEE McuFunSafeMonitor_CM_single 0 0 0.000000 3.4E+38 ECU_ADDRESS 0x0000 /* @ECU_Address@MFSM_PwrChipVoltValue@ */ /end MEASUREMENT
/begin MEASUREMENT MFSM_RslvrAmpFault "" UBYTE McuFunSafeMonitor_CM_uint8 0 0 0.000000 1.000000 ECU_ADDRESS 0x0000 /* @ECU_Address@MFSM_RslvrAmpFault@ */ /end MEASUREMENT
/begin MEASUREMENT MFSM_RslvrAmpSum "" FLOAT32_IEEE McuFunSafeMonitor_CM_single 0 0 -3.4E+38 3.4E+38 ECU_ADDRESS 0x0000 /* @ECU_Address@MFSM_RslvrAmpSum@ */ /end MEASUREMENT
/begin MEASUREMENT MFSM_SensorVoltFault "" UBYTE McuFunSafeMonitor_CM_uint8 0 0 0.000000 1.000000 ECU_ADDRESS 0x0000 /* @ECU_Address@MFSM_SensorVoltFault@ */ /end MEASUREMENT
/begin MEASUREMENT MFSM_SinDiff "" FLOAT32_IEEE McuFunSafeMonitor_CM_single 0 0 -3.4E+38 3.4E+38 ECU_ADDRESS 0x0000 /* @ECU_Address@MFSM_SinDiff@ */ /end MEASUREMENT
/begin MEASUREMENT MFSM_SinNegHigh "" FLOAT32_IEEE McuFunSafeMonitor_CM_single 0 0 -3.4E+38 3.4E+38 ECU_ADDRESS 0x0000 /* @ECU_Address@MFSM_SinNegHigh@ */ /end MEASUREMENT
/begin MEASUREMENT MFSM_SinNegLow "" FLOAT32_IEEE McuFunSafeMonitor_CM_single 0 0 -3.4E+38 3.4E+38 ECU_ADDRESS 0x0000 /* @ECU_Address@MFSM_SinNegLow@ */ /end MEASUREMENT
/begin MEASUREMENT MFSM_SinOpenFault "" UBYTE McuFunSafeMonitor_CM_uint8 0 0 0.000000 1.000000 ECU_ADDRESS 0x0000 /* @ECU_Address@MFSM_SinOpenFault@ */ /end MEASUREMENT
/begin MEASUREMENT MFSM_SinPosHigh "" FLOAT32_IEEE McuFunSafeMonitor_CM_single 0 0 -3.4E+38 3.4E+38 ECU_ADDRESS 0x0000 /* @ECU_Address@MFSM_SinPosHigh@ */ /end MEASUREMENT
/begin MEASUREMENT MFSM_SinPosLow "" FLOAT32_IEEE McuFunSafeMonitor_CM_single 0 0 -3.4E+38 3.4E+38 ECU_ADDRESS 0x0000 /* @ECU_Address@MFSM_SinPosLow@ */ /end MEASUREMENT
/begin MEASUREMENT MFSM_SinShortGndFault "" UBYTE McuFunSafeMonitor_CM_uint8 0 0 0.000000 1.000000 ECU_ADDRESS 0x0000 /* @ECU_Address@MFSM_SinShortGndFault@ */ /end MEASUREMENT
/begin MEASUREMENT MFSM_SinShortPwrFault "" UBYTE McuFunSafeMonitor_CM_uint8 0 0 0.000000 1.000000 ECU_ADDRESS 0x0000 /* @ECU_Address@MFSM_SinShortPwrFault@ */ /end MEASUREMENT
/begin MEASUREMENT MFSM_SinSum "" FLOAT32_IEEE McuFunSafeMonitor_CM_single 0 0 -3.4E+38 3.4E+38 ECU_ADDRESS 0x0000 /* @ECU_Address@MFSM_SinSum@ */ /end MEASUREMENT
/begin MEASUREMENT MFSM_SineDiffFault "" UBYTE McuFunSafeMonitor_CM_uint8 0 0 0.000000 1.000000 ECU_ADDRESS 0x0000 /* @ECU_Address@MFSM_SineDiffFault@ */ /end MEASUREMENT
/begin MEASUREMENT MFSM_TqDiff "" FLOAT32_IEEE McuFunSafeMonitor_CM_single 0 0 0.000000 3.4E+38 ECU_ADDRESS 0x0000 /* @ECU_Address@MFSM_TqDiff@ */ /end MEASUREMENT
/begin MEASUREMENT MFSM_TqDiffFualt "" UBYTE McuFunSafeMonitor_CM_uint8 0 0 0.000000 1.000000 ECU_ADDRESS 0x0000 /* @ECU_Address@MFSM_TqDiffFualt@ */ /end MEASUREMENT
/begin MEASUREMENT McuFunSafeMonitor_B.Add1 "" FLOAT32_IEEE McuFunSafeMonitor_CM_single 0 0 -3.4E+38 3.4E+38 MATRIX_DIM 1 1 ECU_ADDRESS 0x0000 /* @ECU_Address@McuFunSafeMonitor_B.Add1@ */ /end MEASUREMENT
/begin MEASUREMENT McuFunSafeMonitor_B.DataTypeConversion "" UBYTE McuFunSafeMonitor_CM_uint8 0 0 0 255 ECU_ADDRESS 0x0000 /* @ECU_Address@McuFunSafeMonitor_B.DataTypeConversion@ */ /end MEASUREMENT
/begin MEASUREMENT McuFunSafeMonitor_B.DataTypeConversion_c "" UBYTE McuFunSafeMonitor_CM_uint8 0 0 0 255 ECU_ADDRESS 0x0000 /* @ECU_Address@McuFunSafeMonitor_B.DataTypeConversion_c@ */ /end MEASUREMENT
/begin MEASUREMENT McuFunSafeMonitor_B.DataTypeConversion_c3 "" UBYTE McuFunSafeMonitor_CM_uint8 0 0 0 255 ECU_ADDRESS 0x0000 /* @ECU_Address@McuFunSafeMonitor_B.DataTypeConversion_c3@ */ /end MEASUREMENT
/begin MEASUREMENT McuFunSafeMonitor_B.DataTypeConversion_cs "" UBYTE McuFunSafeMonitor_CM_uint8 0 0 0 255 ECU_ADDRESS 0x0000 /* @ECU_Address@McuFunSafeMonitor_B.DataTypeConversion_cs@ */ /end MEASUREMENT
/begin MEASUREMENT McuFunSafeMonitor_B.DataTypeConversion_d "" UBYTE McuFunSafeMonitor_CM_uint8 0 0 0 255 ECU_ADDRESS 0x0000 /* @ECU_Address@McuFunSafeMonitor_B.DataTypeConversion_d@ */ /end MEASUREMENT
/begin MEASUREMENT McuFunSafeMonitor_B.DataTypeConversion_dg "" UBYTE McuFunSafeMonitor_CM_uint8 0 0 0 255 ECU_ADDRESS 0x0000 /* @ECU_Address@McuFunSafeMonitor_B.DataTypeConversion_dg@ */ /end MEASUREMENT
/begin MEASUREMENT McuFunSafeMonitor_B.DataTypeConversion_dm "" UBYTE McuFunSafeMonitor_CM_uint8 0 0 0 255 ECU_ADDRESS 0x0000 /* @ECU_Address@McuFunSafeMonitor_B.DataTypeConversion_dm@ */ /end MEASUREMENT
/begin MEASUREMENT McuFunSafeMonitor_B.DataTypeConversion_e "" UBYTE McuFunSafeMonitor_CM_uint8 0 0 0 255 ECU_ADDRESS 0x0000 /* @ECU_Address@McuFunSafeMonitor_B.DataTypeConversion_e@ */ /end MEASUREMENT
/begin MEASUREMENT McuFunSafeMonitor_B.DataTypeConversion_eb "" UBYTE McuFunSafeMonitor_CM_uint8 0 0 0 255 ECU_ADDRESS 0x0000 /* @ECU_Address@McuFunSafeMonitor_B.DataTypeConversion_eb@ */ /end MEASUREMENT
/begin MEASUREMENT McuFunSafeMonitor_B.DataTypeConversion_ee "" UBYTE McuFunSafeMonitor_CM_uint8 0 0 0 255 ECU_ADDRESS 0x0000 /* @ECU_Address@McuFunSafeMonitor_B.DataTypeConversion_ee@ */ /end MEASUREMENT
/begin MEASUREMENT McuFunSafeMonitor_B.DataTypeConversion_f "" UBYTE McuFunSafeMonitor_CM_uint8 0 0 0 255 ECU_ADDRESS 0x0000 /* @ECU_Address@McuFunSafeMonitor_B.DataTypeConversion_f@ */ /end MEASUREMENT
/begin MEASUREMENT McuFunSafeMonitor_B.DataTypeConversion_fo "" UBYTE McuFunSafeMonitor_CM_uint8 0 0 0 255 ECU_ADDRESS 0x0000 /* @ECU_Address@McuFunSafeMonitor_B.DataTypeConversion_fo@ */ /end MEASUREMENT
/begin MEASUREMENT McuFunSafeMonitor_B.DataTypeConversion_j "" UBYTE McuFunSafeMonitor_CM_uint8 0 0 0 255 ECU_ADDRESS 0x0000 /* @ECU_Address@McuFunSafeMonitor_B.DataTypeConversion_j@ */ /end MEASUREMENT
/begin MEASUREMENT McuFunSafeMonitor_B.DataTypeConversion_l "" UBYTE McuFunSafeMonitor_CM_uint8 0 0 0 255 ECU_ADDRESS 0x0000 /* @ECU_Address@McuFunSafeMonitor_B.DataTypeConversion_l@ */ /end MEASUREMENT
/begin MEASUREMENT McuFunSafeMonitor_B.DataTypeConversion_ld "" UBYTE McuFunSafeMonitor_CM_uint8 0 0 0 255 ECU_ADDRESS 0x0000 /* @ECU_Address@McuFunSafeMonitor_B.DataTypeConversion_ld@ */ /end MEASUREMENT
/begin MEASUREMENT McuFunSafeMonitor_B.DataTypeConversion_lp "" UBYTE McuFunSafeMonitor_CM_uint8 0 0 0 255 ECU_ADDRESS 0x0000 /* @ECU_Address@McuFunSafeMonitor_B.DataTypeConversion_lp@ */ /end MEASUREMENT
/begin MEASUREMENT McuFunSafeMonitor_B.DataTypeConversion_m "" UBYTE McuFunSafeMonitor_CM_uint8 0 0 0 255 ECU_ADDRESS 0x0000 /* @ECU_Address@McuFunSafeMonitor_B.DataTypeConversion_m@ */ /end MEASUREMENT
/begin MEASUREMENT McuFunSafeMonitor_B.DataTypeConversion_n "" UBYTE McuFunSafeMonitor_CM_uint8 0 0 0 255 ECU_ADDRESS 0x0000 /* @ECU_Address@McuFunSafeMonitor_B.DataTypeConversion_n@ */ /end MEASUREMENT
/begin MEASUREMENT McuFunSafeMonitor_B.DataTypeConversion_o "" UBYTE McuFunSafeMonitor_CM_uint8 0 0 0 255 ECU_ADDRESS 0x0000 /* @ECU_Address@McuFunSafeMonitor_B.DataTypeConversion_o@ */ /end MEASUREMENT
/begin MEASUREMENT McuFunSafeMonitor_B.DataTypeConversion_oi "" UBYTE McuFunSafeMonitor_CM_uint8 0 0 0 255 ECU_ADDRESS 0x0000 /* @ECU_Address@McuFunSafeMonitor_B.DataTypeConversion_oi@ */ /end MEASUREMENT
/begin MEASUREMENT McuFunSafeMonitor_B.DataTypeConversion_p "" UBYTE McuFunSafeMonitor_CM_uint8 0 0 0 255 ECU_ADDRESS 0x0000 /* @ECU_Address@McuFunSafeMonitor_B.DataTypeConversion_p@ */ /end MEASUREMENT
/begin MEASUREMENT McuFunSafeMonitor_B.DataTypeConversion_p0 "" UBYTE McuFunSafeMonitor_CM_uint8 0 0 0 255 ECU_ADDRESS 0x0000 /* @ECU_Address@McuFunSafeMonitor_B.DataTypeConversion_p0@ */ /end MEASUREMENT
/begin MEASUREMENT McuFunSafeMonitor_B.OutportBufferForMFSM_CosDiffFault "" UBYTE McuFunSafeMonitor_CM_uint8 0 0 0 255 ECU_ADDRESS 0x0000 /* @ECU_Address@McuFunSafeMonitor_B.OutportBufferForMFSM_CosDiffFault@ */ /end MEASUREMENT
/begin MEASUREMENT McuFunSafeMonitor_B.OutportBufferForMFSM_SineDiffFault "" UBYTE McuFunSafeMonitor_CM_uint8 0 0 0 255 ECU_ADDRESS 0x0000 /* @ECU_Address@McuFunSafeMonitor_B.OutportBufferForMFSM_SineDiffFault@ */ /end MEASUREMENT
/begin MEASUREMENT McuFunSafeMonitor_DW.BareUnitDelay_DSTATE "" UBYTE McuFunSafeMonitor_CM_uint8 0 0 0 255 ECU_ADDRESS 0x0000 /* @ECU_Address@McuFunSafeMonitor_DW.BareUnitDelay_DSTATE@ */ /end MEASUREMENT
/begin MEASUREMENT McuFunSafeMonitor_DW.BareUnitDelay_DSTATE_a "" UBYTE McuFunSafeMonitor_CM_uint8 0 0 0 255 ECU_ADDRESS 0x0000 /* @ECU_Address@McuFunSafeMonitor_DW.BareUnitDelay_DSTATE_a@ */ /end MEASUREMENT
/begin MEASUREMENT McuFunSafeMonitor_DW.BareUnitDelay_DSTATE_b "" UBYTE McuFunSafeMonitor_CM_uint8 0 0 0 255 ECU_ADDRESS 0x0000 /* @ECU_Address@McuFunSafeMonitor_DW.BareUnitDelay_DSTATE_b@ */ /end MEASUREMENT
/begin MEASUREMENT McuFunSafeMonitor_DW.BareUnitDelay_DSTATE_d "" UBYTE McuFunSafeMonitor_CM_uint8 0 0 0 255 ECU_ADDRESS 0x0000 /* @ECU_Address@McuFunSafeMonitor_DW.BareUnitDelay_DSTATE_d@ */ /end MEASUREMENT
/begin MEASUREMENT McuFunSafeMonitor_DW.BareUnitDelay_DSTATE_e "" UBYTE McuFunSafeMonitor_CM_uint8 0 0 0 255 ECU_ADDRESS 0x0000 /* @ECU_Address@McuFunSafeMonitor_DW.BareUnitDelay_DSTATE_e@ */ /end MEASUREMENT
/begin MEASUREMENT McuFunSafeMonitor_DW.BareUnitDelay_DSTATE_h "" UBYTE McuFunSafeMonitor_CM_uint8 0 0 0 255 ECU_ADDRESS 0x0000 /* @ECU_Address@McuFunSafeMonitor_DW.BareUnitDelay_DSTATE_h@ */ /end MEASUREMENT
/begin MEASUREMENT McuFunSafeMonitor_DW.BareUnitDelay_DSTATE_hu "" UBYTE McuFunSafeMonitor_CM_uint8 0 0 0 255 ECU_ADDRESS 0x0000 /* @ECU_Address@McuFunSafeMonitor_DW.BareUnitDelay_DSTATE_hu@ */ /end MEASUREMENT
/begin MEASUREMENT McuFunSafeMonitor_DW.BareUnitDelay_DSTATE_j "" UBYTE McuFunSafeMonitor_CM_uint8 0 0 0 255 ECU_ADDRESS 0x0000 /* @ECU_Address@McuFunSafeMonitor_DW.BareUnitDelay_DSTATE_j@ */ /end MEASUREMENT
/begin MEASUREMENT McuFunSafeMonitor_DW.BareUnitDelay_DSTATE_jy "" UBYTE McuFunSafeMonitor_CM_uint8 0 0 0 255 ECU_ADDRESS 0x0000 /* @ECU_Address@McuFunSafeMonitor_DW.BareUnitDelay_DSTATE_jy@ */ /end MEASUREMENT
/begin MEASUREMENT McuFunSafeMonitor_DW.BareUnitDelay_DSTATE_k "" UBYTE McuFunSafeMonitor_CM_uint8 0 0 0 255 ECU_ADDRESS 0x0000 /* @ECU_Address@McuFunSafeMonitor_DW.BareUnitDelay_DSTATE_k@ */ /end MEASUREMENT
/begin MEASUREMENT McuFunSafeMonitor_DW.BareUnitDelay_DSTATE_k3 "" UBYTE McuFunSafeMonitor_CM_uint8 0 0 0 255 ECU_ADDRESS 0x0000 /* @ECU_Address@McuFunSafeMonitor_DW.BareUnitDelay_DSTATE_k3@ */ /end MEASUREMENT
/begin MEASUREMENT McuFunSafeMonitor_DW.BareUnitDelay_DSTATE_kb "" UBYTE McuFunSafeMonitor_CM_uint8 0 0 0 255 ECU_ADDRESS 0x0000 /* @ECU_Address@McuFunSafeMonitor_DW.BareUnitDelay_DSTATE_kb@ */ /end MEASUREMENT
/begin MEASUREMENT McuFunSafeMonitor_DW.BareUnitDelay_DSTATE_l "" UBYTE McuFunSafeMonitor_CM_uint8 0 0 0 255 ECU_ADDRESS 0x0000 /* @ECU_Address@McuFunSafeMonitor_DW.BareUnitDelay_DSTATE_l@ */ /end MEASUREMENT
/begin MEASUREMENT McuFunSafeMonitor_DW.BareUnitDelay_DSTATE_lf "" UBYTE McuFunSafeMonitor_CM_uint8 0 0 0 255 ECU_ADDRESS 0x0000 /* @ECU_Address@McuFunSafeMonitor_DW.BareUnitDelay_DSTATE_lf@ */ /end MEASUREMENT
/begin MEASUREMENT McuFunSafeMonitor_DW.BareUnitDelay_DSTATE_m "" UBYTE McuFunSafeMonitor_CM_uint8 0 0 0 255 ECU_ADDRESS 0x0000 /* @ECU_Address@McuFunSafeMonitor_DW.BareUnitDelay_DSTATE_m@ */ /end MEASUREMENT
/begin MEASUREMENT McuFunSafeMonitor_DW.BareUnitDelay_DSTATE_md "" UBYTE McuFunSafeMonitor_CM_uint8 0 0 0 255 ECU_ADDRESS 0x0000 /* @ECU_Address@McuFunSafeMonitor_DW.BareUnitDelay_DSTATE_md@ */ /end MEASUREMENT
/begin MEASUREMENT McuFunSafeMonitor_DW.BareUnitDelay_DSTATE_n "" UBYTE McuFunSafeMonitor_CM_uint8 0 0 0 255 ECU_ADDRESS 0x0000 /* @ECU_Address@McuFunSafeMonitor_DW.BareUnitDelay_DSTATE_n@ */ /end MEASUREMENT
/begin MEASUREMENT McuFunSafeMonitor_DW.BareUnitDelay_DSTATE_n5 "" UBYTE McuFunSafeMonitor_CM_uint8 0 0 0 255 ECU_ADDRESS 0x0000 /* @ECU_Address@McuFunSafeMonitor_DW.BareUnitDelay_DSTATE_n5@ */ /end MEASUREMENT
/begin MEASUREMENT McuFunSafeMonitor_DW.BareUnitDelay_DSTATE_o "" UBYTE McuFunSafeMonitor_CM_uint8 0 0 0 255 ECU_ADDRESS 0x0000 /* @ECU_Address@McuFunSafeMonitor_DW.BareUnitDelay_DSTATE_o@ */ /end MEASUREMENT
/begin MEASUREMENT McuFunSafeMonitor_DW.BareUnitDelay_DSTATE_ov "" UBYTE McuFunSafeMonitor_CM_uint8 0 0 0 255 ECU_ADDRESS 0x0000 /* @ECU_Address@McuFunSafeMonitor_DW.BareUnitDelay_DSTATE_ov@ */ /end MEASUREMENT
/begin MEASUREMENT McuFunSafeMonitor_DW.BareUnitDelay_DSTATE_p "" UBYTE McuFunSafeMonitor_CM_uint8 0 0 0 255 ECU_ADDRESS 0x0000 /* @ECU_Address@McuFunSafeMonitor_DW.BareUnitDelay_DSTATE_p@ */ /end MEASUREMENT
/begin MEASUREMENT McuFunSafeMonitor_DW.BareUnitDelay_DSTATE_pa "" UBYTE McuFunSafeMonitor_CM_uint8 0 0 0 255 ECU_ADDRESS 0x0000 /* @ECU_Address@McuFunSafeMonitor_DW.BareUnitDelay_DSTATE_pa@ */ /end MEASUREMENT
/begin MEASUREMENT McuFunSafeMonitor_DW.Delay1_DSTATE "" FLOAT32_IEEE McuFunSafeMonitor_CM_single 0 0 -3.4E+38 3.4E+38 ECU_ADDRESS 0x0000 /* @ECU_Address@McuFunSafeMonitor_DW.Delay1_DSTATE@ */ /end MEASUREMENT
/begin MEASUREMENT McuFunSafeMonitor_DW.Delay2_DSTATE "" FLOAT32_IEEE McuFunSafeMonitor_CM_single 0 0 -3.4E+38 3.4E+38 ECU_ADDRESS 0x0000 /* @ECU_Address@McuFunSafeMonitor_DW.Delay2_DSTATE@ */ /end MEASUREMENT
/begin MEASUREMENT McuFunSafeMonitor_DW.Delay_DSTATE "" FLOAT32_IEEE McuFunSafeMonitor_CM_single 0 0 -3.4E+38 3.4E+38 ECU_ADDRESS 0x0000 /* @ECU_Address@McuFunSafeMonitor_DW.Delay_DSTATE@ */ /end MEASUREMENT
/begin MEASUREMENT McuFunSafeMonitor_DW.Delay_DSTATE_b "" FLOAT32_IEEE McuFunSafeMonitor_CM_single 0 0 -3.4E+38 3.4E+38 ECU_ADDRESS 0x0000 /* @ECU_Address@McuFunSafeMonitor_DW.Delay_DSTATE_b@ */ /end MEASUREMENT
/begin MEASUREMENT McuFunSafeMonitor_DW.Delay_DSTATE_h "" FLOAT32_IEEE McuFunSafeMonitor_CM_single 0 0 -3.4E+38 3.4E+38 ECU_ADDRESS 0x0000 /* @ECU_Address@McuFunSafeMonitor_DW.Delay_DSTATE_h@ */ /end MEASUREMENT
/begin MEASUREMENT McuFunSafeMonitor_DW.Memory_PreviousInput "" UBYTE McuFunSafeMonitor_CM_logical 0 0 0 1 ECU_ADDRESS 0x0000 /* @ECU_Address@McuFunSafeMonitor_DW.Memory_PreviousInput@ */ /end MEASUREMENT
/begin MEASUREMENT McuFunSafeMonitor_DW.Memory_PreviousInput_b "" UBYTE McuFunSafeMonitor_CM_logical 0 0 0 1 ECU_ADDRESS 0x0000 /* @ECU_Address@McuFunSafeMonitor_DW.Memory_PreviousInput_b@ */ /end MEASUREMENT
/begin MEASUREMENT McuFunSafeMonitor_DW.Memory_PreviousInput_c "" UBYTE McuFunSafeMonitor_CM_logical 0 0 0 1 ECU_ADDRESS 0x0000 /* @ECU_Address@McuFunSafeMonitor_DW.Memory_PreviousInput_c@ */ /end MEASUREMENT
/begin MEASUREMENT McuFunSafeMonitor_DW.Memory_PreviousInput_c3 "" UBYTE McuFunSafeMonitor_CM_logical 0 0 0 1 ECU_ADDRESS 0x0000 /* @ECU_Address@McuFunSafeMonitor_DW.Memory_PreviousInput_c3@ */ /end MEASUREMENT
/begin MEASUREMENT McuFunSafeMonitor_DW.Memory_PreviousInput_d "" UBYTE McuFunSafeMonitor_CM_logical 0 0 0 1 ECU_ADDRESS 0x0000 /* @ECU_Address@McuFunSafeMonitor_DW.Memory_PreviousInput_d@ */ /end MEASUREMENT
/begin MEASUREMENT McuFunSafeMonitor_DW.Memory_PreviousInput_e "" UBYTE McuFunSafeMonitor_CM_logical 0 0 0 1 ECU_ADDRESS 0x0000 /* @ECU_Address@McuFunSafeMonitor_DW.Memory_PreviousInput_e@ */ /end MEASUREMENT
/begin MEASUREMENT McuFunSafeMonitor_DW.Memory_PreviousInput_eb "" UBYTE McuFunSafeMonitor_CM_logical 0 0 0 1 ECU_ADDRESS 0x0000 /* @ECU_Address@McuFunSafeMonitor_DW.Memory_PreviousInput_eb@ */ /end MEASUREMENT
/begin MEASUREMENT McuFunSafeMonitor_DW.Memory_PreviousInput_f "" UBYTE McuFunSafeMonitor_CM_logical 0 0 0 1 ECU_ADDRESS 0x0000 /* @ECU_Address@McuFunSafeMonitor_DW.Memory_PreviousInput_f@ */ /end MEASUREMENT
/begin MEASUREMENT McuFunSafeMonitor_DW.Memory_PreviousInput_fa "" UBYTE McuFunSafeMonitor_CM_logical 0 0 0 1 ECU_ADDRESS 0x0000 /* @ECU_Address@McuFunSafeMonitor_DW.Memory_PreviousInput_fa@ */ /end MEASUREMENT
/begin MEASUREMENT McuFunSafeMonitor_DW.Memory_PreviousInput_fx "" UBYTE McuFunSafeMonitor_CM_logical 0 0 0 1 ECU_ADDRESS 0x0000 /* @ECU_Address@McuFunSafeMonitor_DW.Memory_PreviousInput_fx@ */ /end MEASUREMENT
/begin MEASUREMENT McuFunSafeMonitor_DW.Memory_PreviousInput_g "" UBYTE McuFunSafeMonitor_CM_logical 0 0 0 1 ECU_ADDRESS 0x0000 /* @ECU_Address@McuFunSafeMonitor_DW.Memory_PreviousInput_g@ */ /end MEASUREMENT
/begin MEASUREMENT McuFunSafeMonitor_DW.Memory_PreviousInput_h "" UBYTE McuFunSafeMonitor_CM_logical 0 0 0 1 ECU_ADDRESS 0x0000 /* @ECU_Address@McuFunSafeMonitor_DW.Memory_PreviousInput_h@ */ /end MEASUREMENT
/begin MEASUREMENT McuFunSafeMonitor_DW.Memory_PreviousInput_hq "" UBYTE McuFunSafeMonitor_CM_logical 0 0 0 1 ECU_ADDRESS 0x0000 /* @ECU_Address@McuFunSafeMonitor_DW.Memory_PreviousInput_hq@ */ /end MEASUREMENT
/begin MEASUREMENT McuFunSafeMonitor_DW.Memory_PreviousInput_i "" UBYTE McuFunSafeMonitor_CM_logical 0 0 0 1 ECU_ADDRESS 0x0000 /* @ECU_Address@McuFunSafeMonitor_DW.Memory_PreviousInput_i@ */ /end MEASUREMENT
/begin MEASUREMENT McuFunSafeMonitor_DW.Memory_PreviousInput_ig "" UBYTE McuFunSafeMonitor_CM_logical 0 0 0 1 ECU_ADDRESS 0x0000 /* @ECU_Address@McuFunSafeMonitor_DW.Memory_PreviousInput_ig@ */ /end MEASUREMENT
/begin MEASUREMENT McuFunSafeMonitor_DW.Memory_PreviousInput_k "" UBYTE McuFunSafeMonitor_CM_logical 0 0 0 1 ECU_ADDRESS 0x0000 /* @ECU_Address@McuFunSafeMonitor_DW.Memory_PreviousInput_k@ */ /end MEASUREMENT
/begin MEASUREMENT McuFunSafeMonitor_DW.Memory_PreviousInput_l "" UBYTE McuFunSafeMonitor_CM_logical 0 0 0 1 ECU_ADDRESS 0x0000 /* @ECU_Address@McuFunSafeMonitor_DW.Memory_PreviousInput_l@ */ /end MEASUREMENT
/begin MEASUREMENT McuFunSafeMonitor_DW.Memory_PreviousInput_m "" UBYTE McuFunSafeMonitor_CM_logical 0 0 0 1 ECU_ADDRESS 0x0000 /* @ECU_Address@McuFunSafeMonitor_DW.Memory_PreviousInput_m@ */ /end MEASUREMENT
/begin MEASUREMENT McuFunSafeMonitor_DW.Memory_PreviousInput_mz "" UBYTE McuFunSafeMonitor_CM_logical 0 0 0 1 ECU_ADDRESS 0x0000 /* @ECU_Address@McuFunSafeMonitor_DW.Memory_PreviousInput_mz@ */ /end MEASUREMENT
/begin MEASUREMENT McuFunSafeMonitor_DW.Memory_PreviousInput_o "" UBYTE McuFunSafeMonitor_CM_logical 0 0 0 1 ECU_ADDRESS 0x0000 /* @ECU_Address@McuFunSafeMonitor_DW.Memory_PreviousInput_o@ */ /end MEASUREMENT
/begin MEASUREMENT McuFunSafeMonitor_DW.Memory_PreviousInput_o3 "" UBYTE McuFunSafeMonitor_CM_logical 0 0 0 1 ECU_ADDRESS 0x0000 /* @ECU_Address@McuFunSafeMonitor_DW.Memory_PreviousInput_o3@ */ /end MEASUREMENT
/begin MEASUREMENT McuFunSafeMonitor_DW.Memory_PreviousInput_p "" UBYTE McuFunSafeMonitor_CM_logical 0 0 0 1 ECU_ADDRESS 0x0000 /* @ECU_Address@McuFunSafeMonitor_DW.Memory_PreviousInput_p@ */ /end MEASUREMENT
/begin MEASUREMENT McuFunSafeMonitor_DW.UnitDelay1_DSTATE "" FLOAT32_IEEE McuFunSafeMonitor_CM_single 0 0 -3.4E+38 3.4E+38 ECU_ADDRESS 0x0000 /* @ECU_Address@McuFunSafeMonitor_DW.UnitDelay1_DSTATE@ */ /end MEASUREMENT
/begin MEASUREMENT McuFunSafeMonitor_DW.UnitDelay2_DSTATE "" FLOAT32_IEEE McuFunSafeMonitor_CM_single 0 0 -3.4E+38 3.4E+38 ECU_ADDRESS 0x0000 /* @ECU_Address@McuFunSafeMonitor_DW.UnitDelay2_DSTATE@ */ /end MEASUREMENT
/begin MEASUREMENT McuFunSafeMonitor_DW.UnitDelay_DSTATE "" FLOAT32_IEEE McuFunSafeMonitor_CM_single 0 0 -3.4E+38 3.4E+38 ECU_ADDRESS 0x0000 /* @ECU_Address@McuFunSafeMonitor_DW.UnitDelay_DSTATE@ */ /end MEASUREMENT
/begin MEASUREMENT McuFunSafeMonitor_DW.UnitDelay_DSTATE_o "" UWORD McuFunSafeMonitor_CM_uint16 0 0 0 65535 ECU_ADDRESS 0x0000 /* @ECU_Address@McuFunSafeMonitor_DW.UnitDelay_DSTATE_o@ */ /end MEASUREMENT
/begin MEASUREMENT McuFunSafeMonitor_DW.UnitDelay_DSTATE_p "" UWORD McuFunSafeMonitor_CM_uint16 0 0 0 65535 ECU_ADDRESS 0x0000 /* @ECU_Address@McuFunSafeMonitor_DW.UnitDelay_DSTATE_p@ */ /end MEASUREMENT
/begin MEASUREMENT SGPP_BSW_f32_iSmpPhaU_A "" FLOAT32_IEEE McuFunSafeMonitor_CM_single 0 0 -3.4E+38 3.4E+38 ECU_ADDRESS 0x0000 /* @ECU_Address@SGPP_BSW_f32_iSmpPhaU_A@ */ /end MEASUREMENT
/begin MEASUREMENT SGPP_BSW_f32_iSmpPhaW_A "" FLOAT32_IEEE McuFunSafeMonitor_CM_single 0 0 -3.4E+38 3.4E+38 ECU_ADDRESS 0x0000 /* @ECU_Address@SGPP_BSW_f32_iSmpPhaW_A@ */ /end MEASUREMENT
/begin MEASUREMENT SGPP_BSW_f32_nRotateSpd_rpm "" FLOAT32_IEEE McuFunSafeMonitor_CM_single 0 0 -3.4E+38 3.4E+38 ECU_ADDRESS 0x0000 /* @ECU_Address@SGPP_BSW_f32_nRotateSpd_rpm@ */ /end MEASUREMENT
/begin MEASUREMENT SGPP_BSW_f32_uDcHV_V "" FLOAT32_IEEE McuFunSafeMonitor_CM_single 0 0 -3.4E+38 3.4E+38 ECU_ADDRESS 0x0000 /* @ECU_Address@SGPP_BSW_f32_uDcHV_V@ */ /end MEASUREMENT
/begin MEASUREMENT SGPP_FOC_f32_Uduty_Null "" FLOAT32_IEEE McuFunSafeMonitor_CM_single 0 0 -3.4E+38 3.4E+38 ECU_ADDRESS 0x0000 /* @ECU_Address@SGPP_FOC_f32_Uduty_Null@ */ /end MEASUREMENT
/begin MEASUREMENT SGPP_FOC_f32_Vduty_Null "" FLOAT32_IEEE McuFunSafeMonitor_CM_single 0 0 -3.4E+38 3.4E+38 ECU_ADDRESS 0x0000 /* @ECU_Address@SGPP_FOC_f32_Vduty_Null@ */ /end MEASUREMENT
/begin MEASUREMENT SGPP_FOC_f32_Wduty_Null "" FLOAT32_IEEE McuFunSafeMonitor_CM_single 0 0 -3.4E+38 3.4E+38 ECU_ADDRESS 0x0000 /* @ECU_Address@SGPP_FOC_f32_Wduty_Null@ */ /end MEASUREMENT
/begin MEASUREMENT SGPP_PhaseADuty "" FLOAT32_IEEE McuFunSafeMonitor_CM_single 0 0 -3.4E+38 3.4E+38 ECU_ADDRESS 0x0000 /* @ECU_Address@SGPP_PhaseADuty@ */ /end MEASUREMENT
/begin MEASUREMENT SGPP_PhaseBDuty "" FLOAT32_IEEE McuFunSafeMonitor_CM_single 0 0 -3.4E+38 3.4E+38 ECU_ADDRESS 0x0000 /* @ECU_Address@SGPP_PhaseBDuty@ */ /end MEASUREMENT
/begin MEASUREMENT SGPP_PhaseCDuty "" FLOAT32_IEEE McuFunSafeMonitor_CM_single 0 0 -3.4E+38 3.4E+38 ECU_ADDRESS 0x0000 /* @ECU_Address@SGPP_PhaseCDuty@ */ /end MEASUREMENT
/begin MEASUREMENT SGRD_CosEnvelope "" FLOAT32_IEEE McuFunSafeMonitor_CM_single 0 0 -3.4E+38 3.4E+38 ECU_ADDRESS 0x0000 /* @ECU_Address@SGRD_CosEnvelope@ */ /end MEASUREMENT
/begin MEASUREMENT SGRD_SinEnvelope "" FLOAT32_IEEE McuFunSafeMonitor_CM_single 0 0 -3.4E+38 3.4E+38 ECU_ADDRESS 0x0000 /* @ECU_Address@SGRD_SinEnvelope@ */ /end MEASUREMENT
/begin MEASUREMENT SGSA_DcLinkVoltMeasAD "" FLOAT32_IEEE McuFunSafeMonitor_CM_single 0 0 -3.4E+38 3.4E+38 ECU_ADDRESS 0x0000 /* @ECU_Address@SGSA_DcLinkVoltMeasAD@ */ /end MEASUREMENT
/begin MEASUREMENT SGSA_MotorTemp1AD "" FLOAT32_IEEE McuFunSafeMonitor_CM_single 0 0 -3.4E+38 3.4E+38 ECU_ADDRESS 0x0000 /* @ECU_Address@SGSA_MotorTemp1AD@ */ /end MEASUREMENT
/begin MEASUREMENT SGSA_PhaseACurrentAD "" FLOAT32_IEEE McuFunSafeMonitor_CM_single 0 0 -3.4E+38 3.4E+38 ECU_ADDRESS 0x0000 /* @ECU_Address@SGSA_PhaseACurrentAD@ */ /end MEASUREMENT
/begin MEASUREMENT SGSA_PhaseCCurrentAD "" FLOAT32_IEEE McuFunSafeMonitor_CM_single 0 0 -3.4E+38 3.4E+38 ECU_ADDRESS 0x0000 /* @ECU_Address@SGSA_PhaseCCurrentAD@ */ /end MEASUREMENT
/begin MEASUREMENT SGSA_PwrChipVolt "" FLOAT32_IEEE McuFunSafeMonitor_CM_single 0 0 -3.4E+38 3.4E+38 ECU_ADDRESS 0x0000 /* @ECU_Address@SGSA_PwrChipVolt@ */ /end MEASUREMENT
/begin AXIS_PTS MFSM_ElecSpd_A "" 0x0000 /* @ECU_Address@MFSM_ElecSpd_A@ */ NO_INPUT_QUANTITY Axis_FLOAT32_IEEE 0 McuFunSafeMonitor_CM_single_Rpm 3 -3.4E+38 3.4E+38 /end AXIS_PTS
/begin AXIS_PTS MFSM_LpfBusCurrent_A "" 0x0000 /* @ECU_Address@MFSM_LpfBusCurrent_A@ */ NO_INPUT_QUANTITY Axis_FLOAT32_IEEE 0 McuFunSafeMonitor_CM_single_Rpm 3 -3.4E+38 3.4E+38 /end AXIS_PTS
/begin AXIS_PTS MFSM_MechSpd_A "" 0x0000 /* @ECU_Address@MFSM_MechSpd_A@ */ NO_INPUT_QUANTITY Axis_FLOAT32_IEEE 0 McuFunSafeMonitor_CM_single_Rpm 3 -3.4E+38 3.4E+38 /end AXIS_PTS
/begin COMPU_METHOD McuFunSafeMonitor_CM_logical "Q = V" IDENTICAL "%1.0" "" /end COMPU_METHOD
/begin COMPU_METHOD McuFunSafeMonitor_CM_single "Q = V" IDENTICAL "%8.6" "" /end COMPU_METHOD
/begin COMPU_METHOD McuFunSafeMonitor_CM_single_N_per_m "Q = V" IDENTICAL "%8.6" "N/m" /end COMPU_METHOD
/begin COMPU_METHOD McuFunSafeMonitor_CM_single_Rpm "Q = V" IDENTICAL "%8.6" "Rpm" /end COMPU_METHOD
/begin COMPU_METHOD McuFunSafeMonitor_CM_single_dash_ "Q = V" IDENTICAL "%8.6" "-" /end COMPU_METHOD
/begin COMPU_METHOD McuFunSafeMonitor_CM_uint16 "Q = V" IDENTICAL "%5.0" "" /end COMPU_METHOD
/begin COMPU_METHOD McuFunSafeMonitor_CM_uint16_dash_ "Q = V" IDENTICAL "%5.0" "-" /end COMPU_METHOD
/begin COMPU_METHOD McuFunSafeMonitor_CM_uint8 "Q = V" IDENTICAL "%3.0" "" /end COMPU_METHOD
/begin COMPU_METHOD McuFunSafeMonitor_CM_uint8_dash_ "Q = V" IDENTICAL "%3.0" "-" /end COMPU_METHOD
/begin RECORD_LAYOUT Record_BOOLEAN FNC_VALUES 1 UBYTE COLUMN_DIR DIRECT /end RECORD_LAYOUT
/begin RECORD_LAYOUT Record_FLOAT32_IEEE FNC_VALUES 1 FLOAT32_IEEE COLUMN_DIR DIRECT /end RECORD_LAYOUT
/begin RECORD_LAYOUT Record_UBYTE FNC_VALUES 1 UBYTE COLUMN_DIR DIRECT /end RECORD_LAYOUT
/begin RECORD_LAYOUT Record_UWORD FNC_VALUES 1 UWORD COLUMN_DIR DIRECT /end RECORD_LAYOUT
/* Record Layouts for Lookup Tables in Standard Axis format */
/begin RECORD_LAYOUT Axis_FLOAT32_IEEE AXIS_PTS_X 1 FLOAT32_IEEE INDEX_INCR DIRECT /end RECORD_LAYOUT
/begin GROUP McuFunSafeMonitor "McuFunSafeMonitor" /* Root */ ROOT
 /begin SUB_GROUP McuFunSafeMonitor_MFSM_FuncSafetyRedundancy_1ms_sys McuFunSafeMonitor_MFSM_FuncSafetyRedundancy_96us_sys /end SUB_GROUP
 /begin REF_MEASUREMENT IPU_IsgTqActIsgTqAct SGPP_BSW_f32_iSmpPhaU_A SGPP_BSW_f32_iSmpPhaW_A SGPP_BSW_f32_nRotateSpd_rpm SGPP_BSW_f32_uDcHV_V SGPP_FOC_f32_Uduty_Null SGPP_FOC_f32_Vduty_Null SGPP_FOC_f32_Wduty_Null SGPP_PhaseADuty SGPP_PhaseBDuty SGPP_PhaseCDuty SGRD_CosEnvelope SGRD_SinEnvelope SGSA_DcLinkVoltMeasAD SGSA_MotorTemp1AD SGSA_PhaseACurrentAD SGSA_PhaseCCurrentAD SGSA_PwrChipVolt /end REF_MEASUREMENT
/end GROUP
/begin GROUP McuFunSafeMonitor_MFSM_FuncSafetyRedundancy_1ms_sys "McuFunSafeMonitor/MFSM_FuncSafetyRedundancy_1ms_sys"
 /begin SUB_GROUP McuFunSafeMonitor_MFSM_FuncSafetyRedundancy_1ms_sys_EnSlowDiag McuFunSafeMonitor_MFSM_FuncSafetyRedundancy_1ms_sys_Subsystem /end SUB_GROUP
/end GROUP
/begin GROUP McuFunSafeMonitor_MFSM_FuncSafetyRedundancy_1ms_sys_EnSlowDiag "McuFunSafeMonitor/MFSM_FuncSafetyRedundancy_1ms_sys/EnSlowDiag"
 /begin SUB_GROUP McuFunSafeMonitor_MFSM_FuncSafetyRedundancy_1ms_sys_EnSlowDiag_Parameter /end SUB_GROUP
 /begin REF_MEASUREMENT McuFunSafeMonitor_DW.UnitDelay_DSTATE_o /end REF_MEASUREMENT
/end GROUP
/begin GROUP McuFunSafeMonitor_MFSM_FuncSafetyRedundancy_1ms_sys_EnSlowDiag_Parameter "McuFunSafeMonitor/MFSM_FuncSafetyRedundancy_1ms_sys/EnSlowDiag/Parameter" /begin REF_CHARACTERISTIC MFSM_SlowDiagInitTimeCount_C /end REF_CHARACTERISTIC /end GROUP
/begin GROUP McuFunSafeMonitor_MFSM_FuncSafetyRedundancy_1ms_sys_Subsystem "McuFunSafeMonitor/MFSM_FuncSafetyRedundancy_1ms_sys/Subsystem"
 /begin SUB_GROUP McuFunSafeMonitor_MFSM_FuncSafetyRedundancy_1ms_sys_Subsystem_BusCurrentDeviationFault McuFunSafeMonitor_MFSM_FuncSafetyRedundancy_1ms_sys_Subsystem_Function_Caller McuFunSafeMonitor_MFSM_FuncSafetyRedundancy_1ms_sys_Subsystem_HighVoltConsistencyChk McuFunSafeMonitor_MFSM_FuncSafetyRedundancy_1ms_sys_Subsystem_MtrTempConsistencyChk McuFunSafeMonitor_MFSM_FuncSafetyRedundancy_1ms_sys_Subsystem_MtrTempSensorShortGnd McuFunSafeMonitor_MFSM_FuncSafetyRedundancy_1ms_sys_Subsystem_MtrTempSensorShortPwr McuFunSafeMonitor_MFSM_FuncSafetyRedundancy_1ms_sys_Subsystem_SensorVoltConsistencyChk McuFunSafeMonitor_MFSM_FuncSafetyRedundancy_1ms_sys_Subsystem_TorqueDeviationFault /end SUB_GROUP
/end GROUP
/begin GROUP McuFunSafeMonitor_MFSM_FuncSafetyRedundancy_1ms_sys_Subsystem_BusCurrentDeviationFault "McuFunSafeMonitor/MFSM_FuncSafetyRedundancy_1ms_sys/Subsystem/BusCurrentDeviationFault"
 /begin SUB_GROUP McuFunSafeMonitor_MFSM_FuncSafetyRedundancy_1ms_sys_Subsystem_BusCurrentDeviationFault_FaultDebounce McuFunSafeMonitor_MFSM_FuncSafetyRedundancy_1ms_sys_Subsystem_BusCurrentDeviationFault_Local_Variable_Storage1 McuFunSafeMonitor_MFSM_FuncSafetyRedundancy_1ms_sys_Subsystem_BusCurrentDeviationFault_Parameter1 McuFunSafeMonitor_MFSM_FuncSafetyRedundancy_1ms_sys_Subsystem_BusCurrentDeviationFault_Parameter2 McuFunSafeMonitor_MFSM_FuncSafetyRedundancy_1ms_sys_Subsystem_BusCurrentDeviationFault_Parameter3 McuFunSafeMonitor_MFSM_FuncSafetyRedundancy_1ms_sys_Subsystem_BusCurrentDeviationFault_Parameter4 McuFunSafeMonitor_MFSM_FuncSafetyRedundancy_1ms_sys_Subsystem_BusCurrentDeviationFault_Parameter5 /end SUB_GROUP
 /begin REF_MEASUREMENT McuFunSafeMonitor_B.DataTypeConversion_dm McuFunSafeMonitor_ConstB.DataTypeConversion1_ne /end REF_MEASUREMENT
/end GROUP
/begin GROUP McuFunSafeMonitor_MFSM_FuncSafetyRedundancy_1ms_sys_Subsystem_BusCurrentDeviationFault_FaultDebounce "McuFunSafeMonitor/MFSM_FuncSafetyRedundancy_1ms_sys/Subsystem/BusCurrentDeviationFault/FaultDebounce"
 /begin SUB_GROUP McuFunSafeMonitor_MFSM_FuncSafetyRedundancy_1ms_sys_Subsystem_BusCurrentDeviationFault_FaultDebounce_Subsystem McuFunSafeMonitor_MFSM_FuncSafetyRedundancy_1ms_sys_Subsystem_BusCurrentDeviationFault_FaultDebounce_UnitDelay /end SUB_GROUP
/end GROUP
/begin GROUP McuFunSafeMonitor_MFSM_FuncSafetyRedundancy_1ms_sys_Subsystem_BusCurrentDeviationFault_FaultDebounce_Subsystem "McuFunSafeMonitor/MFSM_FuncSafetyRedundancy_1ms_sys/Subsystem/BusCurrentDeviationFault/FaultDebounce/Subsystem" /begin REF_MEASUREMENT McuFunSafeMonitor_DW.Memory_PreviousInput_fx /end REF_MEASUREMENT /end GROUP
/begin GROUP McuFunSafeMonitor_MFSM_FuncSafetyRedundancy_1ms_sys_Subsystem_BusCurrentDeviationFault_FaultDebounce_UnitDelay "McuFunSafeMonitor/MFSM_FuncSafetyRedundancy_1ms_sys/Subsystem/BusCurrentDeviationFault/FaultDebounce/UnitDelay"
 /begin REF_MEASUREMENT McuFunSafeMonitor_ConstB.DataTypeConversion1_ne McuFunSafeMonitor_ConstB.LogicalOperator1_b McuFunSafeMonitor_DW.BareUnitDelay_DSTATE_jy /end REF_MEASUREMENT
/end GROUP
/begin GROUP McuFunSafeMonitor_MFSM_FuncSafetyRedundancy_1ms_sys_Subsystem_BusCurrentDeviationFault_Local_Variable_Storage1 "McuFunSafeMonitor/MFSM_FuncSafetyRedundancy_1ms_sys/Subsystem/BusCurrentDeviationFault/Local Variable Storage1" /begin REF_MEASUREMENT MFSM_BusCurDiff /end REF_MEASUREMENT /end GROUP
/begin GROUP McuFunSafeMonitor_MFSM_FuncSafetyRedundancy_1ms_sys_Subsystem_BusCurrentDeviationFault_Parameter1 "McuFunSafeMonitor/MFSM_FuncSafetyRedundancy_1ms_sys/Subsystem/BusCurrentDeviationFault/Parameter1" /begin REF_CHARACTERISTIC MFSM_BusCurDiff_C /end REF_CHARACTERISTIC /end GROUP
/begin GROUP McuFunSafeMonitor_MFSM_FuncSafetyRedundancy_1ms_sys_Subsystem_BusCurrentDeviationFault_Parameter2 "McuFunSafeMonitor/MFSM_FuncSafetyRedundancy_1ms_sys/Subsystem/BusCurrentDeviationFault/Parameter2" /begin REF_CHARACTERISTIC MFSM_DebounceMaxBusCurDiff_C /end REF_CHARACTERISTIC /end GROUP
/begin GROUP McuFunSafeMonitor_MFSM_FuncSafetyRedundancy_1ms_sys_Subsystem_BusCurrentDeviationFault_Parameter3 "McuFunSafeMonitor/MFSM_FuncSafetyRedundancy_1ms_sys/Subsystem/BusCurrentDeviationFault/Parameter3" /begin REF_CHARACTERISTIC MFSM_DebounceIncrBusCurDiff_C /end REF_CHARACTERISTIC /end GROUP
/begin GROUP McuFunSafeMonitor_MFSM_FuncSafetyRedundancy_1ms_sys_Subsystem_BusCurrentDeviationFault_Parameter4 "McuFunSafeMonitor/MFSM_FuncSafetyRedundancy_1ms_sys/Subsystem/BusCurrentDeviationFault/Parameter4" /begin REF_CHARACTERISTIC MFSM_DebounceDecrBusCurDiff_C /end REF_CHARACTERISTIC /end GROUP
/begin GROUP McuFunSafeMonitor_MFSM_FuncSafetyRedundancy_1ms_sys_Subsystem_BusCurrentDeviationFault_Parameter5 "McuFunSafeMonitor/MFSM_FuncSafetyRedundancy_1ms_sys/Subsystem/BusCurrentDeviationFault/Parameter5" /begin REF_CHARACTERISTIC MFSM_DebounceMinBusCurDiff_C /end REF_CHARACTERISTIC /end GROUP
/begin GROUP McuFunSafeMonitor_MFSM_FuncSafetyRedundancy_1ms_sys_Subsystem_Function_Caller "McuFunSafeMonitor/MFSM_FuncSafetyRedundancy_1ms_sys/Subsystem/Function Caller"
 /begin SUB_GROUP McuFunSafeMonitor_MFSM_FuncSafetyRedundancy_1ms_sys_Subsystem_Function_Caller_Local_Variable_Storage1 McuFunSafeMonitor_MFSM_FuncSafetyRedundancy_1ms_sys_Subsystem_Function_Caller_Local_Variable_Storage17 McuFunSafeMonitor_MFSM_FuncSafetyRedundancy_1ms_sys_Subsystem_Function_Caller_Local_Variable_Storage2 McuFunSafeMonitor_MFSM_FuncSafetyRedundancy_1ms_sys_Subsystem_Function_Caller_Local_Variable_Storage3 /end SUB_GROUP
/end GROUP
/begin GROUP McuFunSafeMonitor_MFSM_FuncSafetyRedundancy_1ms_sys_Subsystem_Function_Caller_Local_Variable_Storage1 "McuFunSafeMonitor/MFSM_FuncSafetyRedundancy_1ms_sys/Subsystem/Function Caller/Local Variable Storage1" /begin REF_MEASUREMENT MFSM_PwrChipVoltValue /end REF_MEASUREMENT /end GROUP
/begin GROUP McuFunSafeMonitor_MFSM_FuncSafetyRedundancy_1ms_sys_Subsystem_Function_Caller_Local_Variable_Storage17 "McuFunSafeMonitor/MFSM_FuncSafetyRedundancy_1ms_sys/Subsystem/Function Caller/Local Variable Storage17" /begin REF_MEASUREMENT MFSM_DcVolt /end REF_MEASUREMENT /end GROUP
/begin GROUP McuFunSafeMonitor_MFSM_FuncSafetyRedundancy_1ms_sys_Subsystem_Function_Caller_Local_Variable_Storage2 "McuFunSafeMonitor/MFSM_FuncSafetyRedundancy_1ms_sys/Subsystem/Function Caller/Local Variable Storage2" /begin REF_MEASUREMENT MFSM_MtrTempPVolt /end REF_MEASUREMENT /end GROUP
/begin GROUP McuFunSafeMonitor_MFSM_FuncSafetyRedundancy_1ms_sys_Subsystem_Function_Caller_Local_Variable_Storage3 "McuFunSafeMonitor/MFSM_FuncSafetyRedundancy_1ms_sys/Subsystem/Function Caller/Local Variable Storage3" /begin REF_MEASUREMENT MFSM_MtrTempNVolt /end REF_MEASUREMENT /end GROUP
/begin GROUP McuFunSafeMonitor_MFSM_FuncSafetyRedundancy_1ms_sys_Subsystem_HighVoltConsistencyChk "McuFunSafeMonitor/MFSM_FuncSafetyRedundancy_1ms_sys/Subsystem/HighVoltConsistencyChk"
 /begin SUB_GROUP McuFunSafeMonitor_MFSM_FuncSafetyRedundancy_1ms_sys_Subsystem_HighVoltConsistencyChk_FaultDebounce McuFunSafeMonitor_MFSM_FuncSafetyRedundancy_1ms_sys_Subsystem_HighVoltConsistencyChk_Local_Variable_Storage3 McuFunSafeMonitor_MFSM_FuncSafetyRedundancy_1ms_sys_Subsystem_HighVoltConsistencyChk_Parameter1 McuFunSafeMonitor_MFSM_FuncSafetyRedundancy_1ms_sys_Subsystem_HighVoltConsistencyChk_Parameter2 McuFunSafeMonitor_MFSM_FuncSafetyRedundancy_1ms_sys_Subsystem_HighVoltConsistencyChk_Parameter3 McuFunSafeMonitor_MFSM_FuncSafetyRedundancy_1ms_sys_Subsystem_HighVoltConsistencyChk_Parameter4 McuFunSafeMonitor_MFSM_FuncSafetyRedundancy_1ms_sys_Subsystem_HighVoltConsistencyChk_Parameter5 /end SUB_GROUP
 /begin REF_MEASUREMENT McuFunSafeMonitor_B.DataTypeConversion_c McuFunSafeMonitor_ConstB.DataTypeConversion1_c SGSA_DcLinkVoltMeasAD /end REF_MEASUREMENT
/end GROUP
/begin GROUP McuFunSafeMonitor_MFSM_FuncSafetyRedundancy_1ms_sys_Subsystem_HighVoltConsistencyChk_FaultDebounce "McuFunSafeMonitor/MFSM_FuncSafetyRedundancy_1ms_sys/Subsystem/HighVoltConsistencyChk/FaultDebounce"
 /begin SUB_GROUP McuFunSafeMonitor_MFSM_FuncSafetyRedundancy_1ms_sys_Subsystem_HighVoltConsistencyChk_FaultDebounce_Subsystem McuFunSafeMonitor_MFSM_FuncSafetyRedundancy_1ms_sys_Subsystem_HighVoltConsistencyChk_FaultDebounce_UnitDelay /end SUB_GROUP
/end GROUP
/begin GROUP McuFunSafeMonitor_MFSM_FuncSafetyRedundancy_1ms_sys_Subsystem_HighVoltConsistencyChk_FaultDebounce_Subsystem "McuFunSafeMonitor/MFSM_FuncSafetyRedundancy_1ms_sys/Subsystem/HighVoltConsistencyChk/FaultDebounce/Subsystem" /begin REF_MEASUREMENT McuFunSafeMonitor_DW.Memory_PreviousInput_e /end REF_MEASUREMENT /end GROUP
/begin GROUP McuFunSafeMonitor_MFSM_FuncSafetyRedundancy_1ms_sys_Subsystem_HighVoltConsistencyChk_FaultDebounce_UnitDelay "McuFunSafeMonitor/MFSM_FuncSafetyRedundancy_1ms_sys/Subsystem/HighVoltConsistencyChk/FaultDebounce/UnitDelay"
 /begin REF_MEASUREMENT McuFunSafeMonitor_ConstB.DataTypeConversion1_c McuFunSafeMonitor_ConstB.LogicalOperator1_n4 McuFunSafeMonitor_DW.BareUnitDelay_DSTATE_j /end REF_MEASUREMENT
/end GROUP
/begin GROUP McuFunSafeMonitor_MFSM_FuncSafetyRedundancy_1ms_sys_Subsystem_HighVoltConsistencyChk_Local_Variable_Storage3 "McuFunSafeMonitor/MFSM_FuncSafetyRedundancy_1ms_sys/Subsystem/HighVoltConsistencyChk/Local Variable Storage3" /begin REF_MEASUREMENT MFSM_DcVoltDiff /end REF_MEASUREMENT /end GROUP
/begin GROUP McuFunSafeMonitor_MFSM_FuncSafetyRedundancy_1ms_sys_Subsystem_HighVoltConsistencyChk_Parameter1 "McuFunSafeMonitor/MFSM_FuncSafetyRedundancy_1ms_sys/Subsystem/HighVoltConsistencyChk/Parameter1" /begin REF_CHARACTERISTIC MFSM_HighVoltDiff_C /end REF_CHARACTERISTIC /end GROUP
/begin GROUP McuFunSafeMonitor_MFSM_FuncSafetyRedundancy_1ms_sys_Subsystem_HighVoltConsistencyChk_Parameter2 "McuFunSafeMonitor/MFSM_FuncSafetyRedundancy_1ms_sys/Subsystem/HighVoltConsistencyChk/Parameter2" /begin REF_CHARACTERISTIC MFSM_DebounceMaxHighVolt_C /end REF_CHARACTERISTIC /end GROUP
/begin GROUP McuFunSafeMonitor_MFSM_FuncSafetyRedundancy_1ms_sys_Subsystem_HighVoltConsistencyChk_Parameter3 "McuFunSafeMonitor/MFSM_FuncSafetyRedundancy_1ms_sys/Subsystem/HighVoltConsistencyChk/Parameter3" /begin REF_CHARACTERISTIC MFSM_DebounceIncrHighVolt_C /end REF_CHARACTERISTIC /end GROUP
/begin GROUP McuFunSafeMonitor_MFSM_FuncSafetyRedundancy_1ms_sys_Subsystem_HighVoltConsistencyChk_Parameter4 "McuFunSafeMonitor/MFSM_FuncSafetyRedundancy_1ms_sys/Subsystem/HighVoltConsistencyChk/Parameter4" /begin REF_CHARACTERISTIC MFSM_DebounceDecrHighVolt_C /end REF_CHARACTERISTIC /end GROUP
/begin GROUP McuFunSafeMonitor_MFSM_FuncSafetyRedundancy_1ms_sys_Subsystem_HighVoltConsistencyChk_Parameter5 "McuFunSafeMonitor/MFSM_FuncSafetyRedundancy_1ms_sys/Subsystem/HighVoltConsistencyChk/Parameter5" /begin REF_CHARACTERISTIC MFSM_DebounceMinHighVolt_C /end REF_CHARACTERISTIC /end GROUP
/begin GROUP McuFunSafeMonitor_MFSM_FuncSafetyRedundancy_1ms_sys_Subsystem_MtrTempConsistencyChk "McuFunSafeMonitor/MFSM_FuncSafetyRedundancy_1ms_sys/Subsystem/MtrTempConsistencyChk"
 /begin SUB_GROUP McuFunSafeMonitor_MFSM_FuncSafetyRedundancy_1ms_sys_Subsystem_MtrTempConsistencyChk_FaultDebounce McuFunSafeMonitor_MFSM_FuncSafetyRedundancy_1ms_sys_Subsystem_MtrTempConsistencyChk_Parameter1 McuFunSafeMonitor_MFSM_FuncSafetyRedundancy_1ms_sys_Subsystem_MtrTempConsistencyChk_Parameter2 McuFunSafeMonitor_MFSM_FuncSafetyRedundancy_1ms_sys_Subsystem_MtrTempConsistencyChk_Parameter3 McuFunSafeMonitor_MFSM_FuncSafetyRedundancy_1ms_sys_Subsystem_MtrTempConsistencyChk_Parameter4 McuFunSafeMonitor_MFSM_FuncSafetyRedundancy_1ms_sys_Subsystem_MtrTempConsistencyChk_Parameter5 McuFunSafeMonitor_MFSM_FuncSafetyRedundancy_1ms_sys_Subsystem_MtrTempConsistencyChk_Parameter6 /end SUB_GROUP
 /begin REF_MEASUREMENT McuFunSafeMonitor_B.DataTypeConversion_ld McuFunSafeMonitor_ConstB.DataTypeConversion1_ls SGSA_MotorTemp1AD /end REF_MEASUREMENT
/end GROUP
/begin GROUP McuFunSafeMonitor_MFSM_FuncSafetyRedundancy_1ms_sys_Subsystem_MtrTempConsistencyChk_FaultDebounce "McuFunSafeMonitor/MFSM_FuncSafetyRedundancy_1ms_sys/Subsystem/MtrTempConsistencyChk/FaultDebounce"
 /begin SUB_GROUP McuFunSafeMonitor_MFSM_FuncSafetyRedundancy_1ms_sys_Subsystem_MtrTempConsistencyChk_FaultDebounce_Subsystem McuFunSafeMonitor_MFSM_FuncSafetyRedundancy_1ms_sys_Subsystem_MtrTempConsistencyChk_FaultDebounce_UnitDelay /end SUB_GROUP
/end GROUP
/begin GROUP McuFunSafeMonitor_MFSM_FuncSafetyRedundancy_1ms_sys_Subsystem_MtrTempConsistencyChk_FaultDebounce_Subsystem "McuFunSafeMonitor/MFSM_FuncSafetyRedundancy_1ms_sys/Subsystem/MtrTempConsistencyChk/FaultDebounce/Subsystem" /begin REF_MEASUREMENT McuFunSafeMonitor_DW.Memory_PreviousInput_g /end REF_MEASUREMENT /end GROUP
/begin GROUP McuFunSafeMonitor_MFSM_FuncSafetyRedundancy_1ms_sys_Subsystem_MtrTempConsistencyChk_FaultDebounce_UnitDelay "McuFunSafeMonitor/MFSM_FuncSafetyRedundancy_1ms_sys/Subsystem/MtrTempConsistencyChk/FaultDebounce/UnitDelay"
 /begin REF_MEASUREMENT McuFunSafeMonitor_ConstB.DataTypeConversion1_ls McuFunSafeMonitor_ConstB.LogicalOperator1_h McuFunSafeMonitor_DW.BareUnitDelay_DSTATE_d /end REF_MEASUREMENT
/end GROUP
/begin GROUP McuFunSafeMonitor_MFSM_FuncSafetyRedundancy_1ms_sys_Subsystem_MtrTempConsistencyChk_Parameter1 "McuFunSafeMonitor/MFSM_FuncSafetyRedundancy_1ms_sys/Subsystem/MtrTempConsistencyChk/Parameter1" /begin REF_CHARACTERISTIC MFSM_MtrTempSensorShortPwr_C /end REF_CHARACTERISTIC /end GROUP
/begin GROUP McuFunSafeMonitor_MFSM_FuncSafetyRedundancy_1ms_sys_Subsystem_MtrTempConsistencyChk_Parameter2 "McuFunSafeMonitor/MFSM_FuncSafetyRedundancy_1ms_sys/Subsystem/MtrTempConsistencyChk/Parameter2" /begin REF_CHARACTERISTIC MFSM_DebounceMaxMtrTemp_C /end REF_CHARACTERISTIC /end GROUP
/begin GROUP McuFunSafeMonitor_MFSM_FuncSafetyRedundancy_1ms_sys_Subsystem_MtrTempConsistencyChk_Parameter3 "McuFunSafeMonitor/MFSM_FuncSafetyRedundancy_1ms_sys/Subsystem/MtrTempConsistencyChk/Parameter3" /begin REF_CHARACTERISTIC MFSM_DebounceIncrMtrTemp_C /end REF_CHARACTERISTIC /end GROUP
/begin GROUP McuFunSafeMonitor_MFSM_FuncSafetyRedundancy_1ms_sys_Subsystem_MtrTempConsistencyChk_Parameter4 "McuFunSafeMonitor/MFSM_FuncSafetyRedundancy_1ms_sys/Subsystem/MtrTempConsistencyChk/Parameter4" /begin REF_CHARACTERISTIC MFSM_DebounceDecrMtrTemp_C /end REF_CHARACTERISTIC /end GROUP
/begin GROUP McuFunSafeMonitor_MFSM_FuncSafetyRedundancy_1ms_sys_Subsystem_MtrTempConsistencyChk_Parameter5 "McuFunSafeMonitor/MFSM_FuncSafetyRedundancy_1ms_sys/Subsystem/MtrTempConsistencyChk/Parameter5" /begin REF_CHARACTERISTIC MFSM_DebounceMinMtrTemp_C /end REF_CHARACTERISTIC /end GROUP
/begin GROUP McuFunSafeMonitor_MFSM_FuncSafetyRedundancy_1ms_sys_Subsystem_MtrTempConsistencyChk_Parameter6 "McuFunSafeMonitor/MFSM_FuncSafetyRedundancy_1ms_sys/Subsystem/MtrTempConsistencyChk/Parameter6" /begin REF_CHARACTERISTIC MFSM_MtrTempSensorShortGnd_C /end REF_CHARACTERISTIC /end GROUP
/begin GROUP McuFunSafeMonitor_MFSM_FuncSafetyRedundancy_1ms_sys_Subsystem_MtrTempSensorShortGnd "McuFunSafeMonitor/MFSM_FuncSafetyRedundancy_1ms_sys/Subsystem/MtrTempSensorShortGnd"
 /begin SUB_GROUP McuFunSafeMonitor_MFSM_FuncSafetyRedundancy_1ms_sys_Subsystem_MtrTempSensorShortGnd_FaultDebounce McuFunSafeMonitor_MFSM_FuncSafetyRedundancy_1ms_sys_Subsystem_MtrTempSensorShortGnd_Parameter1 McuFunSafeMonitor_MFSM_FuncSafetyRedundancy_1ms_sys_Subsystem_MtrTempSensorShortGnd_Parameter2 McuFunSafeMonitor_MFSM_FuncSafetyRedundancy_1ms_sys_Subsystem_MtrTempSensorShortGnd_Parameter3 McuFunSafeMonitor_MFSM_FuncSafetyRedundancy_1ms_sys_Subsystem_MtrTempSensorShortGnd_Parameter4 McuFunSafeMonitor_MFSM_FuncSafetyRedundancy_1ms_sys_Subsystem_MtrTempSensorShortGnd_Parameter5 McuFunSafeMonitor_MFSM_FuncSafetyRedundancy_1ms_sys_Subsystem_MtrTempSensorShortGnd_Parameter6 /end SUB_GROUP
 /begin REF_MEASUREMENT McuFunSafeMonitor_B.DataTypeConversion_c3 McuFunSafeMonitor_ConstB.DataTypeConversion1_nb /end REF_MEASUREMENT
/end GROUP
/begin GROUP McuFunSafeMonitor_MFSM_FuncSafetyRedundancy_1ms_sys_Subsystem_MtrTempSensorShortGnd_FaultDebounce "McuFunSafeMonitor/MFSM_FuncSafetyRedundancy_1ms_sys/Subsystem/MtrTempSensorShortGnd/FaultDebounce"
 /begin SUB_GROUP McuFunSafeMonitor_MFSM_FuncSafetyRedundancy_1ms_sys_Subsystem_MtrTempSensorShortGnd_FaultDebounce_Subsystem McuFunSafeMonitor_MFSM_FuncSafetyRedundancy_1ms_sys_Subsystem_MtrTempSensorShortGnd_FaultDebounce_UnitDelay /end SUB_GROUP
/end GROUP
/begin GROUP McuFunSafeMonitor_MFSM_FuncSafetyRedundancy_1ms_sys_Subsystem_MtrTempSensorShortGnd_FaultDebounce_Subsystem "McuFunSafeMonitor/MFSM_FuncSafetyRedundancy_1ms_sys/Subsystem/MtrTempSensorShortGnd/FaultDebounce/Subsystem" /begin REF_MEASUREMENT McuFunSafeMonitor_DW.Memory_PreviousInput_b /end REF_MEASUREMENT /end GROUP
/begin GROUP McuFunSafeMonitor_MFSM_FuncSafetyRedundancy_1ms_sys_Subsystem_MtrTempSensorShortGnd_FaultDebounce_UnitDelay "McuFunSafeMonitor/MFSM_FuncSafetyRedundancy_1ms_sys/Subsystem/MtrTempSensorShortGnd/FaultDebounce/UnitDelay"
 /begin REF_MEASUREMENT McuFunSafeMonitor_ConstB.DataTypeConversion1_nb McuFunSafeMonitor_ConstB.LogicalOperator1_fl McuFunSafeMonitor_DW.BareUnitDelay_DSTATE_md /end REF_MEASUREMENT
/end GROUP
/begin GROUP McuFunSafeMonitor_MFSM_FuncSafetyRedundancy_1ms_sys_Subsystem_MtrTempSensorShortGnd_Parameter1 "McuFunSafeMonitor/MFSM_FuncSafetyRedundancy_1ms_sys/Subsystem/MtrTempSensorShortGnd/Parameter1" /begin REF_CHARACTERISTIC MFSM_MtrTempSensorPShortGnd_C /end REF_CHARACTERISTIC /end GROUP
/begin GROUP McuFunSafeMonitor_MFSM_FuncSafetyRedundancy_1ms_sys_Subsystem_MtrTempSensorShortGnd_Parameter2 "McuFunSafeMonitor/MFSM_FuncSafetyRedundancy_1ms_sys/Subsystem/MtrTempSensorShortGnd/Parameter2" /begin REF_CHARACTERISTIC MFSM_DebounceMaxMtrTempShortGnd_C /end REF_CHARACTERISTIC /end GROUP
/begin GROUP McuFunSafeMonitor_MFSM_FuncSafetyRedundancy_1ms_sys_Subsystem_MtrTempSensorShortGnd_Parameter3 "McuFunSafeMonitor/MFSM_FuncSafetyRedundancy_1ms_sys/Subsystem/MtrTempSensorShortGnd/Parameter3" /begin REF_CHARACTERISTIC MFSM_DebounceIncrMtrTempShortGnd_C /end REF_CHARACTERISTIC /end GROUP
/begin GROUP McuFunSafeMonitor_MFSM_FuncSafetyRedundancy_1ms_sys_Subsystem_MtrTempSensorShortGnd_Parameter4 "McuFunSafeMonitor/MFSM_FuncSafetyRedundancy_1ms_sys/Subsystem/MtrTempSensorShortGnd/Parameter4" /begin REF_CHARACTERISTIC MFSM_DebounceDecrMtrTempShortGnd_C /end REF_CHARACTERISTIC /end GROUP
/begin GROUP McuFunSafeMonitor_MFSM_FuncSafetyRedundancy_1ms_sys_Subsystem_MtrTempSensorShortGnd_Parameter5 "McuFunSafeMonitor/MFSM_FuncSafetyRedundancy_1ms_sys/Subsystem/MtrTempSensorShortGnd/Parameter5" /begin REF_CHARACTERISTIC MFSM_DebounceMinMtrTempShortGnd_C /end REF_CHARACTERISTIC /end GROUP
/begin GROUP McuFunSafeMonitor_MFSM_FuncSafetyRedundancy_1ms_sys_Subsystem_MtrTempSensorShortGnd_Parameter6 "McuFunSafeMonitor/MFSM_FuncSafetyRedundancy_1ms_sys/Subsystem/MtrTempSensorShortGnd/Parameter6" /begin REF_CHARACTERISTIC MFSM_MtrTempSensorNShortGnd_C /end REF_CHARACTERISTIC /end GROUP
/begin GROUP McuFunSafeMonitor_MFSM_FuncSafetyRedundancy_1ms_sys_Subsystem_MtrTempSensorShortPwr "McuFunSafeMonitor/MFSM_FuncSafetyRedundancy_1ms_sys/Subsystem/MtrTempSensorShortPwr"
 /begin SUB_GROUP McuFunSafeMonitor_MFSM_FuncSafetyRedundancy_1ms_sys_Subsystem_MtrTempSensorShortPwr_FaultDebounce McuFunSafeMonitor_MFSM_FuncSafetyRedundancy_1ms_sys_Subsystem_MtrTempSensorShortPwr_Parameter1 McuFunSafeMonitor_MFSM_FuncSafetyRedundancy_1ms_sys_Subsystem_MtrTempSensorShortPwr_Parameter2 McuFunSafeMonitor_MFSM_FuncSafetyRedundancy_1ms_sys_Subsystem_MtrTempSensorShortPwr_Parameter3 McuFunSafeMonitor_MFSM_FuncSafetyRedundancy_1ms_sys_Subsystem_MtrTempSensorShortPwr_Parameter4 McuFunSafeMonitor_MFSM_FuncSafetyRedundancy_1ms_sys_Subsystem_MtrTempSensorShortPwr_Parameter5 McuFunSafeMonitor_MFSM_FuncSafetyRedundancy_1ms_sys_Subsystem_MtrTempSensorShortPwr_Parameter6 /end SUB_GROUP
 /begin REF_MEASUREMENT McuFunSafeMonitor_B.DataTypeConversion_p0 McuFunSafeMonitor_ConstB.DataTypeConversion1_d /end REF_MEASUREMENT
/end GROUP
/begin GROUP McuFunSafeMonitor_MFSM_FuncSafetyRedundancy_1ms_sys_Subsystem_MtrTempSensorShortPwr_FaultDebounce "McuFunSafeMonitor/MFSM_FuncSafetyRedundancy_1ms_sys/Subsystem/MtrTempSensorShortPwr/FaultDebounce"
 /begin SUB_GROUP McuFunSafeMonitor_MFSM_FuncSafetyRedundancy_1ms_sys_Subsystem_MtrTempSensorShortPwr_FaultDebounce_Subsystem McuFunSafeMonitor_MFSM_FuncSafetyRedundancy_1ms_sys_Subsystem_MtrTempSensorShortPwr_FaultDebounce_UnitDelay /end SUB_GROUP
/end GROUP
/begin GROUP McuFunSafeMonitor_MFSM_FuncSafetyRedundancy_1ms_sys_Subsystem_MtrTempSensorShortPwr_FaultDebounce_Subsystem "McuFunSafeMonitor/MFSM_FuncSafetyRedundancy_1ms_sys/Subsystem/MtrTempSensorShortPwr/FaultDebounce/Subsystem" /begin REF_MEASUREMENT McuFunSafeMonitor_DW.Memory_PreviousInput_c3 /end REF_MEASUREMENT /end GROUP
/begin GROUP McuFunSafeMonitor_MFSM_FuncSafetyRedundancy_1ms_sys_Subsystem_MtrTempSensorShortPwr_FaultDebounce_UnitDelay "McuFunSafeMonitor/MFSM_FuncSafetyRedundancy_1ms_sys/Subsystem/MtrTempSensorShortPwr/FaultDebounce/UnitDelay"
 /begin REF_MEASUREMENT McuFunSafeMonitor_ConstB.DataTypeConversion1_d McuFunSafeMonitor_ConstB.LogicalOperator1_pw McuFunSafeMonitor_DW.BareUnitDelay_DSTATE_b /end REF_MEASUREMENT
/end GROUP
/begin GROUP McuFunSafeMonitor_MFSM_FuncSafetyRedundancy_1ms_sys_Subsystem_MtrTempSensorShortPwr_Parameter1 "McuFunSafeMonitor/MFSM_FuncSafetyRedundancy_1ms_sys/Subsystem/MtrTempSensorShortPwr/Parameter1" /begin REF_CHARACTERISTIC MFSM_MtrTempSensorPShortPwr_C /end REF_CHARACTERISTIC /end GROUP
/begin GROUP McuFunSafeMonitor_MFSM_FuncSafetyRedundancy_1ms_sys_Subsystem_MtrTempSensorShortPwr_Parameter2 "McuFunSafeMonitor/MFSM_FuncSafetyRedundancy_1ms_sys/Subsystem/MtrTempSensorShortPwr/Parameter2" /begin REF_CHARACTERISTIC MFSM_DebounceMaxMtrTempShortPwr_C /end REF_CHARACTERISTIC /end GROUP
/begin GROUP McuFunSafeMonitor_MFSM_FuncSafetyRedundancy_1ms_sys_Subsystem_MtrTempSensorShortPwr_Parameter3 "McuFunSafeMonitor/MFSM_FuncSafetyRedundancy_1ms_sys/Subsystem/MtrTempSensorShortPwr/Parameter3" /begin REF_CHARACTERISTIC MFSM_DebounceIncrMtrTempShortPwr_C /end REF_CHARACTERISTIC /end GROUP
/begin GROUP McuFunSafeMonitor_MFSM_FuncSafetyRedundancy_1ms_sys_Subsystem_MtrTempSensorShortPwr_Parameter4 "McuFunSafeMonitor/MFSM_FuncSafetyRedundancy_1ms_sys/Subsystem/MtrTempSensorShortPwr/Parameter4" /begin REF_CHARACTERISTIC MFSM_DebounceDecrMtrTempShortPwr_C /end REF_CHARACTERISTIC /end GROUP
/begin GROUP McuFunSafeMonitor_MFSM_FuncSafetyRedundancy_1ms_sys_Subsystem_MtrTempSensorShortPwr_Parameter5 "McuFunSafeMonitor/MFSM_FuncSafetyRedundancy_1ms_sys/Subsystem/MtrTempSensorShortPwr/Parameter5" /begin REF_CHARACTERISTIC MFSM_DebounceMinMtrTempShortPwr_C /end REF_CHARACTERISTIC /end GROUP
/begin GROUP McuFunSafeMonitor_MFSM_FuncSafetyRedundancy_1ms_sys_Subsystem_MtrTempSensorShortPwr_Parameter6 "McuFunSafeMonitor/MFSM_FuncSafetyRedundancy_1ms_sys/Subsystem/MtrTempSensorShortPwr/Parameter6" /begin REF_CHARACTERISTIC MFSM_MtrTempSensorNShortPwr_C /end REF_CHARACTERISTIC /end GROUP
/begin GROUP McuFunSafeMonitor_MFSM_FuncSafetyRedundancy_1ms_sys_Subsystem_SensorVoltConsistencyChk "McuFunSafeMonitor/MFSM_FuncSafetyRedundancy_1ms_sys/Subsystem/SensorVoltConsistencyChk"
 /begin SUB_GROUP McuFunSafeMonitor_MFSM_FuncSafetyRedundancy_1ms_sys_Subsystem_SensorVoltConsistencyChk_FaultDebounce McuFunSafeMonitor_MFSM_FuncSafetyRedundancy_1ms_sys_Subsystem_SensorVoltConsistencyChk_Local_Variable_Storage1 McuFunSafeMonitor_MFSM_FuncSafetyRedundancy_1ms_sys_Subsystem_SensorVoltConsistencyChk_Parameter1 McuFunSafeMonitor_MFSM_FuncSafetyRedundancy_1ms_sys_Subsystem_SensorVoltConsistencyChk_Parameter2 McuFunSafeMonitor_MFSM_FuncSafetyRedundancy_1ms_sys_Subsystem_SensorVoltConsistencyChk_Parameter3 McuFunSafeMonitor_MFSM_FuncSafetyRedundancy_1ms_sys_Subsystem_SensorVoltConsistencyChk_Parameter4 McuFunSafeMonitor_MFSM_FuncSafetyRedundancy_1ms_sys_Subsystem_SensorVoltConsistencyChk_Parameter5 /end SUB_GROUP
 /begin REF_MEASUREMENT McuFunSafeMonitor_B.DataTypeConversion_lp McuFunSafeMonitor_ConstB.DataTypeConversion1_n2 SGSA_PwrChipVolt /end REF_MEASUREMENT
/end GROUP
/begin GROUP McuFunSafeMonitor_MFSM_FuncSafetyRedundancy_1ms_sys_Subsystem_SensorVoltConsistencyChk_FaultDebounce "McuFunSafeMonitor/MFSM_FuncSafetyRedundancy_1ms_sys/Subsystem/SensorVoltConsistencyChk/FaultDebounce"
 /begin SUB_GROUP McuFunSafeMonitor_MFSM_FuncSafetyRedundancy_1ms_sys_Subsystem_SensorVoltConsistencyChk_FaultDebounce_Subsystem McuFunSafeMonitor_MFSM_FuncSafetyRedundancy_1ms_sys_Subsystem_SensorVoltConsistencyChk_FaultDebounce_UnitDelay /end SUB_GROUP
/end GROUP
/begin GROUP McuFunSafeMonitor_MFSM_FuncSafetyRedundancy_1ms_sys_Subsystem_SensorVoltConsistencyChk_FaultDebounce_Subsystem "McuFunSafeMonitor/MFSM_FuncSafetyRedundancy_1ms_sys/Subsystem/SensorVoltConsistencyChk/FaultDebounce/Subsystem" /begin REF_MEASUREMENT McuFunSafeMonitor_DW.Memory_PreviousInput_eb /end REF_MEASUREMENT /end GROUP
/begin GROUP McuFunSafeMonitor_MFSM_FuncSafetyRedundancy_1ms_sys_Subsystem_SensorVoltConsistencyChk_FaultDebounce_UnitDelay "McuFunSafeMonitor/MFSM_FuncSafetyRedundancy_1ms_sys/Subsystem/SensorVoltConsistencyChk/FaultDebounce/UnitDelay"
 /begin REF_MEASUREMENT McuFunSafeMonitor_ConstB.DataTypeConversion1_n2 McuFunSafeMonitor_ConstB.LogicalOperator1_fw McuFunSafeMonitor_DW.BareUnitDelay_DSTATE_k3 /end REF_MEASUREMENT
/end GROUP
/begin GROUP McuFunSafeMonitor_MFSM_FuncSafetyRedundancy_1ms_sys_Subsystem_SensorVoltConsistencyChk_Local_Variable_Storage1 "McuFunSafeMonitor/MFSM_FuncSafetyRedundancy_1ms_sys/Subsystem/SensorVoltConsistencyChk/Local Variable Storage1" /begin REF_MEASUREMENT MFSM_PwrChipVoltDiff /end REF_MEASUREMENT /end GROUP
/begin GROUP McuFunSafeMonitor_MFSM_FuncSafetyRedundancy_1ms_sys_Subsystem_SensorVoltConsistencyChk_Parameter1 "McuFunSafeMonitor/MFSM_FuncSafetyRedundancy_1ms_sys/Subsystem/SensorVoltConsistencyChk/Parameter1" /begin REF_CHARACTERISTIC MFSM_SensorVoltDiff_C /end REF_CHARACTERISTIC /end GROUP
/begin GROUP McuFunSafeMonitor_MFSM_FuncSafetyRedundancy_1ms_sys_Subsystem_SensorVoltConsistencyChk_Parameter2 "McuFunSafeMonitor/MFSM_FuncSafetyRedundancy_1ms_sys/Subsystem/SensorVoltConsistencyChk/Parameter2" /begin REF_CHARACTERISTIC MFSM_DebounceMaxSensorVolt_C /end REF_CHARACTERISTIC /end GROUP
/begin GROUP McuFunSafeMonitor_MFSM_FuncSafetyRedundancy_1ms_sys_Subsystem_SensorVoltConsistencyChk_Parameter3 "McuFunSafeMonitor/MFSM_FuncSafetyRedundancy_1ms_sys/Subsystem/SensorVoltConsistencyChk/Parameter3" /begin REF_CHARACTERISTIC MFSM_DebounceIncrSensorVolt_C /end REF_CHARACTERISTIC /end GROUP
/begin GROUP McuFunSafeMonitor_MFSM_FuncSafetyRedundancy_1ms_sys_Subsystem_SensorVoltConsistencyChk_Parameter4 "McuFunSafeMonitor/MFSM_FuncSafetyRedundancy_1ms_sys/Subsystem/SensorVoltConsistencyChk/Parameter4" /begin REF_CHARACTERISTIC MFSM_DebounceDecrSensorVolt_C /end REF_CHARACTERISTIC /end GROUP
/begin GROUP McuFunSafeMonitor_MFSM_FuncSafetyRedundancy_1ms_sys_Subsystem_SensorVoltConsistencyChk_Parameter5 "McuFunSafeMonitor/MFSM_FuncSafetyRedundancy_1ms_sys/Subsystem/SensorVoltConsistencyChk/Parameter5" /begin REF_CHARACTERISTIC MFSM_DebounceMinSensorVolt_C /end REF_CHARACTERISTIC /end GROUP
/begin GROUP McuFunSafeMonitor_MFSM_FuncSafetyRedundancy_1ms_sys_Subsystem_TorqueDeviationFault "McuFunSafeMonitor/MFSM_FuncSafetyRedundancy_1ms_sys/Subsystem/TorqueDeviationFault"
 /begin SUB_GROUP McuFunSafeMonitor_MFSM_FuncSafetyRedundancy_1ms_sys_Subsystem_TorqueDeviationFault_FaultDebounce McuFunSafeMonitor_MFSM_FuncSafetyRedundancy_1ms_sys_Subsystem_TorqueDeviationFault_Local_Variable_Storage1 McuFunSafeMonitor_MFSM_FuncSafetyRedundancy_1ms_sys_Subsystem_TorqueDeviationFault_Parameter1 McuFunSafeMonitor_MFSM_FuncSafetyRedundancy_1ms_sys_Subsystem_TorqueDeviationFault_Parameter2 McuFunSafeMonitor_MFSM_FuncSafetyRedundancy_1ms_sys_Subsystem_TorqueDeviationFault_Parameter3 McuFunSafeMonitor_MFSM_FuncSafetyRedundancy_1ms_sys_Subsystem_TorqueDeviationFault_Parameter4 McuFunSafeMonitor_MFSM_FuncSafetyRedundancy_1ms_sys_Subsystem_TorqueDeviationFault_Parameter5 McuFunSafeMonitor_MFSM_FuncSafetyRedundancy_1ms_sys_Subsystem_TorqueDeviationFault_Subsystem /end SUB_GROUP
 /begin REF_MEASUREMENT McuFunSafeMonitor_B.DataTypeConversion_cs McuFunSafeMonitor_ConstB.DataTypeConversion1_pu /end REF_MEASUREMENT
/end GROUP
/begin GROUP McuFunSafeMonitor_MFSM_FuncSafetyRedundancy_1ms_sys_Subsystem_TorqueDeviationFault_FaultDebounce "McuFunSafeMonitor/MFSM_FuncSafetyRedundancy_1ms_sys/Subsystem/TorqueDeviationFault/FaultDebounce"
 /begin SUB_GROUP McuFunSafeMonitor_MFSM_FuncSafetyRedundancy_1ms_sys_Subsystem_TorqueDeviationFault_FaultDebounce_Subsystem McuFunSafeMonitor_MFSM_FuncSafetyRedundancy_1ms_sys_Subsystem_TorqueDeviationFault_FaultDebounce_UnitDelay /end SUB_GROUP
/end GROUP
/begin GROUP McuFunSafeMonitor_MFSM_FuncSafetyRedundancy_1ms_sys_Subsystem_TorqueDeviationFault_FaultDebounce_Subsystem "McuFunSafeMonitor/MFSM_FuncSafetyRedundancy_1ms_sys/Subsystem/TorqueDeviationFault/FaultDebounce/Subsystem" /begin REF_MEASUREMENT McuFunSafeMonitor_DW.Memory_PreviousInput_o3 /end REF_MEASUREMENT /end GROUP
/begin GROUP McuFunSafeMonitor_MFSM_FuncSafetyRedundancy_1ms_sys_Subsystem_TorqueDeviationFault_FaultDebounce_UnitDelay "McuFunSafeMonitor/MFSM_FuncSafetyRedundancy_1ms_sys/Subsystem/TorqueDeviationFault/FaultDebounce/UnitDelay"
 /begin REF_MEASUREMENT McuFunSafeMonitor_ConstB.DataTypeConversion1_pu McuFunSafeMonitor_ConstB.LogicalOperator1_lm McuFunSafeMonitor_DW.BareUnitDelay_DSTATE_ov /end REF_MEASUREMENT
/end GROUP
/begin GROUP McuFunSafeMonitor_MFSM_FuncSafetyRedundancy_1ms_sys_Subsystem_TorqueDeviationFault_Local_Variable_Storage1 "McuFunSafeMonitor/MFSM_FuncSafetyRedundancy_1ms_sys/Subsystem/TorqueDeviationFault/Local Variable Storage1" /begin REF_MEASUREMENT MFSM_TqDiff /end REF_MEASUREMENT /end GROUP
/begin GROUP McuFunSafeMonitor_MFSM_FuncSafetyRedundancy_1ms_sys_Subsystem_TorqueDeviationFault_Parameter1 "McuFunSafeMonitor/MFSM_FuncSafetyRedundancy_1ms_sys/Subsystem/TorqueDeviationFault/Parameter1" /begin REF_CHARACTERISTIC MFSM_TorqueDiff_C /end REF_CHARACTERISTIC /end GROUP
/begin GROUP McuFunSafeMonitor_MFSM_FuncSafetyRedundancy_1ms_sys_Subsystem_TorqueDeviationFault_Parameter2 "McuFunSafeMonitor/MFSM_FuncSafetyRedundancy_1ms_sys/Subsystem/TorqueDeviationFault/Parameter2" /begin REF_CHARACTERISTIC MFSM_DebounceMaxTqDiff_C /end REF_CHARACTERISTIC /end GROUP
/begin GROUP McuFunSafeMonitor_MFSM_FuncSafetyRedundancy_1ms_sys_Subsystem_TorqueDeviationFault_Parameter3 "McuFunSafeMonitor/MFSM_FuncSafetyRedundancy_1ms_sys/Subsystem/TorqueDeviationFault/Parameter3" /begin REF_CHARACTERISTIC MFSM_DebounceIncrTqDiff_C /end REF_CHARACTERISTIC /end GROUP
/begin GROUP McuFunSafeMonitor_MFSM_FuncSafetyRedundancy_1ms_sys_Subsystem_TorqueDeviationFault_Parameter4 "McuFunSafeMonitor/MFSM_FuncSafetyRedundancy_1ms_sys/Subsystem/TorqueDeviationFault/Parameter4" /begin REF_CHARACTERISTIC MFSM_DebounceDecrTqDiff_C /end REF_CHARACTERISTIC /end GROUP
/begin GROUP McuFunSafeMonitor_MFSM_FuncSafetyRedundancy_1ms_sys_Subsystem_TorqueDeviationFault_Parameter5 "McuFunSafeMonitor/MFSM_FuncSafetyRedundancy_1ms_sys/Subsystem/TorqueDeviationFault/Parameter5" /begin REF_CHARACTERISTIC MFSM_DebounceMinTqDiff_C /end REF_CHARACTERISTIC /end GROUP
/begin GROUP McuFunSafeMonitor_MFSM_FuncSafetyRedundancy_1ms_sys_Subsystem_TorqueDeviationFault_Subsystem "McuFunSafeMonitor/MFSM_FuncSafetyRedundancy_1ms_sys/Subsystem/TorqueDeviationFault/Subsystem" /begin REF_MEASUREMENT IPU_IsgTqActIsgTqAct /end REF_MEASUREMENT /end GROUP
/begin GROUP McuFunSafeMonitor_MFSM_FuncSafetyRedundancy_96us_sys "McuFunSafeMonitor/MFSM_FuncSafetyRedundancy_96us_sys"
 /begin SUB_GROUP McuFunSafeMonitor_MFSM_FuncSafetyRedundancy_96us_sys_EnFastDiag McuFunSafeMonitor_MFSM_FuncSafetyRedundancy_96us_sys_Subsystem /end SUB_GROUP
/end GROUP
/begin GROUP McuFunSafeMonitor_MFSM_FuncSafetyRedundancy_96us_sys_EnFastDiag "McuFunSafeMonitor/MFSM_FuncSafetyRedundancy_96us_sys/EnFastDiag"
 /begin SUB_GROUP McuFunSafeMonitor_MFSM_FuncSafetyRedundancy_96us_sys_EnFastDiag_Parameter /end SUB_GROUP
 /begin REF_MEASUREMENT McuFunSafeMonitor_DW.UnitDelay_DSTATE_p /end REF_MEASUREMENT
/end GROUP
/begin GROUP McuFunSafeMonitor_MFSM_FuncSafetyRedundancy_96us_sys_EnFastDiag_Parameter "McuFunSafeMonitor/MFSM_FuncSafetyRedundancy_96us_sys/EnFastDiag/Parameter" /begin REF_CHARACTERISTIC MFSM_FastDiagInitTimeCount_C /end REF_CHARACTERISTIC /end GROUP
/begin GROUP McuFunSafeMonitor_MFSM_FuncSafetyRedundancy_96us_sys_Subsystem "McuFunSafeMonitor/MFSM_FuncSafetyRedundancy_96us_sys/Subsystem"
 /begin SUB_GROUP McuFunSafeMonitor_MFSM_FuncSafetyRedundancy_96us_sys_Subsystem_BusCurrentEstimate McuFunSafeMonitor_MFSM_FuncSafetyRedundancy_96us_sys_Subsystem_CosOpenFualt McuFunSafeMonitor_MFSM_FuncSafetyRedundancy_96us_sys_Subsystem_CosSigShortGndFualt McuFunSafeMonitor_MFSM_FuncSafetyRedundancy_96us_sys_Subsystem_CosSigShortPwrFualt McuFunSafeMonitor_MFSM_FuncSafetyRedundancy_96us_sys_Subsystem_ExcAmpFualt McuFunSafeMonitor_MFSM_FuncSafetyRedundancy_96us_sys_Subsystem_ExcOpenFualt McuFunSafeMonitor_MFSM_FuncSafetyRedundancy_96us_sys_Subsystem_ExcShortGndFualt McuFunSafeMonitor_MFSM_FuncSafetyRedundancy_96us_sys_Subsystem_ExcShortPwrFualt McuFunSafeMonitor_MFSM_FuncSafetyRedundancy_96us_sys_Subsystem_Function_Caller McuFunSafeMonitor_MFSM_FuncSafetyRedundancy_96us_sys_Subsystem_PhaseCurrrentAmpFault McuFunSafeMonitor_MFSM_FuncSafetyRedundancy_96us_sys_Subsystem_PhaseCurrrentOpen McuFunSafeMonitor_MFSM_FuncSafetyRedundancy_96us_sys_Subsystem_PhaseCurrrentShortGnd McuFunSafeMonitor_MFSM_FuncSafetyRedundancy_96us_sys_Subsystem_PhaseCurrrentShortPwr McuFunSafeMonitor_MFSM_FuncSafetyRedundancy_96us_sys_Subsystem_RslvrAmpFualt McuFunSafeMonitor_MFSM_FuncSafetyRedundancy_96us_sys_Subsystem_SinOpenFualt McuFunSafeMonitor_MFSM_FuncSafetyRedundancy_96us_sys_Subsystem_SinSigShortGndFualt McuFunSafeMonitor_MFSM_FuncSafetyRedundancy_96us_sys_Subsystem_SinSigShortPwrFualt McuFunSafeMonitor_MFSM_FuncSafetyRedundancy_96us_sys_Subsystem_TorqueEstimate /end SUB_GROUP
/end GROUP
/begin GROUP McuFunSafeMonitor_MFSM_FuncSafetyRedundancy_96us_sys_Subsystem_BusCurrentEstimate "McuFunSafeMonitor/MFSM_FuncSafetyRedundancy_96us_sys/Subsystem/BusCurrentEstimate"
 /begin SUB_GROUP McuFunSafeMonitor_MFSM_FuncSafetyRedundancy_96us_sys_Subsystem_BusCurrentEstimate_LowPassFilter McuFunSafeMonitor_MFSM_FuncSafetyRedundancy_96us_sys_Subsystem_BusCurrentEstimate_Parameter1 McuFunSafeMonitor_MFSM_FuncSafetyRedundancy_96us_sys_Subsystem_BusCurrentEstimate_bus_current_calculate McuFunSafeMonitor_MFSM_FuncSafetyRedundancy_96us_sys_Subsystem_BusCurrentEstimate_bus_current_select McuFunSafeMonitor_MFSM_FuncSafetyRedundancy_96us_sys_Subsystem_BusCurrentEstimate_current_compensate /end SUB_GROUP
 /begin REF_MEASUREMENT McuFunSafeMonitor_B.Add1 /end REF_MEASUREMENT
/end GROUP
/begin GROUP McuFunSafeMonitor_MFSM_FuncSafetyRedundancy_96us_sys_Subsystem_BusCurrentEstimate_LowPassFilter "McuFunSafeMonitor/MFSM_FuncSafetyRedundancy_96us_sys/Subsystem/BusCurrentEstimate/LowPassFilter" /begin REF_MEASUREMENT McuFunSafeMonitor_DW.Delay_DSTATE_h /end REF_MEASUREMENT /end GROUP
/begin GROUP McuFunSafeMonitor_MFSM_FuncSafetyRedundancy_96us_sys_Subsystem_BusCurrentEstimate_Parameter1 "McuFunSafeMonitor/MFSM_FuncSafetyRedundancy_96us_sys/Subsystem/BusCurrentEstimate/Parameter1" /begin REF_CHARACTERISTIC MFSM_BusCurrentFilterFreq_C /end REF_CHARACTERISTIC /end GROUP
/begin GROUP McuFunSafeMonitor_MFSM_FuncSafetyRedundancy_96us_sys_Subsystem_BusCurrentEstimate_bus_current_calculate "McuFunSafeMonitor/MFSM_FuncSafetyRedundancy_96us_sys/Subsystem/BusCurrentEstimate/bus current calculate"
 /begin SUB_GROUP McuFunSafeMonitor_MFSM_FuncSafetyRedundancy_96us_sys_Subsystem_BusCurrentEstimate_bus_current_calculate_Local_Variable_Storage1 /end SUB_GROUP
 /begin REF_MEASUREMENT McuFunSafeMonitor_DW.Delay1_DSTATE McuFunSafeMonitor_DW.Delay2_DSTATE McuFunSafeMonitor_DW.Delay_DSTATE SGPP_BSW_f32_iSmpPhaU_A SGPP_BSW_f32_iSmpPhaW_A SGPP_PhaseADuty SGPP_PhaseBDuty SGPP_PhaseCDuty /end REF_MEASUREMENT
/end GROUP
/begin GROUP McuFunSafeMonitor_MFSM_FuncSafetyRedundancy_96us_sys_Subsystem_BusCurrentEstimate_bus_current_calculate_Local_Variable_Storage1 "McuFunSafeMonitor/MFSM_FuncSafetyRedundancy_96us_sys/Subsystem/BusCurrentEstimate/bus current calculate/Local Variable Storage1" /begin REF_MEASUREMENT MFSM_PhaseBCurrent /end REF_MEASUREMENT /end GROUP
/begin GROUP McuFunSafeMonitor_MFSM_FuncSafetyRedundancy_96us_sys_Subsystem_BusCurrentEstimate_bus_current_select "McuFunSafeMonitor/MFSM_FuncSafetyRedundancy_96us_sys/Subsystem/BusCurrentEstimate/bus current select"
 /begin SUB_GROUP McuFunSafeMonitor_MFSM_FuncSafetyRedundancy_96us_sys_Subsystem_BusCurrentEstimate_bus_current_select_Parameter2 McuFunSafeMonitor_MFSM_FuncSafetyRedundancy_96us_sys_Subsystem_BusCurrentEstimate_bus_current_select_Parameter5 /end SUB_GROUP
 /begin REF_CHARACTERISTIC MFSM_BusCurrentCompCoeff_M MFSM_MechSpd_A /end REF_CHARACTERISTIC
 /begin REF_MEASUREMENT SGPP_BSW_f32_nRotateSpd_rpm /end REF_MEASUREMENT
/end GROUP
/begin GROUP McuFunSafeMonitor_MFSM_FuncSafetyRedundancy_96us_sys_Subsystem_BusCurrentEstimate_bus_current_select_Parameter2 "McuFunSafeMonitor/MFSM_FuncSafetyRedundancy_96us_sys/Subsystem/BusCurrentEstimate/bus current select/Parameter2" /begin REF_CHARACTERISTIC MFSM_BusCurrentCalCoeff_C /end REF_CHARACTERISTIC /end GROUP
/begin GROUP McuFunSafeMonitor_MFSM_FuncSafetyRedundancy_96us_sys_Subsystem_BusCurrentEstimate_bus_current_select_Parameter5 "McuFunSafeMonitor/MFSM_FuncSafetyRedundancy_96us_sys/Subsystem/BusCurrentEstimate/bus current select/Parameter5" /begin REF_CHARACTERISTIC MFSM_BusCurrentCalCoeffSel_C /end REF_CHARACTERISTIC /end GROUP
/begin GROUP McuFunSafeMonitor_MFSM_FuncSafetyRedundancy_96us_sys_Subsystem_BusCurrentEstimate_current_compensate "McuFunSafeMonitor/MFSM_FuncSafetyRedundancy_96us_sys/Subsystem/BusCurrentEstimate/current compensate"
 /begin SUB_GROUP McuFunSafeMonitor_MFSM_FuncSafetyRedundancy_96us_sys_Subsystem_BusCurrentEstimate_current_compensate_Parameter3 /end SUB_GROUP
 /begin REF_CHARACTERISTIC MFSM_BusCurrentComp_M MFSM_LpfBusCurrent_A /end REF_CHARACTERISTIC
/end GROUP
/begin GROUP McuFunSafeMonitor_MFSM_FuncSafetyRedundancy_96us_sys_Subsystem_BusCurrentEstimate_current_compensate_Parameter3 "McuFunSafeMonitor/MFSM_FuncSafetyRedundancy_96us_sys/Subsystem/BusCurrentEstimate/current compensate/Parameter3" /begin REF_CHARACTERISTIC MFSM_BusCurrentCompEna_C /end REF_CHARACTERISTIC /end GROUP
/begin GROUP McuFunSafeMonitor_MFSM_FuncSafetyRedundancy_96us_sys_Subsystem_CosOpenFualt "McuFunSafeMonitor/MFSM_FuncSafetyRedundancy_96us_sys/Subsystem/CosOpenFualt"
 /begin SUB_GROUP McuFunSafeMonitor_MFSM_FuncSafetyRedundancy_96us_sys_Subsystem_CosOpenFualt_FaultDebounce McuFunSafeMonitor_MFSM_FuncSafetyRedundancy_96us_sys_Subsystem_CosOpenFualt_Local_Variable_Storage1 McuFunSafeMonitor_MFSM_FuncSafetyRedundancy_96us_sys_Subsystem_CosOpenFualt_Local_Variable_Storage3 McuFunSafeMonitor_MFSM_FuncSafetyRedundancy_96us_sys_Subsystem_CosOpenFualt_Parameter1 McuFunSafeMonitor_MFSM_FuncSafetyRedundancy_96us_sys_Subsystem_CosOpenFualt_Parameter2 McuFunSafeMonitor_MFSM_FuncSafetyRedundancy_96us_sys_Subsystem_CosOpenFualt_Parameter3 McuFunSafeMonitor_MFSM_FuncSafetyRedundancy_96us_sys_Subsystem_CosOpenFualt_Parameter4 McuFunSafeMonitor_MFSM_FuncSafetyRedundancy_96us_sys_Subsystem_CosOpenFualt_Parameter5 McuFunSafeMonitor_MFSM_FuncSafetyRedundancy_96us_sys_Subsystem_CosOpenFualt_Parameter6 /end SUB_GROUP
 /begin REF_MEASUREMENT McuFunSafeMonitor_B.DataTypeConversion_m McuFunSafeMonitor_ConstB.DataTypeConversion1_m /end REF_MEASUREMENT
/end GROUP
/begin GROUP McuFunSafeMonitor_MFSM_FuncSafetyRedundancy_96us_sys_Subsystem_CosOpenFualt_FaultDebounce "McuFunSafeMonitor/MFSM_FuncSafetyRedundancy_96us_sys/Subsystem/CosOpenFualt/FaultDebounce"
 /begin SUB_GROUP McuFunSafeMonitor_MFSM_FuncSafetyRedundancy_96us_sys_Subsystem_CosOpenFualt_FaultDebounce_Subsystem McuFunSafeMonitor_MFSM_FuncSafetyRedundancy_96us_sys_Subsystem_CosOpenFualt_FaultDebounce_UnitDelay /end SUB_GROUP
/end GROUP
/begin GROUP McuFunSafeMonitor_MFSM_FuncSafetyRedundancy_96us_sys_Subsystem_CosOpenFualt_FaultDebounce_Subsystem "McuFunSafeMonitor/MFSM_FuncSafetyRedundancy_96us_sys/Subsystem/CosOpenFualt/FaultDebounce/Subsystem" /begin REF_MEASUREMENT McuFunSafeMonitor_DW.Memory_PreviousInput_p /end REF_MEASUREMENT /end GROUP
/begin GROUP McuFunSafeMonitor_MFSM_FuncSafetyRedundancy_96us_sys_Subsystem_CosOpenFualt_FaultDebounce_UnitDelay "McuFunSafeMonitor/MFSM_FuncSafetyRedundancy_96us_sys/Subsystem/CosOpenFualt/FaultDebounce/UnitDelay"
 /begin REF_MEASUREMENT McuFunSafeMonitor_ConstB.DataTypeConversion1_m McuFunSafeMonitor_ConstB.LogicalOperator1_f McuFunSafeMonitor_DW.BareUnitDelay_DSTATE_p /end REF_MEASUREMENT
/end GROUP
/begin GROUP McuFunSafeMonitor_MFSM_FuncSafetyRedundancy_96us_sys_Subsystem_CosOpenFualt_Local_Variable_Storage1 "McuFunSafeMonitor/MFSM_FuncSafetyRedundancy_96us_sys/Subsystem/CosOpenFualt/Local Variable Storage1" /begin REF_MEASUREMENT MFSM_CosSum /end REF_MEASUREMENT /end GROUP
/begin GROUP McuFunSafeMonitor_MFSM_FuncSafetyRedundancy_96us_sys_Subsystem_CosOpenFualt_Local_Variable_Storage3 "McuFunSafeMonitor/MFSM_FuncSafetyRedundancy_96us_sys/Subsystem/CosOpenFualt/Local Variable Storage3" /begin REF_MEASUREMENT MFSM_CosDiff /end REF_MEASUREMENT /end GROUP
/begin GROUP McuFunSafeMonitor_MFSM_FuncSafetyRedundancy_96us_sys_Subsystem_CosOpenFualt_Parameter1 "McuFunSafeMonitor/MFSM_FuncSafetyRedundancy_96us_sys/Subsystem/CosOpenFualt/Parameter1" /begin REF_CHARACTERISTIC MFSM_MinCosOpenValue_C /end REF_CHARACTERISTIC /end GROUP
/begin GROUP McuFunSafeMonitor_MFSM_FuncSafetyRedundancy_96us_sys_Subsystem_CosOpenFualt_Parameter2 "McuFunSafeMonitor/MFSM_FuncSafetyRedundancy_96us_sys/Subsystem/CosOpenFualt/Parameter2" /begin REF_CHARACTERISTIC MFSM_DebounceMaxCosOpen_C /end REF_CHARACTERISTIC /end GROUP
/begin GROUP McuFunSafeMonitor_MFSM_FuncSafetyRedundancy_96us_sys_Subsystem_CosOpenFualt_Parameter3 "McuFunSafeMonitor/MFSM_FuncSafetyRedundancy_96us_sys/Subsystem/CosOpenFualt/Parameter3" /begin REF_CHARACTERISTIC MFSM_DebounceIncrCosOpen_C /end REF_CHARACTERISTIC /end GROUP
/begin GROUP McuFunSafeMonitor_MFSM_FuncSafetyRedundancy_96us_sys_Subsystem_CosOpenFualt_Parameter4 "McuFunSafeMonitor/MFSM_FuncSafetyRedundancy_96us_sys/Subsystem/CosOpenFualt/Parameter4" /begin REF_CHARACTERISTIC MFSM_DebounceDecrCosOpen_C /end REF_CHARACTERISTIC /end GROUP
/begin GROUP McuFunSafeMonitor_MFSM_FuncSafetyRedundancy_96us_sys_Subsystem_CosOpenFualt_Parameter5 "McuFunSafeMonitor/MFSM_FuncSafetyRedundancy_96us_sys/Subsystem/CosOpenFualt/Parameter5" /begin REF_CHARACTERISTIC MFSM_DebounceMinCosOpen_C /end REF_CHARACTERISTIC /end GROUP
/begin GROUP McuFunSafeMonitor_MFSM_FuncSafetyRedundancy_96us_sys_Subsystem_CosOpenFualt_Parameter6 "McuFunSafeMonitor/MFSM_FuncSafetyRedundancy_96us_sys/Subsystem/CosOpenFualt/Parameter6" /begin REF_CHARACTERISTIC MFSM_MaxCosOpenValue_C /end REF_CHARACTERISTIC /end GROUP
/begin GROUP McuFunSafeMonitor_MFSM_FuncSafetyRedundancy_96us_sys_Subsystem_CosSigShortGndFualt "McuFunSafeMonitor/MFSM_FuncSafetyRedundancy_96us_sys/Subsystem/CosSigShortGndFualt"
 /begin SUB_GROUP McuFunSafeMonitor_MFSM_FuncSafetyRedundancy_96us_sys_Subsystem_CosSigShortGndFualt_FaultDebounce McuFunSafeMonitor_MFSM_FuncSafetyRedundancy_96us_sys_Subsystem_CosSigShortGndFualt_Parameter1 McuFunSafeMonitor_MFSM_FuncSafetyRedundancy_96us_sys_Subsystem_CosSigShortGndFualt_Parameter2 McuFunSafeMonitor_MFSM_FuncSafetyRedundancy_96us_sys_Subsystem_CosSigShortGndFualt_Parameter3 McuFunSafeMonitor_MFSM_FuncSafetyRedundancy_96us_sys_Subsystem_CosSigShortGndFualt_Parameter4 McuFunSafeMonitor_MFSM_FuncSafetyRedundancy_96us_sys_Subsystem_CosSigShortGndFualt_Parameter5 /end SUB_GROUP
 /begin REF_MEASUREMENT McuFunSafeMonitor_B.DataTypeConversion_oi McuFunSafeMonitor_ConstB.DataTypeConversion1_h /end REF_MEASUREMENT
/end GROUP
/begin GROUP McuFunSafeMonitor_MFSM_FuncSafetyRedundancy_96us_sys_Subsystem_CosSigShortGndFualt_FaultDebounce "McuFunSafeMonitor/MFSM_FuncSafetyRedundancy_96us_sys/Subsystem/CosSigShortGndFualt/FaultDebounce"
 /begin SUB_GROUP McuFunSafeMonitor_MFSM_FuncSafetyRedundancy_96us_sys_Subsystem_CosSigShortGndFualt_FaultDebounce_Subsystem McuFunSafeMonitor_MFSM_FuncSafetyRedundancy_96us_sys_Subsystem_CosSigShortGndFualt_FaultDebounce_UnitDelay /end SUB_GROUP
/end GROUP
/begin GROUP McuFunSafeMonitor_MFSM_FuncSafetyRedundancy_96us_sys_Subsystem_CosSigShortGndFualt_FaultDebounce_Subsystem "McuFunSafeMonitor/MFSM_FuncSafetyRedundancy_96us_sys/Subsystem/CosSigShortGndFualt/FaultDebounce/Subsystem" /begin REF_MEASUREMENT McuFunSafeMonitor_DW.Memory_PreviousInput_l /end REF_MEASUREMENT /end GROUP
/begin GROUP McuFunSafeMonitor_MFSM_FuncSafetyRedundancy_96us_sys_Subsystem_CosSigShortGndFualt_FaultDebounce_UnitDelay "McuFunSafeMonitor/MFSM_FuncSafetyRedundancy_96us_sys/Subsystem/CosSigShortGndFualt/FaultDebounce/UnitDelay"
 /begin REF_MEASUREMENT McuFunSafeMonitor_ConstB.DataTypeConversion1_h McuFunSafeMonitor_ConstB.LogicalOperator1_g0 McuFunSafeMonitor_DW.BareUnitDelay_DSTATE_a /end REF_MEASUREMENT
/end GROUP
/begin GROUP McuFunSafeMonitor_MFSM_FuncSafetyRedundancy_96us_sys_Subsystem_CosSigShortGndFualt_Parameter1 "McuFunSafeMonitor/MFSM_FuncSafetyRedundancy_96us_sys/Subsystem/CosSigShortGndFualt/Parameter1" /begin REF_CHARACTERISTIC MFSM_CosShortGndValue_C /end REF_CHARACTERISTIC /end GROUP
/begin GROUP McuFunSafeMonitor_MFSM_FuncSafetyRedundancy_96us_sys_Subsystem_CosSigShortGndFualt_Parameter2 "McuFunSafeMonitor/MFSM_FuncSafetyRedundancy_96us_sys/Subsystem/CosSigShortGndFualt/Parameter2" /begin REF_CHARACTERISTIC MFSM_DebounceMaxCosShortGnd_C /end REF_CHARACTERISTIC /end GROUP
/begin GROUP McuFunSafeMonitor_MFSM_FuncSafetyRedundancy_96us_sys_Subsystem_CosSigShortGndFualt_Parameter3 "McuFunSafeMonitor/MFSM_FuncSafetyRedundancy_96us_sys/Subsystem/CosSigShortGndFualt/Parameter3" /begin REF_CHARACTERISTIC MFSM_DebounceIncrCosShortGnd_C /end REF_CHARACTERISTIC /end GROUP
/begin GROUP McuFunSafeMonitor_MFSM_FuncSafetyRedundancy_96us_sys_Subsystem_CosSigShortGndFualt_Parameter4 "McuFunSafeMonitor/MFSM_FuncSafetyRedundancy_96us_sys/Subsystem/CosSigShortGndFualt/Parameter4" /begin REF_CHARACTERISTIC MFSM_DebounceDecrCosShortGnd_C /end REF_CHARACTERISTIC /end GROUP
/begin GROUP McuFunSafeMonitor_MFSM_FuncSafetyRedundancy_96us_sys_Subsystem_CosSigShortGndFualt_Parameter5 "McuFunSafeMonitor/MFSM_FuncSafetyRedundancy_96us_sys/Subsystem/CosSigShortGndFualt/Parameter5" /begin REF_CHARACTERISTIC MFSM_DebounceMinCosShortGnd_C /end REF_CHARACTERISTIC /end GROUP
/begin GROUP McuFunSafeMonitor_MFSM_FuncSafetyRedundancy_96us_sys_Subsystem_CosSigShortPwrFualt "McuFunSafeMonitor/MFSM_FuncSafetyRedundancy_96us_sys/Subsystem/CosSigShortPwrFualt"
 /begin SUB_GROUP McuFunSafeMonitor_MFSM_FuncSafetyRedundancy_96us_sys_Subsystem_CosSigShortPwrFualt_FaultDebounce McuFunSafeMonitor_MFSM_FuncSafetyRedundancy_96us_sys_Subsystem_CosSigShortPwrFualt_Parameter1 McuFunSafeMonitor_MFSM_FuncSafetyRedundancy_96us_sys_Subsystem_CosSigShortPwrFualt_Parameter2 McuFunSafeMonitor_MFSM_FuncSafetyRedundancy_96us_sys_Subsystem_CosSigShortPwrFualt_Parameter3 McuFunSafeMonitor_MFSM_FuncSafetyRedundancy_96us_sys_Subsystem_CosSigShortPwrFualt_Parameter4 McuFunSafeMonitor_MFSM_FuncSafetyRedundancy_96us_sys_Subsystem_CosSigShortPwrFualt_Parameter5 /end SUB_GROUP
 /begin REF_MEASUREMENT McuFunSafeMonitor_B.DataTypeConversion_l McuFunSafeMonitor_ConstB.DataTypeConversion1_o /end REF_MEASUREMENT
/end GROUP
/begin GROUP McuFunSafeMonitor_MFSM_FuncSafetyRedundancy_96us_sys_Subsystem_CosSigShortPwrFualt_FaultDebounce "McuFunSafeMonitor/MFSM_FuncSafetyRedundancy_96us_sys/Subsystem/CosSigShortPwrFualt/FaultDebounce"
 /begin SUB_GROUP McuFunSafeMonitor_MFSM_FuncSafetyRedundancy_96us_sys_Subsystem_CosSigShortPwrFualt_FaultDebounce_Subsystem McuFunSafeMonitor_MFSM_FuncSafetyRedundancy_96us_sys_Subsystem_CosSigShortPwrFualt_FaultDebounce_UnitDelay /end SUB_GROUP
/end GROUP
/begin GROUP McuFunSafeMonitor_MFSM_FuncSafetyRedundancy_96us_sys_Subsystem_CosSigShortPwrFualt_FaultDebounce_Subsystem "McuFunSafeMonitor/MFSM_FuncSafetyRedundancy_96us_sys/Subsystem/CosSigShortPwrFualt/FaultDebounce/Subsystem" /begin REF_MEASUREMENT McuFunSafeMonitor_DW.Memory_PreviousInput_d /end REF_MEASUREMENT /end GROUP
/begin GROUP McuFunSafeMonitor_MFSM_FuncSafetyRedundancy_96us_sys_Subsystem_CosSigShortPwrFualt_FaultDebounce_UnitDelay "McuFunSafeMonitor/MFSM_FuncSafetyRedundancy_96us_sys/Subsystem/CosSigShortPwrFualt/FaultDebounce/UnitDelay"
 /begin REF_MEASUREMENT McuFunSafeMonitor_ConstB.DataTypeConversion1_o McuFunSafeMonitor_ConstB.LogicalOperator1_k McuFunSafeMonitor_DW.BareUnitDelay_DSTATE_o /end REF_MEASUREMENT
/end GROUP
/begin GROUP McuFunSafeMonitor_MFSM_FuncSafetyRedundancy_96us_sys_Subsystem_CosSigShortPwrFualt_Parameter1 "McuFunSafeMonitor/MFSM_FuncSafetyRedundancy_96us_sys/Subsystem/CosSigShortPwrFualt/Parameter1" /begin REF_CHARACTERISTIC MFSM_CosShortPwrValue_C /end REF_CHARACTERISTIC /end GROUP
/begin GROUP McuFunSafeMonitor_MFSM_FuncSafetyRedundancy_96us_sys_Subsystem_CosSigShortPwrFualt_Parameter2 "McuFunSafeMonitor/MFSM_FuncSafetyRedundancy_96us_sys/Subsystem/CosSigShortPwrFualt/Parameter2" /begin REF_CHARACTERISTIC MFSM_DebounceMaxCosShortPwr_C /end REF_CHARACTERISTIC /end GROUP
/begin GROUP McuFunSafeMonitor_MFSM_FuncSafetyRedundancy_96us_sys_Subsystem_CosSigShortPwrFualt_Parameter3 "McuFunSafeMonitor/MFSM_FuncSafetyRedundancy_96us_sys/Subsystem/CosSigShortPwrFualt/Parameter3" /begin REF_CHARACTERISTIC MFSM_DebounceIncrCosShortPwr_C /end REF_CHARACTERISTIC /end GROUP
/begin GROUP McuFunSafeMonitor_MFSM_FuncSafetyRedundancy_96us_sys_Subsystem_CosSigShortPwrFualt_Parameter4 "McuFunSafeMonitor/MFSM_FuncSafetyRedundancy_96us_sys/Subsystem/CosSigShortPwrFualt/Parameter4" /begin REF_CHARACTERISTIC MFSM_DebounceDecrCosShortPwr_C /end REF_CHARACTERISTIC /end GROUP
/begin GROUP McuFunSafeMonitor_MFSM_FuncSafetyRedundancy_96us_sys_Subsystem_CosSigShortPwrFualt_Parameter5 "McuFunSafeMonitor/MFSM_FuncSafetyRedundancy_96us_sys/Subsystem/CosSigShortPwrFualt/Parameter5" /begin REF_CHARACTERISTIC MFSM_DebounceMinCosShortPwr_C /end REF_CHARACTERISTIC /end GROUP
/begin GROUP McuFunSafeMonitor_MFSM_FuncSafetyRedundancy_96us_sys_Subsystem_ExcAmpFualt "McuFunSafeMonitor/MFSM_FuncSafetyRedundancy_96us_sys/Subsystem/ExcAmpFualt"
 /begin SUB_GROUP McuFunSafeMonitor_MFSM_FuncSafetyRedundancy_96us_sys_Subsystem_ExcAmpFualt_FaultDebounce McuFunSafeMonitor_MFSM_FuncSafetyRedundancy_96us_sys_Subsystem_ExcAmpFualt_Parameter2 McuFunSafeMonitor_MFSM_FuncSafetyRedundancy_96us_sys_Subsystem_ExcAmpFualt_Parameter3 McuFunSafeMonitor_MFSM_FuncSafetyRedundancy_96us_sys_Subsystem_ExcAmpFualt_Parameter4 McuFunSafeMonitor_MFSM_FuncSafetyRedundancy_96us_sys_Subsystem_ExcAmpFualt_Parameter5 McuFunSafeMonitor_MFSM_FuncSafetyRedundancy_96us_sys_Subsystem_ExcAmpFualt_Subsystem /end SUB_GROUP
 /begin REF_MEASUREMENT McuFunSafeMonitor_B.DataTypeConversion_n McuFunSafeMonitor_ConstB.DataTypeConversion1_j /end REF_MEASUREMENT
/end GROUP
/begin GROUP McuFunSafeMonitor_MFSM_FuncSafetyRedundancy_96us_sys_Subsystem_ExcAmpFualt_FaultDebounce "McuFunSafeMonitor/MFSM_FuncSafetyRedundancy_96us_sys/Subsystem/ExcAmpFualt/FaultDebounce"
 /begin SUB_GROUP McuFunSafeMonitor_MFSM_FuncSafetyRedundancy_96us_sys_Subsystem_ExcAmpFualt_FaultDebounce_Subsystem McuFunSafeMonitor_MFSM_FuncSafetyRedundancy_96us_sys_Subsystem_ExcAmpFualt_FaultDebounce_UnitDelay /end SUB_GROUP
/end GROUP
/begin GROUP McuFunSafeMonitor_MFSM_FuncSafetyRedundancy_96us_sys_Subsystem_ExcAmpFualt_FaultDebounce_Subsystem "McuFunSafeMonitor/MFSM_FuncSafetyRedundancy_96us_sys/Subsystem/ExcAmpFualt/FaultDebounce/Subsystem" /begin REF_MEASUREMENT McuFunSafeMonitor_DW.Memory_PreviousInput_h /end REF_MEASUREMENT /end GROUP
/begin GROUP McuFunSafeMonitor_MFSM_FuncSafetyRedundancy_96us_sys_Subsystem_ExcAmpFualt_FaultDebounce_UnitDelay "McuFunSafeMonitor/MFSM_FuncSafetyRedundancy_96us_sys/Subsystem/ExcAmpFualt/FaultDebounce/UnitDelay"
 /begin REF_MEASUREMENT McuFunSafeMonitor_ConstB.DataTypeConversion1_j McuFunSafeMonitor_ConstB.LogicalOperator1_o McuFunSafeMonitor_DW.BareUnitDelay_DSTATE_n /end REF_MEASUREMENT
/end GROUP
/begin GROUP McuFunSafeMonitor_MFSM_FuncSafetyRedundancy_96us_sys_Subsystem_ExcAmpFualt_Parameter2 "McuFunSafeMonitor/MFSM_FuncSafetyRedundancy_96us_sys/Subsystem/ExcAmpFualt/Parameter2" /begin REF_CHARACTERISTIC MFSM_DebounceMaxExcAmp_C /end REF_CHARACTERISTIC /end GROUP
/begin GROUP McuFunSafeMonitor_MFSM_FuncSafetyRedundancy_96us_sys_Subsystem_ExcAmpFualt_Parameter3 "McuFunSafeMonitor/MFSM_FuncSafetyRedundancy_96us_sys/Subsystem/ExcAmpFualt/Parameter3" /begin REF_CHARACTERISTIC MFSM_DebounceIncrExcAmp_C /end REF_CHARACTERISTIC /end GROUP
/begin GROUP McuFunSafeMonitor_MFSM_FuncSafetyRedundancy_96us_sys_Subsystem_ExcAmpFualt_Parameter4 "McuFunSafeMonitor/MFSM_FuncSafetyRedundancy_96us_sys/Subsystem/ExcAmpFualt/Parameter4" /begin REF_CHARACTERISTIC MFSM_DebounceDecrExcAmp_C /end REF_CHARACTERISTIC /end GROUP
/begin GROUP McuFunSafeMonitor_MFSM_FuncSafetyRedundancy_96us_sys_Subsystem_ExcAmpFualt_Parameter5 "McuFunSafeMonitor/MFSM_FuncSafetyRedundancy_96us_sys/Subsystem/ExcAmpFualt/Parameter5" /begin REF_CHARACTERISTIC MFSM_DebounceMinExcAmp_C /end REF_CHARACTERISTIC /end GROUP
/begin GROUP McuFunSafeMonitor_MFSM_FuncSafetyRedundancy_96us_sys_Subsystem_ExcAmpFualt_Subsystem "McuFunSafeMonitor/MFSM_FuncSafetyRedundancy_96us_sys/Subsystem/ExcAmpFualt/Subsystem"
 /begin SUB_GROUP McuFunSafeMonitor_MFSM_FuncSafetyRedundancy_96us_sys_Subsystem_ExcAmpFualt_Subsystem_Local_Variable_Storage1 McuFunSafeMonitor_MFSM_FuncSafetyRedundancy_96us_sys_Subsystem_ExcAmpFualt_Subsystem_Local_Variable_Storage3 McuFunSafeMonitor_MFSM_FuncSafetyRedundancy_96us_sys_Subsystem_ExcAmpFualt_Subsystem_Parameter1 McuFunSafeMonitor_MFSM_FuncSafetyRedundancy_96us_sys_Subsystem_ExcAmpFualt_Subsystem_Parameter6 McuFunSafeMonitor_MFSM_FuncSafetyRedundancy_96us_sys_Subsystem_ExcAmpFualt_Subsystem_Parameter7 McuFunSafeMonitor_MFSM_FuncSafetyRedundancy_96us_sys_Subsystem_ExcAmpFualt_Subsystem_Parameter8 /end SUB_GROUP
/end GROUP
/begin GROUP McuFunSafeMonitor_MFSM_FuncSafetyRedundancy_96us_sys_Subsystem_ExcAmpFualt_Subsystem_Local_Variable_Storage1 "McuFunSafeMonitor/MFSM_FuncSafetyRedundancy_96us_sys/Subsystem/ExcAmpFualt/Subsystem/Local Variable Storage1" /begin REF_MEASUREMENT MFSM_ExcDiffLow /end REF_MEASUREMENT /end GROUP
/begin GROUP McuFunSafeMonitor_MFSM_FuncSafetyRedundancy_96us_sys_Subsystem_ExcAmpFualt_Subsystem_Local_Variable_Storage3 "McuFunSafeMonitor/MFSM_FuncSafetyRedundancy_96us_sys/Subsystem/ExcAmpFualt/Subsystem/Local Variable Storage3" /begin REF_MEASUREMENT MFSM_ExcDiffHigh /end REF_MEASUREMENT /end GROUP
/begin GROUP McuFunSafeMonitor_MFSM_FuncSafetyRedundancy_96us_sys_Subsystem_ExcAmpFualt_Subsystem_Parameter1 "McuFunSafeMonitor/MFSM_FuncSafetyRedundancy_96us_sys/Subsystem/ExcAmpFualt/Subsystem/Parameter1" /begin REF_CHARACTERISTIC MFSM_ExcMaxLowValue_C /end REF_CHARACTERISTIC /end GROUP
/begin GROUP McuFunSafeMonitor_MFSM_FuncSafetyRedundancy_96us_sys_Subsystem_ExcAmpFualt_Subsystem_Parameter6 "McuFunSafeMonitor/MFSM_FuncSafetyRedundancy_96us_sys/Subsystem/ExcAmpFualt/Subsystem/Parameter6" /begin REF_CHARACTERISTIC MFSM_ExcMaxHighValue_C /end REF_CHARACTERISTIC /end GROUP
/begin GROUP McuFunSafeMonitor_MFSM_FuncSafetyRedundancy_96us_sys_Subsystem_ExcAmpFualt_Subsystem_Parameter7 "McuFunSafeMonitor/MFSM_FuncSafetyRedundancy_96us_sys/Subsystem/ExcAmpFualt/Subsystem/Parameter7" /begin REF_CHARACTERISTIC MFSM_ExcMinLowValue_C /end REF_CHARACTERISTIC /end GROUP
/begin GROUP McuFunSafeMonitor_MFSM_FuncSafetyRedundancy_96us_sys_Subsystem_ExcAmpFualt_Subsystem_Parameter8 "McuFunSafeMonitor/MFSM_FuncSafetyRedundancy_96us_sys/Subsystem/ExcAmpFualt/Subsystem/Parameter8" /begin REF_CHARACTERISTIC MFSM_ExcMinHighValue_C /end REF_CHARACTERISTIC /end GROUP
/begin GROUP McuFunSafeMonitor_MFSM_FuncSafetyRedundancy_96us_sys_Subsystem_ExcOpenFualt "McuFunSafeMonitor/MFSM_FuncSafetyRedundancy_96us_sys/Subsystem/ExcOpenFualt"
 /begin SUB_GROUP McuFunSafeMonitor_MFSM_FuncSafetyRedundancy_96us_sys_Subsystem_ExcOpenFualt_FaultDebounce McuFunSafeMonitor_MFSM_FuncSafetyRedundancy_96us_sys_Subsystem_ExcOpenFualt_Local_Variable_Storage3 McuFunSafeMonitor_MFSM_FuncSafetyRedundancy_96us_sys_Subsystem_ExcOpenFualt_Parameter2 McuFunSafeMonitor_MFSM_FuncSafetyRedundancy_96us_sys_Subsystem_ExcOpenFualt_Parameter3 McuFunSafeMonitor_MFSM_FuncSafetyRedundancy_96us_sys_Subsystem_ExcOpenFualt_Parameter4 McuFunSafeMonitor_MFSM_FuncSafetyRedundancy_96us_sys_Subsystem_ExcOpenFualt_Parameter5 McuFunSafeMonitor_MFSM_FuncSafetyRedundancy_96us_sys_Subsystem_ExcOpenFualt_Parameter6 /end SUB_GROUP
 /begin REF_MEASUREMENT McuFunSafeMonitor_B.DataTypeConversion_p McuFunSafeMonitor_ConstB.DataTypeConversion1_p /end REF_MEASUREMENT
/end GROUP
/begin GROUP McuFunSafeMonitor_MFSM_FuncSafetyRedundancy_96us_sys_Subsystem_ExcOpenFualt_FaultDebounce "McuFunSafeMonitor/MFSM_FuncSafetyRedundancy_96us_sys/Subsystem/ExcOpenFualt/FaultDebounce"
 /begin SUB_GROUP McuFunSafeMonitor_MFSM_FuncSafetyRedundancy_96us_sys_Subsystem_ExcOpenFualt_FaultDebounce_Subsystem McuFunSafeMonitor_MFSM_FuncSafetyRedundancy_96us_sys_Subsystem_ExcOpenFualt_FaultDebounce_UnitDelay /end SUB_GROUP
/end GROUP
/begin GROUP McuFunSafeMonitor_MFSM_FuncSafetyRedundancy_96us_sys_Subsystem_ExcOpenFualt_FaultDebounce_Subsystem "McuFunSafeMonitor/MFSM_FuncSafetyRedundancy_96us_sys/Subsystem/ExcOpenFualt/FaultDebounce/Subsystem" /begin REF_MEASUREMENT McuFunSafeMonitor_DW.Memory_PreviousInput_i /end REF_MEASUREMENT /end GROUP
/begin GROUP McuFunSafeMonitor_MFSM_FuncSafetyRedundancy_96us_sys_Subsystem_ExcOpenFualt_FaultDebounce_UnitDelay "McuFunSafeMonitor/MFSM_FuncSafetyRedundancy_96us_sys/Subsystem/ExcOpenFualt/FaultDebounce/UnitDelay"
 /begin REF_MEASUREMENT McuFunSafeMonitor_ConstB.DataTypeConversion1_p McuFunSafeMonitor_ConstB.LogicalOperator1_l McuFunSafeMonitor_DW.BareUnitDelay_DSTATE_l /end REF_MEASUREMENT
/end GROUP
/begin GROUP McuFunSafeMonitor_MFSM_FuncSafetyRedundancy_96us_sys_Subsystem_ExcOpenFualt_Local_Variable_Storage3 "McuFunSafeMonitor/MFSM_FuncSafetyRedundancy_96us_sys/Subsystem/ExcOpenFualt/Local Variable Storage3" /begin REF_MEASUREMENT MFSM_ExcAmpAve /end REF_MEASUREMENT /end GROUP
/begin GROUP McuFunSafeMonitor_MFSM_FuncSafetyRedundancy_96us_sys_Subsystem_ExcOpenFualt_Parameter2 "McuFunSafeMonitor/MFSM_FuncSafetyRedundancy_96us_sys/Subsystem/ExcOpenFualt/Parameter2" /begin REF_CHARACTERISTIC MFSM_DebounceMaxExcOpen_C /end REF_CHARACTERISTIC /end GROUP
/begin GROUP McuFunSafeMonitor_MFSM_FuncSafetyRedundancy_96us_sys_Subsystem_ExcOpenFualt_Parameter3 "McuFunSafeMonitor/MFSM_FuncSafetyRedundancy_96us_sys/Subsystem/ExcOpenFualt/Parameter3" /begin REF_CHARACTERISTIC MFSM_DebounceIncrExcOpen_C /end REF_CHARACTERISTIC /end GROUP
/begin GROUP McuFunSafeMonitor_MFSM_FuncSafetyRedundancy_96us_sys_Subsystem_ExcOpenFualt_Parameter4 "McuFunSafeMonitor/MFSM_FuncSafetyRedundancy_96us_sys/Subsystem/ExcOpenFualt/Parameter4" /begin REF_CHARACTERISTIC MFSM_DebounceDecrExcOpen_C /end REF_CHARACTERISTIC /end GROUP
/begin GROUP McuFunSafeMonitor_MFSM_FuncSafetyRedundancy_96us_sys_Subsystem_ExcOpenFualt_Parameter5 "McuFunSafeMonitor/MFSM_FuncSafetyRedundancy_96us_sys/Subsystem/ExcOpenFualt/Parameter5" /begin REF_CHARACTERISTIC MFSM_DebounceMinExcOpen_C /end REF_CHARACTERISTIC /end GROUP
/begin GROUP McuFunSafeMonitor_MFSM_FuncSafetyRedundancy_96us_sys_Subsystem_ExcOpenFualt_Parameter6 "McuFunSafeMonitor/MFSM_FuncSafetyRedundancy_96us_sys/Subsystem/ExcOpenFualt/Parameter6" /begin REF_CHARACTERISTIC MFSM_ExcOpenValue_C /end REF_CHARACTERISTIC /end GROUP
/begin GROUP McuFunSafeMonitor_MFSM_FuncSafetyRedundancy_96us_sys_Subsystem_ExcShortGndFualt "McuFunSafeMonitor/MFSM_FuncSafetyRedundancy_96us_sys/Subsystem/ExcShortGndFualt"
 /begin SUB_GROUP McuFunSafeMonitor_MFSM_FuncSafetyRedundancy_96us_sys_Subsystem_ExcShortGndFualt_FaultDebounce McuFunSafeMonitor_MFSM_FuncSafetyRedundancy_96us_sys_Subsystem_ExcShortGndFualt_Local_Variable_Storage3 McuFunSafeMonitor_MFSM_FuncSafetyRedundancy_96us_sys_Subsystem_ExcShortGndFualt_Parameter2 McuFunSafeMonitor_MFSM_FuncSafetyRedundancy_96us_sys_Subsystem_ExcShortGndFualt_Parameter3 McuFunSafeMonitor_MFSM_FuncSafetyRedundancy_96us_sys_Subsystem_ExcShortGndFualt_Parameter4 McuFunSafeMonitor_MFSM_FuncSafetyRedundancy_96us_sys_Subsystem_ExcShortGndFualt_Parameter5 McuFunSafeMonitor_MFSM_FuncSafetyRedundancy_96us_sys_Subsystem_ExcShortGndFualt_Parameter6 /end SUB_GROUP
 /begin REF_MEASUREMENT McuFunSafeMonitor_B.DataTypeConversion_f McuFunSafeMonitor_ConstB.DataTypeConversion1_jr /end REF_MEASUREMENT
/end GROUP
/begin GROUP McuFunSafeMonitor_MFSM_FuncSafetyRedundancy_96us_sys_Subsystem_ExcShortGndFualt_FaultDebounce "McuFunSafeMonitor/MFSM_FuncSafetyRedundancy_96us_sys/Subsystem/ExcShortGndFualt/FaultDebounce"
 /begin SUB_GROUP McuFunSafeMonitor_MFSM_FuncSafetyRedundancy_96us_sys_Subsystem_ExcShortGndFualt_FaultDebounce_Subsystem McuFunSafeMonitor_MFSM_FuncSafetyRedundancy_96us_sys_Subsystem_ExcShortGndFualt_FaultDebounce_UnitDelay /end SUB_GROUP
/end GROUP
/begin GROUP McuFunSafeMonitor_MFSM_FuncSafetyRedundancy_96us_sys_Subsystem_ExcShortGndFualt_FaultDebounce_Subsystem "McuFunSafeMonitor/MFSM_FuncSafetyRedundancy_96us_sys/Subsystem/ExcShortGndFualt/FaultDebounce/Subsystem" /begin REF_MEASUREMENT McuFunSafeMonitor_DW.Memory_PreviousInput_m /end REF_MEASUREMENT /end GROUP
/begin GROUP McuFunSafeMonitor_MFSM_FuncSafetyRedundancy_96us_sys_Subsystem_ExcShortGndFualt_FaultDebounce_UnitDelay "McuFunSafeMonitor/MFSM_FuncSafetyRedundancy_96us_sys/Subsystem/ExcShortGndFualt/FaultDebounce/UnitDelay"
 /begin REF_MEASUREMENT McuFunSafeMonitor_ConstB.DataTypeConversion1_jr McuFunSafeMonitor_ConstB.LogicalOperator1_m McuFunSafeMonitor_DW.BareUnitDelay_DSTATE_n5 /end REF_MEASUREMENT
/end GROUP
/begin GROUP McuFunSafeMonitor_MFSM_FuncSafetyRedundancy_96us_sys_Subsystem_ExcShortGndFualt_Local_Variable_Storage3 "McuFunSafeMonitor/MFSM_FuncSafetyRedundancy_96us_sys/Subsystem/ExcShortGndFualt/Local Variable Storage3" /begin REF_MEASUREMENT MFSM_ExcAveVal /end REF_MEASUREMENT /end GROUP
/begin GROUP McuFunSafeMonitor_MFSM_FuncSafetyRedundancy_96us_sys_Subsystem_ExcShortGndFualt_Parameter2 "McuFunSafeMonitor/MFSM_FuncSafetyRedundancy_96us_sys/Subsystem/ExcShortGndFualt/Parameter2" /begin REF_CHARACTERISTIC MFSM_DebounceMaxExcShortGnd_C /end REF_CHARACTERISTIC /end GROUP
/begin GROUP McuFunSafeMonitor_MFSM_FuncSafetyRedundancy_96us_sys_Subsystem_ExcShortGndFualt_Parameter3 "McuFunSafeMonitor/MFSM_FuncSafetyRedundancy_96us_sys/Subsystem/ExcShortGndFualt/Parameter3" /begin REF_CHARACTERISTIC MFSM_DebounceIncrExcShortGnd_C /end REF_CHARACTERISTIC /end GROUP
/begin GROUP McuFunSafeMonitor_MFSM_FuncSafetyRedundancy_96us_sys_Subsystem_ExcShortGndFualt_Parameter4 "McuFunSafeMonitor/MFSM_FuncSafetyRedundancy_96us_sys/Subsystem/ExcShortGndFualt/Parameter4" /begin REF_CHARACTERISTIC MFSM_DebounceDecrExcShortGnd_C /end REF_CHARACTERISTIC /end GROUP
/begin GROUP McuFunSafeMonitor_MFSM_FuncSafetyRedundancy_96us_sys_Subsystem_ExcShortGndFualt_Parameter5 "McuFunSafeMonitor/MFSM_FuncSafetyRedundancy_96us_sys/Subsystem/ExcShortGndFualt/Parameter5" /begin REF_CHARACTERISTIC MFSM_DebounceMinExcShortGnd_C /end REF_CHARACTERISTIC /end GROUP
/begin GROUP McuFunSafeMonitor_MFSM_FuncSafetyRedundancy_96us_sys_Subsystem_ExcShortGndFualt_Parameter6 "McuFunSafeMonitor/MFSM_FuncSafetyRedundancy_96us_sys/Subsystem/ExcShortGndFualt/Parameter6" /begin REF_CHARACTERISTIC MFSM_ExcShortGndValue_C /end REF_CHARACTERISTIC /end GROUP
/begin GROUP McuFunSafeMonitor_MFSM_FuncSafetyRedundancy_96us_sys_Subsystem_ExcShortPwrFualt "McuFunSafeMonitor/MFSM_FuncSafetyRedundancy_96us_sys/Subsystem/ExcShortPwrFualt"
 /begin SUB_GROUP McuFunSafeMonitor_MFSM_FuncSafetyRedundancy_96us_sys_Subsystem_ExcShortPwrFualt_FaultDebounce McuFunSafeMonitor_MFSM_FuncSafetyRedundancy_96us_sys_Subsystem_ExcShortPwrFualt_Parameter2 McuFunSafeMonitor_MFSM_FuncSafetyRedundancy_96us_sys_Subsystem_ExcShortPwrFualt_Parameter3 McuFunSafeMonitor_MFSM_FuncSafetyRedundancy_96us_sys_Subsystem_ExcShortPwrFualt_Parameter4 McuFunSafeMonitor_MFSM_FuncSafetyRedundancy_96us_sys_Subsystem_ExcShortPwrFualt_Parameter5 McuFunSafeMonitor_MFSM_FuncSafetyRedundancy_96us_sys_Subsystem_ExcShortPwrFualt_Subsystem /end SUB_GROUP
 /begin REF_MEASUREMENT McuFunSafeMonitor_B.DataTypeConversion_o McuFunSafeMonitor_ConstB.DataTypeConversion1_g /end REF_MEASUREMENT
/end GROUP
/begin GROUP McuFunSafeMonitor_MFSM_FuncSafetyRedundancy_96us_sys_Subsystem_ExcShortPwrFualt_FaultDebounce "McuFunSafeMonitor/MFSM_FuncSafetyRedundancy_96us_sys/Subsystem/ExcShortPwrFualt/FaultDebounce"
 /begin SUB_GROUP McuFunSafeMonitor_MFSM_FuncSafetyRedundancy_96us_sys_Subsystem_ExcShortPwrFualt_FaultDebounce_Subsystem McuFunSafeMonitor_MFSM_FuncSafetyRedundancy_96us_sys_Subsystem_ExcShortPwrFualt_FaultDebounce_UnitDelay /end SUB_GROUP
/end GROUP
/begin GROUP McuFunSafeMonitor_MFSM_FuncSafetyRedundancy_96us_sys_Subsystem_ExcShortPwrFualt_FaultDebounce_Subsystem "McuFunSafeMonitor/MFSM_FuncSafetyRedundancy_96us_sys/Subsystem/ExcShortPwrFualt/FaultDebounce/Subsystem" /begin REF_MEASUREMENT McuFunSafeMonitor_DW.Memory_PreviousInput_mz /end REF_MEASUREMENT /end GROUP
/begin GROUP McuFunSafeMonitor_MFSM_FuncSafetyRedundancy_96us_sys_Subsystem_ExcShortPwrFualt_FaultDebounce_UnitDelay "McuFunSafeMonitor/MFSM_FuncSafetyRedundancy_96us_sys/Subsystem/ExcShortPwrFualt/FaultDebounce/UnitDelay"
 /begin REF_MEASUREMENT McuFunSafeMonitor_ConstB.DataTypeConversion1_g McuFunSafeMonitor_ConstB.LogicalOperator1_g McuFunSafeMonitor_DW.BareUnitDelay_DSTATE_lf /end REF_MEASUREMENT
/end GROUP
/begin GROUP McuFunSafeMonitor_MFSM_FuncSafetyRedundancy_96us_sys_Subsystem_ExcShortPwrFualt_Parameter2 "McuFunSafeMonitor/MFSM_FuncSafetyRedundancy_96us_sys/Subsystem/ExcShortPwrFualt/Parameter2" /begin REF_CHARACTERISTIC MFSM_DebounceMaxExcShortGnd_C /end REF_CHARACTERISTIC /end GROUP
/begin GROUP McuFunSafeMonitor_MFSM_FuncSafetyRedundancy_96us_sys_Subsystem_ExcShortPwrFualt_Parameter3 "McuFunSafeMonitor/MFSM_FuncSafetyRedundancy_96us_sys/Subsystem/ExcShortPwrFualt/Parameter3" /begin REF_CHARACTERISTIC MFSM_DebounceIncrExcShortGnd_C /end REF_CHARACTERISTIC /end GROUP
/begin GROUP McuFunSafeMonitor_MFSM_FuncSafetyRedundancy_96us_sys_Subsystem_ExcShortPwrFualt_Parameter4 "McuFunSafeMonitor/MFSM_FuncSafetyRedundancy_96us_sys/Subsystem/ExcShortPwrFualt/Parameter4" /begin REF_CHARACTERISTIC MFSM_DebounceDecrExcShortGnd_C /end REF_CHARACTERISTIC /end GROUP
/begin GROUP McuFunSafeMonitor_MFSM_FuncSafetyRedundancy_96us_sys_Subsystem_ExcShortPwrFualt_Parameter5 "McuFunSafeMonitor/MFSM_FuncSafetyRedundancy_96us_sys/Subsystem/ExcShortPwrFualt/Parameter5" /begin REF_CHARACTERISTIC MFSM_DebounceMinExcShortGnd_C /end REF_CHARACTERISTIC /end GROUP
/begin GROUP McuFunSafeMonitor_MFSM_FuncSafetyRedundancy_96us_sys_Subsystem_ExcShortPwrFualt_Subsystem "McuFunSafeMonitor/MFSM_FuncSafetyRedundancy_96us_sys/Subsystem/ExcShortPwrFualt/Subsystem"
 /begin SUB_GROUP McuFunSafeMonitor_MFSM_FuncSafetyRedundancy_96us_sys_Subsystem_ExcShortPwrFualt_Subsystem_Local_Variable_Storage1 McuFunSafeMonitor_MFSM_FuncSafetyRedundancy_96us_sys_Subsystem_ExcShortPwrFualt_Subsystem_Local_Variable_Storage3 McuFunSafeMonitor_MFSM_FuncSafetyRedundancy_96us_sys_Subsystem_ExcShortPwrFualt_Subsystem_Parameter1 McuFunSafeMonitor_MFSM_FuncSafetyRedundancy_96us_sys_Subsystem_ExcShortPwrFualt_Subsystem_Parameter6 /end SUB_GROUP
/end GROUP
/begin GROUP McuFunSafeMonitor_MFSM_FuncSafetyRedundancy_96us_sys_Subsystem_ExcShortPwrFualt_Subsystem_Local_Variable_Storage1 "McuFunSafeMonitor/MFSM_FuncSafetyRedundancy_96us_sys/Subsystem/ExcShortPwrFualt/Subsystem/Local Variable Storage1" /begin REF_MEASUREMENT MFSM_ExcShortPwr_Max /end REF_MEASUREMENT /end GROUP
/begin GROUP McuFunSafeMonitor_MFSM_FuncSafetyRedundancy_96us_sys_Subsystem_ExcShortPwrFualt_Subsystem_Local_Variable_Storage3 "McuFunSafeMonitor/MFSM_FuncSafetyRedundancy_96us_sys/Subsystem/ExcShortPwrFualt/Subsystem/Local Variable Storage3" /begin REF_MEASUREMENT MFSM_ExcShortPwr_Min /end REF_MEASUREMENT /end GROUP
/begin GROUP McuFunSafeMonitor_MFSM_FuncSafetyRedundancy_96us_sys_Subsystem_ExcShortPwrFualt_Subsystem_Parameter1 "McuFunSafeMonitor/MFSM_FuncSafetyRedundancy_96us_sys/Subsystem/ExcShortPwrFualt/Subsystem/Parameter1" /begin REF_CHARACTERISTIC MFSM_ExcShortPwrValue_C /end REF_CHARACTERISTIC /end GROUP
/begin GROUP McuFunSafeMonitor_MFSM_FuncSafetyRedundancy_96us_sys_Subsystem_ExcShortPwrFualt_Subsystem_Parameter6 "McuFunSafeMonitor/MFSM_FuncSafetyRedundancy_96us_sys/Subsystem/ExcShortPwrFualt/Subsystem/Parameter6" /begin REF_CHARACTERISTIC MFSM_ExcShortGndValue_C /end REF_CHARACTERISTIC /end GROUP
/begin GROUP McuFunSafeMonitor_MFSM_FuncSafetyRedundancy_96us_sys_Subsystem_Function_Caller "McuFunSafeMonitor/MFSM_FuncSafetyRedundancy_96us_sys/Subsystem/Function Caller"
 /begin SUB_GROUP McuFunSafeMonitor_MFSM_FuncSafetyRedundancy_96us_sys_Subsystem_Function_Caller_Local_Variable_Storage10 McuFunSafeMonitor_MFSM_FuncSafetyRedundancy_96us_sys_Subsystem_Function_Caller_Local_Variable_Storage11 McuFunSafeMonitor_MFSM_FuncSafetyRedundancy_96us_sys_Subsystem_Function_Caller_Local_Variable_Storage12 McuFunSafeMonitor_MFSM_FuncSafetyRedundancy_96us_sys_Subsystem_Function_Caller_Local_Variable_Storage13 McuFunSafeMonitor_MFSM_FuncSafetyRedundancy_96us_sys_Subsystem_Function_Caller_Local_Variable_Storage14 McuFunSafeMonitor_MFSM_FuncSafetyRedundancy_96us_sys_Subsystem_Function_Caller_Local_Variable_Storage15 McuFunSafeMonitor_MFSM_FuncSafetyRedundancy_96us_sys_Subsystem_Function_Caller_Local_Variable_Storage16 McuFunSafeMonitor_MFSM_FuncSafetyRedundancy_96us_sys_Subsystem_Function_Caller_Local_Variable_Storage3 McuFunSafeMonitor_MFSM_FuncSafetyRedundancy_96us_sys_Subsystem_Function_Caller_Local_Variable_Storage4 McuFunSafeMonitor_MFSM_FuncSafetyRedundancy_96us_sys_Subsystem_Function_Caller_Local_Variable_Storage5 McuFunSafeMonitor_MFSM_FuncSafetyRedundancy_96us_sys_Subsystem_Function_Caller_Local_Variable_Storage6 McuFunSafeMonitor_MFSM_FuncSafetyRedundancy_96us_sys_Subsystem_Function_Caller_Local_Variable_Storage7 McuFunSafeMonitor_MFSM_FuncSafetyRedundancy_96us_sys_Subsystem_Function_Caller_Local_Variable_Storage8 McuFunSafeMonitor_MFSM_FuncSafetyRedundancy_96us_sys_Subsystem_Function_Caller_Local_Variable_Storage9 /end SUB_GROUP
/end GROUP
/begin GROUP McuFunSafeMonitor_MFSM_FuncSafetyRedundancy_96us_sys_Subsystem_Function_Caller_Local_Variable_Storage10 "McuFunSafeMonitor/MFSM_FuncSafetyRedundancy_96us_sys/Subsystem/Function Caller/Local Variable Storage10" /begin REF_MEASUREMENT MFSM_CosNegLow /end REF_MEASUREMENT /end GROUP
/begin GROUP McuFunSafeMonitor_MFSM_FuncSafetyRedundancy_96us_sys_Subsystem_Function_Caller_Local_Variable_Storage11 "McuFunSafeMonitor/MFSM_FuncSafetyRedundancy_96us_sys/Subsystem/Function Caller/Local Variable Storage11" /begin REF_MEASUREMENT MFSM_ExcPosHigh /end REF_MEASUREMENT /end GROUP
/begin GROUP McuFunSafeMonitor_MFSM_FuncSafetyRedundancy_96us_sys_Subsystem_Function_Caller_Local_Variable_Storage12 "McuFunSafeMonitor/MFSM_FuncSafetyRedundancy_96us_sys/Subsystem/Function Caller/Local Variable Storage12" /begin REF_MEASUREMENT MFSM_ExcPosLow /end REF_MEASUREMENT /end GROUP
/begin GROUP McuFunSafeMonitor_MFSM_FuncSafetyRedundancy_96us_sys_Subsystem_Function_Caller_Local_Variable_Storage13 "McuFunSafeMonitor/MFSM_FuncSafetyRedundancy_96us_sys/Subsystem/Function Caller/Local Variable Storage13" /begin REF_MEASUREMENT MFSM_ExcNegHigh /end REF_MEASUREMENT /end GROUP
/begin GROUP McuFunSafeMonitor_MFSM_FuncSafetyRedundancy_96us_sys_Subsystem_Function_Caller_Local_Variable_Storage14 "McuFunSafeMonitor/MFSM_FuncSafetyRedundancy_96us_sys/Subsystem/Function Caller/Local Variable Storage14" /begin REF_MEASUREMENT MFSM_ExcNegLow /end REF_MEASUREMENT /end GROUP
/begin GROUP McuFunSafeMonitor_MFSM_FuncSafetyRedundancy_96us_sys_Subsystem_Function_Caller_Local_Variable_Storage15 "McuFunSafeMonitor/MFSM_FuncSafetyRedundancy_96us_sys/Subsystem/Function Caller/Local Variable Storage15" /begin REF_MEASUREMENT MFSM_PhaseA /end REF_MEASUREMENT /end GROUP
/begin GROUP McuFunSafeMonitor_MFSM_FuncSafetyRedundancy_96us_sys_Subsystem_Function_Caller_Local_Variable_Storage16 "McuFunSafeMonitor/MFSM_FuncSafetyRedundancy_96us_sys/Subsystem/Function Caller/Local Variable Storage16" /begin REF_MEASUREMENT MFSM_PhaseC /end REF_MEASUREMENT /end GROUP
/begin GROUP McuFunSafeMonitor_MFSM_FuncSafetyRedundancy_96us_sys_Subsystem_Function_Caller_Local_Variable_Storage3 "McuFunSafeMonitor/MFSM_FuncSafetyRedundancy_96us_sys/Subsystem/Function Caller/Local Variable Storage3" /begin REF_MEASUREMENT MFSM_SinPosHigh /end REF_MEASUREMENT /end GROUP
/begin GROUP McuFunSafeMonitor_MFSM_FuncSafetyRedundancy_96us_sys_Subsystem_Function_Caller_Local_Variable_Storage4 "McuFunSafeMonitor/MFSM_FuncSafetyRedundancy_96us_sys/Subsystem/Function Caller/Local Variable Storage4" /begin REF_MEASUREMENT MFSM_SinNegHigh /end REF_MEASUREMENT /end GROUP
/begin GROUP McuFunSafeMonitor_MFSM_FuncSafetyRedundancy_96us_sys_Subsystem_Function_Caller_Local_Variable_Storage5 "McuFunSafeMonitor/MFSM_FuncSafetyRedundancy_96us_sys/Subsystem/Function Caller/Local Variable Storage5" /begin REF_MEASUREMENT MFSM_SinPosLow /end REF_MEASUREMENT /end GROUP
/begin GROUP McuFunSafeMonitor_MFSM_FuncSafetyRedundancy_96us_sys_Subsystem_Function_Caller_Local_Variable_Storage6 "McuFunSafeMonitor/MFSM_FuncSafetyRedundancy_96us_sys/Subsystem/Function Caller/Local Variable Storage6" /begin REF_MEASUREMENT MFSM_SinNegLow /end REF_MEASUREMENT /end GROUP
/begin GROUP McuFunSafeMonitor_MFSM_FuncSafetyRedundancy_96us_sys_Subsystem_Function_Caller_Local_Variable_Storage7 "McuFunSafeMonitor/MFSM_FuncSafetyRedundancy_96us_sys/Subsystem/Function Caller/Local Variable Storage7" /begin REF_MEASUREMENT MFSM_CosPosHigh /end REF_MEASUREMENT /end GROUP
/begin GROUP McuFunSafeMonitor_MFSM_FuncSafetyRedundancy_96us_sys_Subsystem_Function_Caller_Local_Variable_Storage8 "McuFunSafeMonitor/MFSM_FuncSafetyRedundancy_96us_sys/Subsystem/Function Caller/Local Variable Storage8" /begin REF_MEASUREMENT MFSM_CosNegHigh /end REF_MEASUREMENT /end GROUP
/begin GROUP McuFunSafeMonitor_MFSM_FuncSafetyRedundancy_96us_sys_Subsystem_Function_Caller_Local_Variable_Storage9 "McuFunSafeMonitor/MFSM_FuncSafetyRedundancy_96us_sys/Subsystem/Function Caller/Local Variable Storage9" /begin REF_MEASUREMENT MFSM_CosPosLow /end REF_MEASUREMENT /end GROUP
/begin GROUP McuFunSafeMonitor_MFSM_FuncSafetyRedundancy_96us_sys_Subsystem_PhaseCurrrentAmpFault "McuFunSafeMonitor/MFSM_FuncSafetyRedundancy_96us_sys/Subsystem/PhaseCurrrentAmpFault"
 /begin SUB_GROUP McuFunSafeMonitor_MFSM_FuncSafetyRedundancy_96us_sys_Subsystem_PhaseCurrrentAmpFault_FaultDebounce McuFunSafeMonitor_MFSM_FuncSafetyRedundancy_96us_sys_Subsystem_PhaseCurrrentAmpFault_Parameter2 McuFunSafeMonitor_MFSM_FuncSafetyRedundancy_96us_sys_Subsystem_PhaseCurrrentAmpFault_Parameter3 McuFunSafeMonitor_MFSM_FuncSafetyRedundancy_96us_sys_Subsystem_PhaseCurrrentAmpFault_Parameter4 McuFunSafeMonitor_MFSM_FuncSafetyRedundancy_96us_sys_Subsystem_PhaseCurrrentAmpFault_Parameter5 McuFunSafeMonitor_MFSM_FuncSafetyRedundancy_96us_sys_Subsystem_PhaseCurrrentAmpFault_Subsystem /end SUB_GROUP
 /begin REF_MEASUREMENT McuFunSafeMonitor_B.DataTypeConversion_fo McuFunSafeMonitor_ConstB.DataTypeConversion1_md /end REF_MEASUREMENT
/end GROUP
/begin GROUP McuFunSafeMonitor_MFSM_FuncSafetyRedundancy_96us_sys_Subsystem_PhaseCurrrentAmpFault_FaultDebounce "McuFunSafeMonitor/MFSM_FuncSafetyRedundancy_96us_sys/Subsystem/PhaseCurrrentAmpFault/FaultDebounce"
 /begin SUB_GROUP McuFunSafeMonitor_MFSM_FuncSafetyRedundancy_96us_sys_Subsystem_PhaseCurrrentAmpFault_FaultDebounce_Subsystem McuFunSafeMonitor_MFSM_FuncSafetyRedundancy_96us_sys_Subsystem_PhaseCurrrentAmpFault_FaultDebounce_UnitDelay /end SUB_GROUP
/end GROUP
/begin GROUP McuFunSafeMonitor_MFSM_FuncSafetyRedundancy_96us_sys_Subsystem_PhaseCurrrentAmpFault_FaultDebounce_Subsystem "McuFunSafeMonitor/MFSM_FuncSafetyRedundancy_96us_sys/Subsystem/PhaseCurrrentAmpFault/FaultDebounce/Subsystem" /begin REF_MEASUREMENT McuFunSafeMonitor_DW.Memory_PreviousInput_f /end REF_MEASUREMENT /end GROUP
/begin GROUP McuFunSafeMonitor_MFSM_FuncSafetyRedundancy_96us_sys_Subsystem_PhaseCurrrentAmpFault_FaultDebounce_UnitDelay "McuFunSafeMonitor/MFSM_FuncSafetyRedundancy_96us_sys/Subsystem/PhaseCurrrentAmpFault/FaultDebounce/UnitDelay"
 /begin REF_MEASUREMENT McuFunSafeMonitor_ConstB.DataTypeConversion1_md McuFunSafeMonitor_ConstB.LogicalOperator1_e McuFunSafeMonitor_DW.BareUnitDelay_DSTATE_k /end REF_MEASUREMENT
/end GROUP
/begin GROUP McuFunSafeMonitor_MFSM_FuncSafetyRedundancy_96us_sys_Subsystem_PhaseCurrrentAmpFault_Parameter2 "McuFunSafeMonitor/MFSM_FuncSafetyRedundancy_96us_sys/Subsystem/PhaseCurrrentAmpFault/Parameter2" /begin REF_CHARACTERISTIC MFSM_DebounceMaxPhaCurrDiff_C /end REF_CHARACTERISTIC /end GROUP
/begin GROUP McuFunSafeMonitor_MFSM_FuncSafetyRedundancy_96us_sys_Subsystem_PhaseCurrrentAmpFault_Parameter3 "McuFunSafeMonitor/MFSM_FuncSafetyRedundancy_96us_sys/Subsystem/PhaseCurrrentAmpFault/Parameter3" /begin REF_CHARACTERISTIC MFSM_DebounceIncrPhaCurrDiff_C /end REF_CHARACTERISTIC /end GROUP
/begin GROUP McuFunSafeMonitor_MFSM_FuncSafetyRedundancy_96us_sys_Subsystem_PhaseCurrrentAmpFault_Parameter4 "McuFunSafeMonitor/MFSM_FuncSafetyRedundancy_96us_sys/Subsystem/PhaseCurrrentAmpFault/Parameter4" /begin REF_CHARACTERISTIC MFSM_DebounceDecrPhaCurrDiff_C /end REF_CHARACTERISTIC /end GROUP
/begin GROUP McuFunSafeMonitor_MFSM_FuncSafetyRedundancy_96us_sys_Subsystem_PhaseCurrrentAmpFault_Parameter5 "McuFunSafeMonitor/MFSM_FuncSafetyRedundancy_96us_sys/Subsystem/PhaseCurrrentAmpFault/Parameter5" /begin REF_CHARACTERISTIC MFSM_DebounceMinPhaCurrDiff_C /end REF_CHARACTERISTIC /end GROUP
/begin GROUP McuFunSafeMonitor_MFSM_FuncSafetyRedundancy_96us_sys_Subsystem_PhaseCurrrentAmpFault_Subsystem "McuFunSafeMonitor/MFSM_FuncSafetyRedundancy_96us_sys/Subsystem/PhaseCurrrentAmpFault/Subsystem"
 /begin SUB_GROUP McuFunSafeMonitor_MFSM_FuncSafetyRedundancy_96us_sys_Subsystem_PhaseCurrrentAmpFault_Subsystem_Local_Variable_Storage1 McuFunSafeMonitor_MFSM_FuncSafetyRedundancy_96us_sys_Subsystem_PhaseCurrrentAmpFault_Subsystem_Local_Variable_Storage3 McuFunSafeMonitor_MFSM_FuncSafetyRedundancy_96us_sys_Subsystem_PhaseCurrrentAmpFault_Subsystem_Parameter7 /end SUB_GROUP
 /begin REF_MEASUREMENT SGSA_PhaseACurrentAD SGSA_PhaseCCurrentAD /end REF_MEASUREMENT
/end GROUP
/begin GROUP McuFunSafeMonitor_MFSM_FuncSafetyRedundancy_96us_sys_Subsystem_PhaseCurrrentAmpFault_Subsystem_Local_Variable_Storage1 "McuFunSafeMonitor/MFSM_FuncSafetyRedundancy_96us_sys/Subsystem/PhaseCurrrentAmpFault/Subsystem/Local Variable Storage1" /begin REF_MEASUREMENT MFSM_PhaseCDiff /end REF_MEASUREMENT /end GROUP
/begin GROUP McuFunSafeMonitor_MFSM_FuncSafetyRedundancy_96us_sys_Subsystem_PhaseCurrrentAmpFault_Subsystem_Local_Variable_Storage3 "McuFunSafeMonitor/MFSM_FuncSafetyRedundancy_96us_sys/Subsystem/PhaseCurrrentAmpFault/Subsystem/Local Variable Storage3" /begin REF_MEASUREMENT MFSM_PhaseADiff /end REF_MEASUREMENT /end GROUP
/begin GROUP McuFunSafeMonitor_MFSM_FuncSafetyRedundancy_96us_sys_Subsystem_PhaseCurrrentAmpFault_Subsystem_Parameter7 "McuFunSafeMonitor/MFSM_FuncSafetyRedundancy_96us_sys/Subsystem/PhaseCurrrentAmpFault/Subsystem/Parameter7" /begin REF_CHARACTERISTIC MFSM_PhaCurrDiffValue_C /end REF_CHARACTERISTIC /end GROUP
/begin GROUP McuFunSafeMonitor_MFSM_FuncSafetyRedundancy_96us_sys_Subsystem_PhaseCurrrentOpen "McuFunSafeMonitor/MFSM_FuncSafetyRedundancy_96us_sys/Subsystem/PhaseCurrrentOpen"
 /begin SUB_GROUP McuFunSafeMonitor_MFSM_FuncSafetyRedundancy_96us_sys_Subsystem_PhaseCurrrentOpen_FaultDebounce McuFunSafeMonitor_MFSM_FuncSafetyRedundancy_96us_sys_Subsystem_PhaseCurrrentOpen_Parameter2 McuFunSafeMonitor_MFSM_FuncSafetyRedundancy_96us_sys_Subsystem_PhaseCurrrentOpen_Parameter3 McuFunSafeMonitor_MFSM_FuncSafetyRedundancy_96us_sys_Subsystem_PhaseCurrrentOpen_Parameter4 McuFunSafeMonitor_MFSM_FuncSafetyRedundancy_96us_sys_Subsystem_PhaseCurrrentOpen_Parameter5 McuFunSafeMonitor_MFSM_FuncSafetyRedundancy_96us_sys_Subsystem_PhaseCurrrentOpen_Subsystem /end SUB_GROUP
 /begin REF_MEASUREMENT McuFunSafeMonitor_B.DataTypeConversion_e McuFunSafeMonitor_ConstB.DataTypeConversion1_gu /end REF_MEASUREMENT
/end GROUP
/begin GROUP McuFunSafeMonitor_MFSM_FuncSafetyRedundancy_96us_sys_Subsystem_PhaseCurrrentOpen_FaultDebounce "McuFunSafeMonitor/MFSM_FuncSafetyRedundancy_96us_sys/Subsystem/PhaseCurrrentOpen/FaultDebounce"
 /begin SUB_GROUP McuFunSafeMonitor_MFSM_FuncSafetyRedundancy_96us_sys_Subsystem_PhaseCurrrentOpen_FaultDebounce_Subsystem McuFunSafeMonitor_MFSM_FuncSafetyRedundancy_96us_sys_Subsystem_PhaseCurrrentOpen_FaultDebounce_UnitDelay /end SUB_GROUP
/end GROUP
/begin GROUP McuFunSafeMonitor_MFSM_FuncSafetyRedundancy_96us_sys_Subsystem_PhaseCurrrentOpen_FaultDebounce_Subsystem "McuFunSafeMonitor/MFSM_FuncSafetyRedundancy_96us_sys/Subsystem/PhaseCurrrentOpen/FaultDebounce/Subsystem" /begin REF_MEASUREMENT McuFunSafeMonitor_DW.Memory_PreviousInput_k /end REF_MEASUREMENT /end GROUP
/begin GROUP McuFunSafeMonitor_MFSM_FuncSafetyRedundancy_96us_sys_Subsystem_PhaseCurrrentOpen_FaultDebounce_UnitDelay "McuFunSafeMonitor/MFSM_FuncSafetyRedundancy_96us_sys/Subsystem/PhaseCurrrentOpen/FaultDebounce/UnitDelay"
 /begin REF_MEASUREMENT McuFunSafeMonitor_ConstB.DataTypeConversion1_gu McuFunSafeMonitor_ConstB.LogicalOperator1_mt McuFunSafeMonitor_DW.BareUnitDelay_DSTATE_h /end REF_MEASUREMENT
/end GROUP
/begin GROUP McuFunSafeMonitor_MFSM_FuncSafetyRedundancy_96us_sys_Subsystem_PhaseCurrrentOpen_Parameter2 "McuFunSafeMonitor/MFSM_FuncSafetyRedundancy_96us_sys/Subsystem/PhaseCurrrentOpen/Parameter2" /begin REF_CHARACTERISTIC MFSM_DebounceMaxOpen_C /end REF_CHARACTERISTIC /end GROUP
/begin GROUP McuFunSafeMonitor_MFSM_FuncSafetyRedundancy_96us_sys_Subsystem_PhaseCurrrentOpen_Parameter3 "McuFunSafeMonitor/MFSM_FuncSafetyRedundancy_96us_sys/Subsystem/PhaseCurrrentOpen/Parameter3" /begin REF_CHARACTERISTIC MFSM_DebounceIncrOpen_C /end REF_CHARACTERISTIC /end GROUP
/begin GROUP McuFunSafeMonitor_MFSM_FuncSafetyRedundancy_96us_sys_Subsystem_PhaseCurrrentOpen_Parameter4 "McuFunSafeMonitor/MFSM_FuncSafetyRedundancy_96us_sys/Subsystem/PhaseCurrrentOpen/Parameter4" /begin REF_CHARACTERISTIC MFSM_DebounceDecrOpen_C /end REF_CHARACTERISTIC /end GROUP
/begin GROUP McuFunSafeMonitor_MFSM_FuncSafetyRedundancy_96us_sys_Subsystem_PhaseCurrrentOpen_Parameter5 "McuFunSafeMonitor/MFSM_FuncSafetyRedundancy_96us_sys/Subsystem/PhaseCurrrentOpen/Parameter5" /begin REF_CHARACTERISTIC MFSM_DebounceMinOpen_C /end REF_CHARACTERISTIC /end GROUP
/begin GROUP McuFunSafeMonitor_MFSM_FuncSafetyRedundancy_96us_sys_Subsystem_PhaseCurrrentOpen_Subsystem "McuFunSafeMonitor/MFSM_FuncSafetyRedundancy_96us_sys/Subsystem/PhaseCurrrentOpen/Subsystem"
 /begin SUB_GROUP McuFunSafeMonitor_MFSM_FuncSafetyRedundancy_96us_sys_Subsystem_PhaseCurrrentOpen_Subsystem_Local_Variable_Storage1 McuFunSafeMonitor_MFSM_FuncSafetyRedundancy_96us_sys_Subsystem_PhaseCurrrentOpen_Subsystem_Local_Variable_Storage3 McuFunSafeMonitor_MFSM_FuncSafetyRedundancy_96us_sys_Subsystem_PhaseCurrrentOpen_Subsystem_Parameter1 McuFunSafeMonitor_MFSM_FuncSafetyRedundancy_96us_sys_Subsystem_PhaseCurrrentOpen_Subsystem_Parameter7 /end SUB_GROUP
 /begin REF_MEASUREMENT SGSA_PhaseACurrentAD SGSA_PhaseCCurrentAD /end REF_MEASUREMENT
/end GROUP
/begin GROUP McuFunSafeMonitor_MFSM_FuncSafetyRedundancy_96us_sys_Subsystem_PhaseCurrrentOpen_Subsystem_Local_Variable_Storage1 "McuFunSafeMonitor/MFSM_FuncSafetyRedundancy_96us_sys/Subsystem/PhaseCurrrentOpen/Subsystem/Local Variable Storage1" /begin REF_MEASUREMENT MFSM_PhaseCCurrentDiff /end REF_MEASUREMENT /end GROUP
/begin GROUP McuFunSafeMonitor_MFSM_FuncSafetyRedundancy_96us_sys_Subsystem_PhaseCurrrentOpen_Subsystem_Local_Variable_Storage3 "McuFunSafeMonitor/MFSM_FuncSafetyRedundancy_96us_sys/Subsystem/PhaseCurrrentOpen/Subsystem/Local Variable Storage3" /begin REF_MEASUREMENT MFSM_PhaseACurrentDiff /end REF_MEASUREMENT /end GROUP
/begin GROUP McuFunSafeMonitor_MFSM_FuncSafetyRedundancy_96us_sys_Subsystem_PhaseCurrrentOpen_Subsystem_Parameter1 "McuFunSafeMonitor/MFSM_FuncSafetyRedundancy_96us_sys/Subsystem/PhaseCurrrentOpen/Subsystem/Parameter1" /begin REF_CHARACTERISTIC MFSM_PhaCurrOpenValue_C /end REF_CHARACTERISTIC /end GROUP
/begin GROUP McuFunSafeMonitor_MFSM_FuncSafetyRedundancy_96us_sys_Subsystem_PhaseCurrrentOpen_Subsystem_Parameter7 "McuFunSafeMonitor/MFSM_FuncSafetyRedundancy_96us_sys/Subsystem/PhaseCurrrentOpen/Subsystem/Parameter7" /begin REF_CHARACTERISTIC MFSM_PhaCurrOpenDiffValue_C /end REF_CHARACTERISTIC /end GROUP
/begin GROUP McuFunSafeMonitor_MFSM_FuncSafetyRedundancy_96us_sys_Subsystem_PhaseCurrrentShortGnd "McuFunSafeMonitor/MFSM_FuncSafetyRedundancy_96us_sys/Subsystem/PhaseCurrrentShortGnd"
 /begin SUB_GROUP McuFunSafeMonitor_MFSM_FuncSafetyRedundancy_96us_sys_Subsystem_PhaseCurrrentShortGnd_FaultDebounce McuFunSafeMonitor_MFSM_FuncSafetyRedundancy_96us_sys_Subsystem_PhaseCurrrentShortGnd_Parameter2 McuFunSafeMonitor_MFSM_FuncSafetyRedundancy_96us_sys_Subsystem_PhaseCurrrentShortGnd_Parameter3 McuFunSafeMonitor_MFSM_FuncSafetyRedundancy_96us_sys_Subsystem_PhaseCurrrentShortGnd_Parameter4 McuFunSafeMonitor_MFSM_FuncSafetyRedundancy_96us_sys_Subsystem_PhaseCurrrentShortGnd_Parameter5 McuFunSafeMonitor_MFSM_FuncSafetyRedundancy_96us_sys_Subsystem_PhaseCurrrentShortGnd_Subsystem /end SUB_GROUP
 /begin REF_MEASUREMENT McuFunSafeMonitor_B.DataTypeConversion_d McuFunSafeMonitor_ConstB.DataTypeConversion1_n /end REF_MEASUREMENT
/end GROUP
/begin GROUP McuFunSafeMonitor_MFSM_FuncSafetyRedundancy_96us_sys_Subsystem_PhaseCurrrentShortGnd_FaultDebounce "McuFunSafeMonitor/MFSM_FuncSafetyRedundancy_96us_sys/Subsystem/PhaseCurrrentShortGnd/FaultDebounce"
 /begin SUB_GROUP McuFunSafeMonitor_MFSM_FuncSafetyRedundancy_96us_sys_Subsystem_PhaseCurrrentShortGnd_FaultDebounce_Subsystem McuFunSafeMonitor_MFSM_FuncSafetyRedundancy_96us_sys_Subsystem_PhaseCurrrentShortGnd_FaultDebounce_UnitDelay /end SUB_GROUP
/end GROUP
/begin GROUP McuFunSafeMonitor_MFSM_FuncSafetyRedundancy_96us_sys_Subsystem_PhaseCurrrentShortGnd_FaultDebounce_Subsystem "McuFunSafeMonitor/MFSM_FuncSafetyRedundancy_96us_sys/Subsystem/PhaseCurrrentShortGnd/FaultDebounce/Subsystem" /begin REF_MEASUREMENT McuFunSafeMonitor_DW.Memory_PreviousInput_o /end REF_MEASUREMENT /end GROUP
/begin GROUP McuFunSafeMonitor_MFSM_FuncSafetyRedundancy_96us_sys_Subsystem_PhaseCurrrentShortGnd_FaultDebounce_UnitDelay "McuFunSafeMonitor/MFSM_FuncSafetyRedundancy_96us_sys/Subsystem/PhaseCurrrentShortGnd/FaultDebounce/UnitDelay"
 /begin REF_MEASUREMENT McuFunSafeMonitor_ConstB.DataTypeConversion1_n McuFunSafeMonitor_ConstB.LogicalOperator1_p McuFunSafeMonitor_DW.BareUnitDelay_DSTATE_kb /end REF_MEASUREMENT
/end GROUP
/begin GROUP McuFunSafeMonitor_MFSM_FuncSafetyRedundancy_96us_sys_Subsystem_PhaseCurrrentShortGnd_Parameter2 "McuFunSafeMonitor/MFSM_FuncSafetyRedundancy_96us_sys/Subsystem/PhaseCurrrentShortGnd/Parameter2" /begin REF_CHARACTERISTIC MFSM_DebounceMaxPhaCurrOpen_C /end REF_CHARACTERISTIC /end GROUP
/begin GROUP McuFunSafeMonitor_MFSM_FuncSafetyRedundancy_96us_sys_Subsystem_PhaseCurrrentShortGnd_Parameter3 "McuFunSafeMonitor/MFSM_FuncSafetyRedundancy_96us_sys/Subsystem/PhaseCurrrentShortGnd/Parameter3" /begin REF_CHARACTERISTIC MFSM_DebounceIncrPhaCurrOpen_C /end REF_CHARACTERISTIC /end GROUP
/begin GROUP McuFunSafeMonitor_MFSM_FuncSafetyRedundancy_96us_sys_Subsystem_PhaseCurrrentShortGnd_Parameter4 "McuFunSafeMonitor/MFSM_FuncSafetyRedundancy_96us_sys/Subsystem/PhaseCurrrentShortGnd/Parameter4" /begin REF_CHARACTERISTIC MFSM_DebounceDecrPhaCurrOpen_C /end REF_CHARACTERISTIC /end GROUP
/begin GROUP McuFunSafeMonitor_MFSM_FuncSafetyRedundancy_96us_sys_Subsystem_PhaseCurrrentShortGnd_Parameter5 "McuFunSafeMonitor/MFSM_FuncSafetyRedundancy_96us_sys/Subsystem/PhaseCurrrentShortGnd/Parameter5" /begin REF_CHARACTERISTIC MFSM_DebounceMinPhaCurrOpen_C /end REF_CHARACTERISTIC /end GROUP
/begin GROUP McuFunSafeMonitor_MFSM_FuncSafetyRedundancy_96us_sys_Subsystem_PhaseCurrrentShortGnd_Subsystem "McuFunSafeMonitor/MFSM_FuncSafetyRedundancy_96us_sys/Subsystem/PhaseCurrrentShortGnd/Subsystem"
 /begin SUB_GROUP McuFunSafeMonitor_MFSM_FuncSafetyRedundancy_96us_sys_Subsystem_PhaseCurrrentShortGnd_Subsystem_Parameter7 /end SUB_GROUP
/end GROUP
/begin GROUP McuFunSafeMonitor_MFSM_FuncSafetyRedundancy_96us_sys_Subsystem_PhaseCurrrentShortGnd_Subsystem_Parameter7 "McuFunSafeMonitor/MFSM_FuncSafetyRedundancy_96us_sys/Subsystem/PhaseCurrrentShortGnd/Subsystem/Parameter7" /begin REF_CHARACTERISTIC MFSM_PhaCurrShortGndValue_C /end REF_CHARACTERISTIC /end GROUP
/begin GROUP McuFunSafeMonitor_MFSM_FuncSafetyRedundancy_96us_sys_Subsystem_PhaseCurrrentShortPwr "McuFunSafeMonitor/MFSM_FuncSafetyRedundancy_96us_sys/Subsystem/PhaseCurrrentShortPwr"
 /begin SUB_GROUP McuFunSafeMonitor_MFSM_FuncSafetyRedundancy_96us_sys_Subsystem_PhaseCurrrentShortPwr_FaultDebounce McuFunSafeMonitor_MFSM_FuncSafetyRedundancy_96us_sys_Subsystem_PhaseCurrrentShortPwr_Parameter2 McuFunSafeMonitor_MFSM_FuncSafetyRedundancy_96us_sys_Subsystem_PhaseCurrrentShortPwr_Parameter3 McuFunSafeMonitor_MFSM_FuncSafetyRedundancy_96us_sys_Subsystem_PhaseCurrrentShortPwr_Parameter4 McuFunSafeMonitor_MFSM_FuncSafetyRedundancy_96us_sys_Subsystem_PhaseCurrrentShortPwr_Parameter5 McuFunSafeMonitor_MFSM_FuncSafetyRedundancy_96us_sys_Subsystem_PhaseCurrrentShortPwr_Subsystem /end SUB_GROUP
 /begin REF_MEASUREMENT McuFunSafeMonitor_B.DataTypeConversion_j McuFunSafeMonitor_ConstB.DataTypeConversion1_h5 /end REF_MEASUREMENT
/end GROUP
/begin GROUP McuFunSafeMonitor_MFSM_FuncSafetyRedundancy_96us_sys_Subsystem_PhaseCurrrentShortPwr_FaultDebounce "McuFunSafeMonitor/MFSM_FuncSafetyRedundancy_96us_sys/Subsystem/PhaseCurrrentShortPwr/FaultDebounce"
 /begin SUB_GROUP McuFunSafeMonitor_MFSM_FuncSafetyRedundancy_96us_sys_Subsystem_PhaseCurrrentShortPwr_FaultDebounce_Subsystem McuFunSafeMonitor_MFSM_FuncSafetyRedundancy_96us_sys_Subsystem_PhaseCurrrentShortPwr_FaultDebounce_UnitDelay /end SUB_GROUP
/end GROUP
/begin GROUP McuFunSafeMonitor_MFSM_FuncSafetyRedundancy_96us_sys_Subsystem_PhaseCurrrentShortPwr_FaultDebounce_Subsystem "McuFunSafeMonitor/MFSM_FuncSafetyRedundancy_96us_sys/Subsystem/PhaseCurrrentShortPwr/FaultDebounce/Subsystem" /begin REF_MEASUREMENT McuFunSafeMonitor_DW.Memory_PreviousInput_c /end REF_MEASUREMENT /end GROUP
/begin GROUP McuFunSafeMonitor_MFSM_FuncSafetyRedundancy_96us_sys_Subsystem_PhaseCurrrentShortPwr_FaultDebounce_UnitDelay "McuFunSafeMonitor/MFSM_FuncSafetyRedundancy_96us_sys/Subsystem/PhaseCurrrentShortPwr/FaultDebounce/UnitDelay"
 /begin REF_MEASUREMENT McuFunSafeMonitor_ConstB.DataTypeConversion1_h5 McuFunSafeMonitor_ConstB.LogicalOperator1_n McuFunSafeMonitor_DW.BareUnitDelay_DSTATE_e /end REF_MEASUREMENT
/end GROUP
/begin GROUP McuFunSafeMonitor_MFSM_FuncSafetyRedundancy_96us_sys_Subsystem_PhaseCurrrentShortPwr_Parameter2 "McuFunSafeMonitor/MFSM_FuncSafetyRedundancy_96us_sys/Subsystem/PhaseCurrrentShortPwr/Parameter2" /begin REF_CHARACTERISTIC MFSM_DebounceMaxPhaCurrShortPwr_C /end REF_CHARACTERISTIC /end GROUP
/begin GROUP McuFunSafeMonitor_MFSM_FuncSafetyRedundancy_96us_sys_Subsystem_PhaseCurrrentShortPwr_Parameter3 "McuFunSafeMonitor/MFSM_FuncSafetyRedundancy_96us_sys/Subsystem/PhaseCurrrentShortPwr/Parameter3" /begin REF_CHARACTERISTIC MFSM_DebounceIncrPhaCurrShortPwr_C /end REF_CHARACTERISTIC /end GROUP
/begin GROUP McuFunSafeMonitor_MFSM_FuncSafetyRedundancy_96us_sys_Subsystem_PhaseCurrrentShortPwr_Parameter4 "McuFunSafeMonitor/MFSM_FuncSafetyRedundancy_96us_sys/Subsystem/PhaseCurrrentShortPwr/Parameter4" /begin REF_CHARACTERISTIC MFSM_DebounceDecrPhaCurrShortPwr_C /end REF_CHARACTERISTIC /end GROUP
/begin GROUP McuFunSafeMonitor_MFSM_FuncSafetyRedundancy_96us_sys_Subsystem_PhaseCurrrentShortPwr_Parameter5 "McuFunSafeMonitor/MFSM_FuncSafetyRedundancy_96us_sys/Subsystem/PhaseCurrrentShortPwr/Parameter5" /begin REF_CHARACTERISTIC MFSM_DebounceMinPhaCurrShortPwr_C /end REF_CHARACTERISTIC /end GROUP
/begin GROUP McuFunSafeMonitor_MFSM_FuncSafetyRedundancy_96us_sys_Subsystem_PhaseCurrrentShortPwr_Subsystem "McuFunSafeMonitor/MFSM_FuncSafetyRedundancy_96us_sys/Subsystem/PhaseCurrrentShortPwr/Subsystem"
 /begin SUB_GROUP McuFunSafeMonitor_MFSM_FuncSafetyRedundancy_96us_sys_Subsystem_PhaseCurrrentShortPwr_Subsystem_Parameter7 /end SUB_GROUP
/end GROUP
/begin GROUP McuFunSafeMonitor_MFSM_FuncSafetyRedundancy_96us_sys_Subsystem_PhaseCurrrentShortPwr_Subsystem_Parameter7 "McuFunSafeMonitor/MFSM_FuncSafetyRedundancy_96us_sys/Subsystem/PhaseCurrrentShortPwr/Subsystem/Parameter7" /begin REF_CHARACTERISTIC MFSM_PhaCurrShortPwrValue_C /end REF_CHARACTERISTIC /end GROUP
/begin GROUP McuFunSafeMonitor_MFSM_FuncSafetyRedundancy_96us_sys_Subsystem_RslvrAmpFualt "McuFunSafeMonitor/MFSM_FuncSafetyRedundancy_96us_sys/Subsystem/RslvrAmpFualt"
 /begin SUB_GROUP McuFunSafeMonitor_MFSM_FuncSafetyRedundancy_96us_sys_Subsystem_RslvrAmpFualt_FaultDebounce McuFunSafeMonitor_MFSM_FuncSafetyRedundancy_96us_sys_Subsystem_RslvrAmpFualt_Fault_Determination McuFunSafeMonitor_MFSM_FuncSafetyRedundancy_96us_sys_Subsystem_RslvrAmpFualt_Parameter2 McuFunSafeMonitor_MFSM_FuncSafetyRedundancy_96us_sys_Subsystem_RslvrAmpFualt_Parameter3 McuFunSafeMonitor_MFSM_FuncSafetyRedundancy_96us_sys_Subsystem_RslvrAmpFualt_Parameter4 McuFunSafeMonitor_MFSM_FuncSafetyRedundancy_96us_sys_Subsystem_RslvrAmpFualt_Parameter5 /end SUB_GROUP
 /begin REF_MEASUREMENT McuFunSafeMonitor_B.DataTypeConversion McuFunSafeMonitor_ConstB.DataTypeConversion1 /end REF_MEASUREMENT
/end GROUP
/begin GROUP McuFunSafeMonitor_MFSM_FuncSafetyRedundancy_96us_sys_Subsystem_RslvrAmpFualt_FaultDebounce "McuFunSafeMonitor/MFSM_FuncSafetyRedundancy_96us_sys/Subsystem/RslvrAmpFualt/FaultDebounce"
 /begin SUB_GROUP McuFunSafeMonitor_MFSM_FuncSafetyRedundancy_96us_sys_Subsystem_RslvrAmpFualt_FaultDebounce_Subsystem McuFunSafeMonitor_MFSM_FuncSafetyRedundancy_96us_sys_Subsystem_RslvrAmpFualt_FaultDebounce_UnitDelay /end SUB_GROUP
/end GROUP
/begin GROUP McuFunSafeMonitor_MFSM_FuncSafetyRedundancy_96us_sys_Subsystem_RslvrAmpFualt_FaultDebounce_Subsystem "McuFunSafeMonitor/MFSM_FuncSafetyRedundancy_96us_sys/Subsystem/RslvrAmpFualt/FaultDebounce/Subsystem" /begin REF_MEASUREMENT McuFunSafeMonitor_DW.Memory_PreviousInput /end REF_MEASUREMENT /end GROUP
/begin GROUP McuFunSafeMonitor_MFSM_FuncSafetyRedundancy_96us_sys_Subsystem_RslvrAmpFualt_FaultDebounce_UnitDelay "McuFunSafeMonitor/MFSM_FuncSafetyRedundancy_96us_sys/Subsystem/RslvrAmpFualt/FaultDebounce/UnitDelay"
 /begin REF_MEASUREMENT McuFunSafeMonitor_ConstB.DataTypeConversion1 McuFunSafeMonitor_ConstB.LogicalOperator1 McuFunSafeMonitor_DW.BareUnitDelay_DSTATE /end REF_MEASUREMENT
/end GROUP
/begin GROUP McuFunSafeMonitor_MFSM_FuncSafetyRedundancy_96us_sys_Subsystem_RslvrAmpFualt_Fault_Determination "McuFunSafeMonitor/MFSM_FuncSafetyRedundancy_96us_sys/Subsystem/RslvrAmpFualt/Fault Determination"
 /begin SUB_GROUP McuFunSafeMonitor_MFSM_FuncSafetyRedundancy_96us_sys_Subsystem_RslvrAmpFualt_Fault_Determination_Local_Variable_Storage1 McuFunSafeMonitor_MFSM_FuncSafetyRedundancy_96us_sys_Subsystem_RslvrAmpFualt_Fault_Determination_Parameter1 McuFunSafeMonitor_MFSM_FuncSafetyRedundancy_96us_sys_Subsystem_RslvrAmpFualt_Fault_Determination_Parameter6 /end SUB_GROUP
 /begin REF_MEASUREMENT SGRD_CosEnvelope SGRD_SinEnvelope /end REF_MEASUREMENT
/end GROUP
/begin GROUP McuFunSafeMonitor_MFSM_FuncSafetyRedundancy_96us_sys_Subsystem_RslvrAmpFualt_Fault_Determination_Local_Variable_Storage1 "McuFunSafeMonitor/MFSM_FuncSafetyRedundancy_96us_sys/Subsystem/RslvrAmpFualt/Fault Determination/Local Variable Storage1" /begin REF_MEASUREMENT MFSM_RslvrAmpSum /end REF_MEASUREMENT /end GROUP
/begin GROUP McuFunSafeMonitor_MFSM_FuncSafetyRedundancy_96us_sys_Subsystem_RslvrAmpFualt_Fault_Determination_Parameter1 "McuFunSafeMonitor/MFSM_FuncSafetyRedundancy_96us_sys/Subsystem/RslvrAmpFualt/Fault Determination/Parameter1" /begin REF_CHARACTERISTIC MFSM_AmpLow_C /end REF_CHARACTERISTIC /end GROUP
/begin GROUP McuFunSafeMonitor_MFSM_FuncSafetyRedundancy_96us_sys_Subsystem_RslvrAmpFualt_Fault_Determination_Parameter6 "McuFunSafeMonitor/MFSM_FuncSafetyRedundancy_96us_sys/Subsystem/RslvrAmpFualt/Fault Determination/Parameter6" /begin REF_CHARACTERISTIC MFSM_AmpHigh_C /end REF_CHARACTERISTIC /end GROUP
/begin GROUP McuFunSafeMonitor_MFSM_FuncSafetyRedundancy_96us_sys_Subsystem_RslvrAmpFualt_Parameter2 "McuFunSafeMonitor/MFSM_FuncSafetyRedundancy_96us_sys/Subsystem/RslvrAmpFualt/Parameter2" /begin REF_CHARACTERISTIC MFSM_DebounceMaxRslvrAmp_C /end REF_CHARACTERISTIC /end GROUP
/begin GROUP McuFunSafeMonitor_MFSM_FuncSafetyRedundancy_96us_sys_Subsystem_RslvrAmpFualt_Parameter3 "McuFunSafeMonitor/MFSM_FuncSafetyRedundancy_96us_sys/Subsystem/RslvrAmpFualt/Parameter3" /begin REF_CHARACTERISTIC MFSM_DebounceIncrRslvrAmp_C /end REF_CHARACTERISTIC /end GROUP
/begin GROUP McuFunSafeMonitor_MFSM_FuncSafetyRedundancy_96us_sys_Subsystem_RslvrAmpFualt_Parameter4 "McuFunSafeMonitor/MFSM_FuncSafetyRedundancy_96us_sys/Subsystem/RslvrAmpFualt/Parameter4" /begin REF_CHARACTERISTIC MFSM_DebounceDecrRslvrAmp_C /end REF_CHARACTERISTIC /end GROUP
/begin GROUP McuFunSafeMonitor_MFSM_FuncSafetyRedundancy_96us_sys_Subsystem_RslvrAmpFualt_Parameter5 "McuFunSafeMonitor/MFSM_FuncSafetyRedundancy_96us_sys/Subsystem/RslvrAmpFualt/Parameter5" /begin REF_CHARACTERISTIC MFSM_DebounceMinRslvrAmp_C /end REF_CHARACTERISTIC /end GROUP
/begin GROUP McuFunSafeMonitor_MFSM_FuncSafetyRedundancy_96us_sys_Subsystem_SinOpenFualt "McuFunSafeMonitor/MFSM_FuncSafetyRedundancy_96us_sys/Subsystem/SinOpenFualt"
 /begin SUB_GROUP McuFunSafeMonitor_MFSM_FuncSafetyRedundancy_96us_sys_Subsystem_SinOpenFualt_FaultDebounce McuFunSafeMonitor_MFSM_FuncSafetyRedundancy_96us_sys_Subsystem_SinOpenFualt_Local_Variable_Storage1 McuFunSafeMonitor_MFSM_FuncSafetyRedundancy_96us_sys_Subsystem_SinOpenFualt_Local_Variable_Storage3 McuFunSafeMonitor_MFSM_FuncSafetyRedundancy_96us_sys_Subsystem_SinOpenFualt_Parameter1 McuFunSafeMonitor_MFSM_FuncSafetyRedundancy_96us_sys_Subsystem_SinOpenFualt_Parameter2 McuFunSafeMonitor_MFSM_FuncSafetyRedundancy_96us_sys_Subsystem_SinOpenFualt_Parameter3 McuFunSafeMonitor_MFSM_FuncSafetyRedundancy_96us_sys_Subsystem_SinOpenFualt_Parameter4 McuFunSafeMonitor_MFSM_FuncSafetyRedundancy_96us_sys_Subsystem_SinOpenFualt_Parameter5 McuFunSafeMonitor_MFSM_FuncSafetyRedundancy_96us_sys_Subsystem_SinOpenFualt_Parameter6 /end SUB_GROUP
 /begin REF_MEASUREMENT McuFunSafeMonitor_B.DataTypeConversion_ee McuFunSafeMonitor_ConstB.DataTypeConversion1_f /end REF_MEASUREMENT
/end GROUP
/begin GROUP McuFunSafeMonitor_MFSM_FuncSafetyRedundancy_96us_sys_Subsystem_SinOpenFualt_FaultDebounce "McuFunSafeMonitor/MFSM_FuncSafetyRedundancy_96us_sys/Subsystem/SinOpenFualt/FaultDebounce"
 /begin SUB_GROUP McuFunSafeMonitor_MFSM_FuncSafetyRedundancy_96us_sys_Subsystem_SinOpenFualt_FaultDebounce_Subsystem McuFunSafeMonitor_MFSM_FuncSafetyRedundancy_96us_sys_Subsystem_SinOpenFualt_FaultDebounce_UnitDelay /end SUB_GROUP
/end GROUP
/begin GROUP McuFunSafeMonitor_MFSM_FuncSafetyRedundancy_96us_sys_Subsystem_SinOpenFualt_FaultDebounce_Subsystem "McuFunSafeMonitor/MFSM_FuncSafetyRedundancy_96us_sys/Subsystem/SinOpenFualt/FaultDebounce/Subsystem" /begin REF_MEASUREMENT McuFunSafeMonitor_DW.Memory_PreviousInput_hq /end REF_MEASUREMENT /end GROUP
/begin GROUP McuFunSafeMonitor_MFSM_FuncSafetyRedundancy_96us_sys_Subsystem_SinOpenFualt_FaultDebounce_UnitDelay "McuFunSafeMonitor/MFSM_FuncSafetyRedundancy_96us_sys/Subsystem/SinOpenFualt/FaultDebounce/UnitDelay"
 /begin REF_MEASUREMENT McuFunSafeMonitor_ConstB.DataTypeConversion1_f McuFunSafeMonitor_ConstB.LogicalOperator1_f2 McuFunSafeMonitor_DW.BareUnitDelay_DSTATE_m /end REF_MEASUREMENT
/end GROUP
/begin GROUP McuFunSafeMonitor_MFSM_FuncSafetyRedundancy_96us_sys_Subsystem_SinOpenFualt_Local_Variable_Storage1 "McuFunSafeMonitor/MFSM_FuncSafetyRedundancy_96us_sys/Subsystem/SinOpenFualt/Local Variable Storage1" /begin REF_MEASUREMENT MFSM_SinSum /end REF_MEASUREMENT /end GROUP
/begin GROUP McuFunSafeMonitor_MFSM_FuncSafetyRedundancy_96us_sys_Subsystem_SinOpenFualt_Local_Variable_Storage3 "McuFunSafeMonitor/MFSM_FuncSafetyRedundancy_96us_sys/Subsystem/SinOpenFualt/Local Variable Storage3" /begin REF_MEASUREMENT MFSM_SinDiff /end REF_MEASUREMENT /end GROUP
/begin GROUP McuFunSafeMonitor_MFSM_FuncSafetyRedundancy_96us_sys_Subsystem_SinOpenFualt_Parameter1 "McuFunSafeMonitor/MFSM_FuncSafetyRedundancy_96us_sys/Subsystem/SinOpenFualt/Parameter1" /begin REF_CHARACTERISTIC MFSM_MinSinOpenValue_C /end REF_CHARACTERISTIC /end GROUP
/begin GROUP McuFunSafeMonitor_MFSM_FuncSafetyRedundancy_96us_sys_Subsystem_SinOpenFualt_Parameter2 "McuFunSafeMonitor/MFSM_FuncSafetyRedundancy_96us_sys/Subsystem/SinOpenFualt/Parameter2" /begin REF_CHARACTERISTIC MFSM_DebounceMaxSinOpen_C /end REF_CHARACTERISTIC /end GROUP
/begin GROUP McuFunSafeMonitor_MFSM_FuncSafetyRedundancy_96us_sys_Subsystem_SinOpenFualt_Parameter3 "McuFunSafeMonitor/MFSM_FuncSafetyRedundancy_96us_sys/Subsystem/SinOpenFualt/Parameter3" /begin REF_CHARACTERISTIC MFSM_DebounceIncrSinOpen_C /end REF_CHARACTERISTIC /end GROUP
/begin GROUP McuFunSafeMonitor_MFSM_FuncSafetyRedundancy_96us_sys_Subsystem_SinOpenFualt_Parameter4 "McuFunSafeMonitor/MFSM_FuncSafetyRedundancy_96us_sys/Subsystem/SinOpenFualt/Parameter4" /begin REF_CHARACTERISTIC MFSM_DebounceDecrSinOpen_C /end REF_CHARACTERISTIC /end GROUP
/begin GROUP McuFunSafeMonitor_MFSM_FuncSafetyRedundancy_96us_sys_Subsystem_SinOpenFualt_Parameter5 "McuFunSafeMonitor/MFSM_FuncSafetyRedundancy_96us_sys/Subsystem/SinOpenFualt/Parameter5" /begin REF_CHARACTERISTIC MFSM_DebounceMinSinOpen_C /end REF_CHARACTERISTIC /end GROUP
/begin GROUP McuFunSafeMonitor_MFSM_FuncSafetyRedundancy_96us_sys_Subsystem_SinOpenFualt_Parameter6 "McuFunSafeMonitor/MFSM_FuncSafetyRedundancy_96us_sys/Subsystem/SinOpenFualt/Parameter6" /begin REF_CHARACTERISTIC MFSM_MaxSinOpenValue_C /end REF_CHARACTERISTIC /end GROUP
/begin GROUP McuFunSafeMonitor_MFSM_FuncSafetyRedundancy_96us_sys_Subsystem_SinSigShortGndFualt "McuFunSafeMonitor/MFSM_FuncSafetyRedundancy_96us_sys/Subsystem/SinSigShortGndFualt"
 /begin SUB_GROUP McuFunSafeMonitor_MFSM_FuncSafetyRedundancy_96us_sys_Subsystem_SinSigShortGndFualt_FaultDebounce McuFunSafeMonitor_MFSM_FuncSafetyRedundancy_96us_sys_Subsystem_SinSigShortGndFualt_Parameter1 McuFunSafeMonitor_MFSM_FuncSafetyRedundancy_96us_sys_Subsystem_SinSigShortGndFualt_Parameter2 McuFunSafeMonitor_MFSM_FuncSafetyRedundancy_96us_sys_Subsystem_SinSigShortGndFualt_Parameter3 McuFunSafeMonitor_MFSM_FuncSafetyRedundancy_96us_sys_Subsystem_SinSigShortGndFualt_Parameter4 McuFunSafeMonitor_MFSM_FuncSafetyRedundancy_96us_sys_Subsystem_SinSigShortGndFualt_Parameter5 /end SUB_GROUP
 /begin REF_MEASUREMENT McuFunSafeMonitor_B.DataTypeConversion_dg McuFunSafeMonitor_ConstB.DataTypeConversion1_l /end REF_MEASUREMENT
/end GROUP
/begin GROUP McuFunSafeMonitor_MFSM_FuncSafetyRedundancy_96us_sys_Subsystem_SinSigShortGndFualt_FaultDebounce "McuFunSafeMonitor/MFSM_FuncSafetyRedundancy_96us_sys/Subsystem/SinSigShortGndFualt/FaultDebounce"
 /begin SUB_GROUP McuFunSafeMonitor_MFSM_FuncSafetyRedundancy_96us_sys_Subsystem_SinSigShortGndFualt_FaultDebounce_Subsystem McuFunSafeMonitor_MFSM_FuncSafetyRedundancy_96us_sys_Subsystem_SinSigShortGndFualt_FaultDebounce_UnitDelay /end SUB_GROUP
/end GROUP
/begin GROUP McuFunSafeMonitor_MFSM_FuncSafetyRedundancy_96us_sys_Subsystem_SinSigShortGndFualt_FaultDebounce_Subsystem "McuFunSafeMonitor/MFSM_FuncSafetyRedundancy_96us_sys/Subsystem/SinSigShortGndFualt/FaultDebounce/Subsystem" /begin REF_MEASUREMENT McuFunSafeMonitor_DW.Memory_PreviousInput_ig /end REF_MEASUREMENT /end GROUP
/begin GROUP McuFunSafeMonitor_MFSM_FuncSafetyRedundancy_96us_sys_Subsystem_SinSigShortGndFualt_FaultDebounce_UnitDelay "McuFunSafeMonitor/MFSM_FuncSafetyRedundancy_96us_sys/Subsystem/SinSigShortGndFualt/FaultDebounce/UnitDelay"
 /begin REF_MEASUREMENT McuFunSafeMonitor_ConstB.DataTypeConversion1_l McuFunSafeMonitor_ConstB.LogicalOperator1_mx McuFunSafeMonitor_DW.BareUnitDelay_DSTATE_hu /end REF_MEASUREMENT
/end GROUP
/begin GROUP McuFunSafeMonitor_MFSM_FuncSafetyRedundancy_96us_sys_Subsystem_SinSigShortGndFualt_Parameter1 "McuFunSafeMonitor/MFSM_FuncSafetyRedundancy_96us_sys/Subsystem/SinSigShortGndFualt/Parameter1" /begin REF_CHARACTERISTIC MFSM_SinShortGndValue_C /end REF_CHARACTERISTIC /end GROUP
/begin GROUP McuFunSafeMonitor_MFSM_FuncSafetyRedundancy_96us_sys_Subsystem_SinSigShortGndFualt_Parameter2 "McuFunSafeMonitor/MFSM_FuncSafetyRedundancy_96us_sys/Subsystem/SinSigShortGndFualt/Parameter2" /begin REF_CHARACTERISTIC MFSM_DebounceMaxSinShortGnd_C /end REF_CHARACTERISTIC /end GROUP
/begin GROUP McuFunSafeMonitor_MFSM_FuncSafetyRedundancy_96us_sys_Subsystem_SinSigShortGndFualt_Parameter3 "McuFunSafeMonitor/MFSM_FuncSafetyRedundancy_96us_sys/Subsystem/SinSigShortGndFualt/Parameter3" /begin REF_CHARACTERISTIC MFSM_DebounceIncrSinShortGnd_C /end REF_CHARACTERISTIC /end GROUP
/begin GROUP McuFunSafeMonitor_MFSM_FuncSafetyRedundancy_96us_sys_Subsystem_SinSigShortGndFualt_Parameter4 "McuFunSafeMonitor/MFSM_FuncSafetyRedundancy_96us_sys/Subsystem/SinSigShortGndFualt/Parameter4" /begin REF_CHARACTERISTIC MFSM_DebounceDecrSinShortGnd_C /end REF_CHARACTERISTIC /end GROUP
/begin GROUP McuFunSafeMonitor_MFSM_FuncSafetyRedundancy_96us_sys_Subsystem_SinSigShortGndFualt_Parameter5 "McuFunSafeMonitor/MFSM_FuncSafetyRedundancy_96us_sys/Subsystem/SinSigShortGndFualt/Parameter5" /begin REF_CHARACTERISTIC MFSM_DebounceMinSinShortGnd_C /end REF_CHARACTERISTIC /end GROUP
/begin GROUP McuFunSafeMonitor_MFSM_FuncSafetyRedundancy_96us_sys_Subsystem_SinSigShortPwrFualt "McuFunSafeMonitor/MFSM_FuncSafetyRedundancy_96us_sys/Subsystem/SinSigShortPwrFualt"
 /begin SUB_GROUP McuFunSafeMonitor_MFSM_FuncSafetyRedundancy_96us_sys_Subsystem_SinSigShortPwrFualt_FaultDebounce McuFunSafeMonitor_MFSM_FuncSafetyRedundancy_96us_sys_Subsystem_SinSigShortPwrFualt_Parameter1 McuFunSafeMonitor_MFSM_FuncSafetyRedundancy_96us_sys_Subsystem_SinSigShortPwrFualt_Parameter2 McuFunSafeMonitor_MFSM_FuncSafetyRedundancy_96us_sys_Subsystem_SinSigShortPwrFualt_Parameter3 McuFunSafeMonitor_MFSM_FuncSafetyRedundancy_96us_sys_Subsystem_SinSigShortPwrFualt_Parameter4 McuFunSafeMonitor_MFSM_FuncSafetyRedundancy_96us_sys_Subsystem_SinSigShortPwrFualt_Parameter5 /end SUB_GROUP
 /begin REF_MEASUREMENT McuFunSafeMonitor_B.DataTypeConversion_eb McuFunSafeMonitor_ConstB.DataTypeConversion1_b /end REF_MEASUREMENT
/end GROUP
/begin GROUP McuFunSafeMonitor_MFSM_FuncSafetyRedundancy_96us_sys_Subsystem_SinSigShortPwrFualt_FaultDebounce "McuFunSafeMonitor/MFSM_FuncSafetyRedundancy_96us_sys/Subsystem/SinSigShortPwrFualt/FaultDebounce"
 /begin SUB_GROUP McuFunSafeMonitor_MFSM_FuncSafetyRedundancy_96us_sys_Subsystem_SinSigShortPwrFualt_FaultDebounce_Subsystem McuFunSafeMonitor_MFSM_FuncSafetyRedundancy_96us_sys_Subsystem_SinSigShortPwrFualt_FaultDebounce_UnitDelay /end SUB_GROUP
/end GROUP
/begin GROUP McuFunSafeMonitor_MFSM_FuncSafetyRedundancy_96us_sys_Subsystem_SinSigShortPwrFualt_FaultDebounce_Subsystem "McuFunSafeMonitor/MFSM_FuncSafetyRedundancy_96us_sys/Subsystem/SinSigShortPwrFualt/FaultDebounce/Subsystem" /begin REF_MEASUREMENT McuFunSafeMonitor_DW.Memory_PreviousInput_fa /end REF_MEASUREMENT /end GROUP
/begin GROUP McuFunSafeMonitor_MFSM_FuncSafetyRedundancy_96us_sys_Subsystem_SinSigShortPwrFualt_FaultDebounce_UnitDelay "McuFunSafeMonitor/MFSM_FuncSafetyRedundancy_96us_sys/Subsystem/SinSigShortPwrFualt/FaultDebounce/UnitDelay"
 /begin REF_MEASUREMENT McuFunSafeMonitor_ConstB.DataTypeConversion1_b McuFunSafeMonitor_ConstB.LogicalOperator1_ov McuFunSafeMonitor_DW.BareUnitDelay_DSTATE_pa /end REF_MEASUREMENT
/end GROUP
/begin GROUP McuFunSafeMonitor_MFSM_FuncSafetyRedundancy_96us_sys_Subsystem_SinSigShortPwrFualt_Parameter1 "McuFunSafeMonitor/MFSM_FuncSafetyRedundancy_96us_sys/Subsystem/SinSigShortPwrFualt/Parameter1" /begin REF_CHARACTERISTIC MFSM_SinShortPwrValue_C /end REF_CHARACTERISTIC /end GROUP
/begin GROUP McuFunSafeMonitor_MFSM_FuncSafetyRedundancy_96us_sys_Subsystem_SinSigShortPwrFualt_Parameter2 "McuFunSafeMonitor/MFSM_FuncSafetyRedundancy_96us_sys/Subsystem/SinSigShortPwrFualt/Parameter2" /begin REF_CHARACTERISTIC MFSM_DebounceMaxSinShortPwr_C /end REF_CHARACTERISTIC /end GROUP
/begin GROUP McuFunSafeMonitor_MFSM_FuncSafetyRedundancy_96us_sys_Subsystem_SinSigShortPwrFualt_Parameter3 "McuFunSafeMonitor/MFSM_FuncSafetyRedundancy_96us_sys/Subsystem/SinSigShortPwrFualt/Parameter3" /begin REF_CHARACTERISTIC MFSM_DebounceIncrSinShortPwr_C /end REF_CHARACTERISTIC /end GROUP
/begin GROUP McuFunSafeMonitor_MFSM_FuncSafetyRedundancy_96us_sys_Subsystem_SinSigShortPwrFualt_Parameter4 "McuFunSafeMonitor/MFSM_FuncSafetyRedundancy_96us_sys/Subsystem/SinSigShortPwrFualt/Parameter4" /begin REF_CHARACTERISTIC MFSM_DebounceDecrSinShortPwr_C /end REF_CHARACTERISTIC /end GROUP
/begin GROUP McuFunSafeMonitor_MFSM_FuncSafetyRedundancy_96us_sys_Subsystem_SinSigShortPwrFualt_Parameter5 "McuFunSafeMonitor/MFSM_FuncSafetyRedundancy_96us_sys/Subsystem/SinSigShortPwrFualt/Parameter5" /begin REF_CHARACTERISTIC MFSM_DebounceMinSinShortPwr_C /end REF_CHARACTERISTIC /end GROUP
/begin GROUP McuFunSafeMonitor_MFSM_FuncSafetyRedundancy_96us_sys_Subsystem_TorqueEstimate "McuFunSafeMonitor/MFSM_FuncSafetyRedundancy_96us_sys/Subsystem/TorqueEstimate"
 /begin SUB_GROUP McuFunSafeMonitor_MFSM_FuncSafetyRedundancy_96us_sys_Subsystem_TorqueEstimate_LowPassFilter McuFunSafeMonitor_MFSM_FuncSafetyRedundancy_96us_sys_Subsystem_TorqueEstimate_Parameter1 /end SUB_GROUP
 /begin REF_CHARACTERISTIC MFSM_ElecSpd_A MFSM_MtrEfficiency_M /end REF_CHARACTERISTIC
 /begin REF_MEASUREMENT McuFunSafeMonitor_DW.UnitDelay1_DSTATE McuFunSafeMonitor_DW.UnitDelay2_DSTATE McuFunSafeMonitor_DW.UnitDelay_DSTATE SGPP_BSW_f32_iSmpPhaU_A SGPP_BSW_f32_iSmpPhaW_A SGPP_BSW_f32_nRotateSpd_rpm SGPP_BSW_f32_uDcHV_V SGPP_FOC_f32_Uduty_Null SGPP_FOC_f32_Vduty_Null SGPP_FOC_f32_Wduty_Null /end REF_MEASUREMENT
/end GROUP
/begin GROUP McuFunSafeMonitor_MFSM_FuncSafetyRedundancy_96us_sys_Subsystem_TorqueEstimate_LowPassFilter "McuFunSafeMonitor/MFSM_FuncSafetyRedundancy_96us_sys/Subsystem/TorqueEstimate/LowPassFilter" /begin REF_MEASUREMENT McuFunSafeMonitor_DW.Delay_DSTATE_b /end REF_MEASUREMENT /end GROUP
/begin GROUP McuFunSafeMonitor_MFSM_FuncSafetyRedundancy_96us_sys_Subsystem_TorqueEstimate_Parameter1 "McuFunSafeMonitor/MFSM_FuncSafetyRedundancy_96us_sys/Subsystem/TorqueEstimate/Parameter1" /begin REF_CHARACTERISTIC MFSM_TorqueFilterFreq_C /end REF_CHARACTERISTIC /end GROUP
/end MODULE
/end PROJECT
/* (add any file trailer comments here) */
/* EOF McuFunSafeMonitor.a2l*/
