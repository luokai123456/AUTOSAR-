/******************************************************************************
* ASAP2 file: SrvOpenLoopService.a2l
* Code generation for model "SrvOpenLoopService".
* Model version : 1.30
* Simulink Coder version : 10.6 R2022b
* C source code generated on : Thu May 28 16:32:35 2026
* Target selection: ert.tlc
* Embedded hardware selection: Infineon->TriCore
* Code generation objectives: Unspecified
* Validation result: Not run
* (add additional file header information here)
******************************************************************************/ ASAP2_VERSION 1 31
/* Version 1.31 */
/begin PROJECT ProjectName "Project Comment Goes Here"
/begin HEADER "Header Comments go here" /end HEADER
/begin MODULE ModuleName "Module Comment Goes Here"
/begin MOD_PAR "MOD PAR Comment Goes Here" /end MOD_PAR
/begin MOD_COMMON "Mod Common Comment Here" BYTE_ORDER MSB_LAST ALIGNMENT_BYTE 1 ALIGNMENT_WORD 2 ALIGNMENT_LONG 4 ALIGNMENT_FLOAT32_IEEE 4 ALIGNMENT_FLOAT64_IEEE 4 /end MOD_COMMON
/begin CHARACTERISTIC SVOL_DirectionVoltAmp_C "Voltage amplitude for direction control mode" VALUE 0x0000 /* @ECU_Address@SVOL_DirectionVoltAmp_C@ */ Record_FLOAT32_IEEE 0 SrvOpenLoopService_CM_single_V 0.000000 1000.000000 /end CHARACTERISTIC
/begin CHARACTERISTIC SVOL_OpenLoopVoltGain_C "Voltage-to-speed gain for open-loop control (V/rpm)" VALUE 0x0000 /* @ECU_Address@SVOL_OpenLoopVoltGain_C@ */ Record_FLOAT32_IEEE 0 SrvOpenLoopService_CM_single_V 0.000000 1000.000000 /end CHARACTERISTIC
/begin CHARACTERISTIC SVOL_OpenLoopVoltOffset_C "Base voltage offset for open-loop control" VALUE 0x0000 /* @ECU_Address@SVOL_OpenLoopVoltOffset_C@ */ Record_FLOAT32_IEEE 0 SrvOpenLoopService_CM_single_V 0.000000 1000.000000 /end CHARACTERISTIC
/begin CHARACTERISTIC SVOL_ZeroCalStartFlag_C "" VALUE 0x0000 /* @ECU_Address@SVOL_ZeroCalStartFlag_C@ */ Record_BOOLEAN 0 SrvOpenLoopService_CM_logical 0.000000 1.000000 /end CHARACTERISTIC
/begin CHARACTERISTIC SVOL_ZeroDiff_C "" VALUE 0x0000 /* @ECU_Address@SVOL_ZeroDiff_C@ */ Record_FLOAT32_IEEE 0 SrvOpenLoopService_CM_single 0.000000 3.4E+38 /end CHARACTERISTIC
/begin CHARACTERISTIC SVOL_ZeroRadCalTimeTick_C "" VALUE 0x0000 /* @ECU_Address@SVOL_ZeroRadCalTimeTick_C@ */ Record_SLONG 0 SrvOpenLoopService_CM_int32 0.000000 2147483647 /end CHARACTERISTIC
/begin CHARACTERISTIC SVOL_ZeroRadCalVs_C "" VALUE 0x0000 /* @ECU_Address@SVOL_ZeroRadCalVs_C@ */ Record_FLOAT32_IEEE 0 SrvOpenLoopService_CM_single_V 0.000000 8.000000 /end CHARACTERISTIC
/begin MEASUREMENT CTSO_OperationMode "" UBYTE SrvOpenLoopService_CM_EnumCtlMode 0 0 0 14 ECU_ADDRESS 0x0000 /* @ECU_Address@CTSO_OperationMode@ */ /end MEASUREMENT
/begin MEASUREMENT SGPP_ElecAngle "" FLOAT32_IEEE SrvOpenLoopService_CM_single 0 0 -3.4E+38 3.4E+38 ECU_ADDRESS 0x0000 /* @ECU_Address@SGPP_ElecAngle@ */ /end MEASUREMENT
/begin MEASUREMENT SGPP_PolePairs "" UBYTE SrvOpenLoopService_CM_uint8 0 0 0 255 ECU_ADDRESS 0x0000 /* @ECU_Address@SGPP_PolePairs@ */ /end MEASUREMENT
/begin MEASUREMENT SGPP_SampleTime1 "" FLOAT32_IEEE SrvOpenLoopService_CM_single 0 0 -3.4E+38 3.4E+38 ECU_ADDRESS 0x0000 /* @ECU_Address@SGPP_SampleTime1@ */ /end MEASUREMENT
/begin MEASUREMENT SGPP_SpeedSp "" FLOAT32_IEEE SrvOpenLoopService_CM_single 0 0 -3.4E+38 3.4E+38 ECU_ADDRESS 0x0000 /* @ECU_Address@SGPP_SpeedSp@ */ /end MEASUREMENT
/begin MEASUREMENT SVOL_MtrZeroPoint "" FLOAT32_IEEE SrvOpenLoopService_CM_single 0 0 -3.4E+38 3.4E+38 ECU_ADDRESS 0x0000 /* @ECU_Address@SVOL_MtrZeroPoint@ */ /end MEASUREMENT
/begin MEASUREMENT SVOL_OpenLoopAlphaVolt "Alpha-axis voltage setpoint for open-loop control" FLOAT32_IEEE SrvOpenLoopService_CM_single_V 0 0 -5000.000000 5000.000000 /* Array Size */ ARRAY_SIZE 1 ECU_ADDRESS 0x0000 /* @ECU_Address@SVOL_OpenLoopAlphaVolt@ */ /end MEASUREMENT
/begin MEASUREMENT SVOL_OpenLoopBetaVolt "Beta-axis voltage setpoint for open-loop control" FLOAT32_IEEE SrvOpenLoopService_CM_single_V 0 0 -5000.000000 5000.000000 /* Array Size */ ARRAY_SIZE 1 ECU_ADDRESS 0x0000 /* @ECU_Address@SVOL_OpenLoopBetaVolt@ */ /end MEASUREMENT
/begin MEASUREMENT SVOL_ZeroCalResult "" UBYTE SrvOpenLoopService_CM_logical 0 0 0 1 ECU_ADDRESS 0x0000 /* @ECU_Address@SVOL_ZeroCalResult@ */ /end MEASUREMENT
/begin MEASUREMENT SrvOpenLoopService_B.FocVal_Ualpha "" FLOAT32_IEEE SrvOpenLoopService_CM_single_V 0 0 -3.4E+38 3.4E+38 ECU_ADDRESS 0x0000 /* @ECU_Address@SrvOpenLoopService_B.FocVal_Ualpha@ */ /end MEASUREMENT
/begin MEASUREMENT SrvOpenLoopService_B.FocVal_Ubeta "" FLOAT32_IEEE SrvOpenLoopService_CM_single_V 0 0 -3.4E+38 3.4E+38 ECU_ADDRESS 0x0000 /* @ECU_Address@SrvOpenLoopService_B.FocVal_Ubeta@ */ /end MEASUREMENT
/begin MEASUREMENT SrvOpenLoopService_DW.UnitDelay_DSTATE "" FLOAT32_IEEE SrvOpenLoopService_CM_single 0 0 -3.4E+38 3.4E+38 ECU_ADDRESS 0x0000 /* @ECU_Address@SrvOpenLoopService_DW.UnitDelay_DSTATE@ */ /end MEASUREMENT
/begin MEASUREMENT SrvOpenLoopService_DW.rad_temp_0 "" FLOAT32_IEEE SrvOpenLoopService_CM_single 0 0 -3.4E+38 3.4E+38 ECU_ADDRESS 0x0000 /* @ECU_Address@SrvOpenLoopService_DW.rad_temp_0@ */ /end MEASUREMENT
/begin MEASUREMENT SrvOpenLoopService_DW.rad_temp_90 "" FLOAT32_IEEE SrvOpenLoopService_CM_single 0 0 -3.4E+38 3.4E+38 ECU_ADDRESS 0x0000 /* @ECU_Address@SrvOpenLoopService_DW.rad_temp_90@ */ /end MEASUREMENT
/begin MEASUREMENT SrvOpenLoopService_DW.run_delay_cnt "" SLONG SrvOpenLoopService_CM_int32 0 0 -2147483648 2147483647 ECU_ADDRESS 0x0000 /* @ECU_Address@SrvOpenLoopService_DW.run_delay_cnt@ */ /end MEASUREMENT
/begin MEASUREMENT SrvOpenLoopService_DW.u8_zero_cal_fail "" UBYTE SrvOpenLoopService_CM_uint8 0 0 0 255 ECU_ADDRESS 0x0000 /* @ECU_Address@SrvOpenLoopService_DW.u8_zero_cal_fail@ */ /end MEASUREMENT
/begin COMPU_METHOD SrvOpenLoopService_CM_EnumCtlMode "Enumerated data type: EnumCtlMode" TAB_VERB "%0.6" "" /* Conversion Table */ COMPU_TAB_REF VTAB_FOR_SrvOpenLoopService_CM_EnumCtlMode /end COMPU_METHOD
/begin COMPU_VTAB /* Name of Table */ VTAB_FOR_SrvOpenLoopService_CM_EnumCtlMode "Enumerated data type: EnumCtlMode" TAB_VERB /* Number of Elements */ 15 0 "Init" 1 "LowVoltReady" 2 "HighVoltStandby" 3 "Ready" 4 "HighVoltDischarge" 5 "LowVoltDischarge" 6 "Discharge" 7 "PowerDown" 8 "Fault" 9 "OpenLoopCtrl" 10 "VoltDirectCtrl" 11 "CurrCtrl" 12 "TorqueCtrl" 13 "SpeedCtrl" 14 "ZeroPointCal" /end COMPU_VTAB
/begin COMPU_METHOD SrvOpenLoopService_CM_int32 "Q = V" RAT_FUNC "%10.0" "" COEFFS 0 1 0 0 0 1 /end COMPU_METHOD
/begin COMPU_METHOD SrvOpenLoopService_CM_logical "Q = V" RAT_FUNC "%1.0" "" COEFFS 0 1 0 0 0 1 /end COMPU_METHOD
/begin COMPU_METHOD SrvOpenLoopService_CM_single "Q = V" RAT_FUNC "%8.6" "" COEFFS 0 1 0 0 0 1 /end COMPU_METHOD
/begin COMPU_METHOD SrvOpenLoopService_CM_single_V "Q = V" RAT_FUNC "%8.6" "V" COEFFS 0 1 0 0 0 1 /end COMPU_METHOD
/begin COMPU_METHOD SrvOpenLoopService_CM_uint8 "Q = V" RAT_FUNC "%3.0" "" COEFFS 0 1 0 0 0 1 /end COMPU_METHOD
/begin RECORD_LAYOUT Record_BOOLEAN FNC_VALUES 1 UBYTE COLUMN_DIR DIRECT /end RECORD_LAYOUT
/begin RECORD_LAYOUT Record_FLOAT32_IEEE FNC_VALUES 1 FLOAT32_IEEE COLUMN_DIR DIRECT /end RECORD_LAYOUT
/begin RECORD_LAYOUT Record_SLONG FNC_VALUES 1 SLONG COLUMN_DIR DIRECT /end RECORD_LAYOUT
/begin RECORD_LAYOUT Record_UBYTE FNC_VALUES 1 UBYTE COLUMN_DIR DIRECT /end RECORD_LAYOUT
/begin GROUP SrvOpenLoopService "SrvOpenLoopService" /* Root */ ROOT /begin SUB_GROUP SrvOpenLoopService_SVOL_CalcAlphaBetaVolt_100us_sys /end SUB_GROUP
 /begin REF_MEASUREMENT CTSO_OperationMode SGPP_ElecAngle SGPP_PolePairs SGPP_SampleTime1 SGPP_SpeedSp /end REF_MEASUREMENT
/end GROUP
/begin GROUP SrvOpenLoopService_SVOL_CalcAlphaBetaVolt_100us_sys "SrvOpenLoopService/SVOL_CalcAlphaBetaVolt_100us_sys"
 /begin SUB_GROUP SrvOpenLoopService_SVOL_CalcAlphaBetaVolt_100us_sys_DirAmp SrvOpenLoopService_SVOL_CalcAlphaBetaVolt_100us_sys_OpenLoop SrvOpenLoopService_SVOL_CalcAlphaBetaVolt_100us_sys_ZeroCal /end SUB_GROUP
 /begin REF_MEASUREMENT CTSO_OperationMode /end REF_MEASUREMENT
/end GROUP
/begin GROUP SrvOpenLoopService_SVOL_CalcAlphaBetaVolt_100us_sys_DirAmp "SrvOpenLoopService/SVOL_CalcAlphaBetaVolt_100us_sys/DirAmp"
 /begin SUB_GROUP SrvOpenLoopService_SVOL_CalcAlphaBetaVolt_100us_sys_DirAmp_Parameter1 /end SUB_GROUP
 /begin REF_MEASUREMENT SGPP_ElecAngle /end REF_MEASUREMENT
/end GROUP
/begin GROUP SrvOpenLoopService_SVOL_CalcAlphaBetaVolt_100us_sys_DirAmp_Parameter1 "SrvOpenLoopService/SVOL_CalcAlphaBetaVolt_100us_sys/DirAmp/Parameter1" /begin REF_CHARACTERISTIC SVOL_DirectionVoltAmp_C /end REF_CHARACTERISTIC /end GROUP
/begin GROUP SrvOpenLoopService_SVOL_CalcAlphaBetaVolt_100us_sys_OpenLoop "SrvOpenLoopService/SVOL_CalcAlphaBetaVolt_100us_sys/OpenLoop"
 /begin SUB_GROUP SrvOpenLoopService_SVOL_CalcAlphaBetaVolt_100us_sys_OpenLoop_AlphaBetaCalc SrvOpenLoopService_SVOL_CalcAlphaBetaVolt_100us_sys_OpenLoop_SimThetaCalc /end SUB_GROUP
/end GROUP
/begin GROUP SrvOpenLoopService_SVOL_CalcAlphaBetaVolt_100us_sys_OpenLoop_AlphaBetaCalc "SrvOpenLoopService/SVOL_CalcAlphaBetaVolt_100us_sys/OpenLoop/AlphaBetaCalc"
 /begin SUB_GROUP SrvOpenLoopService_SVOL_CalcAlphaBetaVolt_100us_sys_OpenLoop_AlphaBetaCalc_Parameter1 SrvOpenLoopService_SVOL_CalcAlphaBetaVolt_100us_sys_OpenLoop_AlphaBetaCalc_Parameter2 /end SUB_GROUP
 /begin REF_MEASUREMENT SGPP_SpeedSp /end REF_MEASUREMENT
/end GROUP
/begin GROUP SrvOpenLoopService_SVOL_CalcAlphaBetaVolt_100us_sys_OpenLoop_AlphaBetaCalc_Parameter1 "SrvOpenLoopService/SVOL_CalcAlphaBetaVolt_100us_sys/OpenLoop/AlphaBetaCalc/Parameter1" /begin REF_CHARACTERISTIC SVOL_OpenLoopVoltGain_C /end REF_CHARACTERISTIC /end GROUP
/begin GROUP SrvOpenLoopService_SVOL_CalcAlphaBetaVolt_100us_sys_OpenLoop_AlphaBetaCalc_Parameter2 "SrvOpenLoopService/SVOL_CalcAlphaBetaVolt_100us_sys/OpenLoop/AlphaBetaCalc/Parameter2" /begin REF_CHARACTERISTIC SVOL_OpenLoopVoltOffset_C /end REF_CHARACTERISTIC /end GROUP
/begin GROUP SrvOpenLoopService_SVOL_CalcAlphaBetaVolt_100us_sys_OpenLoop_SimThetaCalc "SrvOpenLoopService/SVOL_CalcAlphaBetaVolt_100us_sys/OpenLoop/SimThetaCalc"
 /begin SUB_GROUP SrvOpenLoopService_SVOL_CalcAlphaBetaVolt_100us_sys_OpenLoop_SimThetaCalc_Subsystem /end SUB_GROUP
 /begin REF_MEASUREMENT SGPP_PolePairs SGPP_SpeedSp /end REF_MEASUREMENT
/end GROUP
/begin GROUP SrvOpenLoopService_SVOL_CalcAlphaBetaVolt_100us_sys_OpenLoop_SimThetaCalc_Subsystem "SrvOpenLoopService/SVOL_CalcAlphaBetaVolt_100us_sys/OpenLoop/SimThetaCalc/Subsystem" /begin REF_MEASUREMENT SGPP_SampleTime1 SrvOpenLoopService_DW.UnitDelay_DSTATE /end REF_MEASUREMENT /end GROUP
/begin GROUP SrvOpenLoopService_SVOL_CalcAlphaBetaVolt_100us_sys_ZeroCal "SrvOpenLoopService/SVOL_CalcAlphaBetaVolt_100us_sys/ZeroCal"
 /begin SUB_GROUP SrvOpenLoopService_SVOL_CalcAlphaBetaVolt_100us_sys_ZeroCal_Local_Variable_Storage1 SrvOpenLoopService_SVOL_CalcAlphaBetaVolt_100us_sys_ZeroCal_Local_Variable_Storage2 SrvOpenLoopService_SVOL_CalcAlphaBetaVolt_100us_sys_ZeroCal_Parameter1 SrvOpenLoopService_SVOL_CalcAlphaBetaVolt_100us_sys_ZeroCal_Parameter2 SrvOpenLoopService_SVOL_CalcAlphaBetaVolt_100us_sys_ZeroCal_Parameter3 SrvOpenLoopService_SVOL_CalcAlphaBetaVolt_100us_sys_ZeroCal_Parameter4 /end SUB_GROUP
 /begin REF_MEASUREMENT SGPP_ElecAngle SrvOpenLoopService_B.FocVal_Ualpha SrvOpenLoopService_B.FocVal_Ubeta SrvOpenLoopService_DW.rad_temp_0 SrvOpenLoopService_DW.rad_temp_90 SrvOpenLoopService_DW.run_delay_cnt SrvOpenLoopService_DW.u8_zero_cal_fail /end REF_MEASUREMENT
/end GROUP
/begin GROUP SrvOpenLoopService_SVOL_CalcAlphaBetaVolt_100us_sys_ZeroCal_Local_Variable_Storage1 "SrvOpenLoopService/SVOL_CalcAlphaBetaVolt_100us_sys/ZeroCal/Local Variable Storage1" /begin REF_MEASUREMENT SVOL_MtrZeroPoint /end REF_MEASUREMENT /end GROUP
/begin GROUP SrvOpenLoopService_SVOL_CalcAlphaBetaVolt_100us_sys_ZeroCal_Local_Variable_Storage2 "SrvOpenLoopService/SVOL_CalcAlphaBetaVolt_100us_sys/ZeroCal/Local Variable Storage2" /begin REF_MEASUREMENT SVOL_ZeroCalResult /end REF_MEASUREMENT /end GROUP
/begin GROUP SrvOpenLoopService_SVOL_CalcAlphaBetaVolt_100us_sys_ZeroCal_Parameter1 "SrvOpenLoopService/SVOL_CalcAlphaBetaVolt_100us_sys/ZeroCal/Parameter1" /begin REF_CHARACTERISTIC SVOL_ZeroRadCalVs_C /end REF_CHARACTERISTIC /end GROUP
/begin GROUP SrvOpenLoopService_SVOL_CalcAlphaBetaVolt_100us_sys_ZeroCal_Parameter2 "SrvOpenLoopService/SVOL_CalcAlphaBetaVolt_100us_sys/ZeroCal/Parameter2" /begin REF_CHARACTERISTIC SVOL_ZeroRadCalTimeTick_C /end REF_CHARACTERISTIC /end GROUP
/begin GROUP SrvOpenLoopService_SVOL_CalcAlphaBetaVolt_100us_sys_ZeroCal_Parameter3 "SrvOpenLoopService/SVOL_CalcAlphaBetaVolt_100us_sys/ZeroCal/Parameter3" /begin REF_CHARACTERISTIC SVOL_ZeroDiff_C /end REF_CHARACTERISTIC /end GROUP
/begin GROUP SrvOpenLoopService_SVOL_CalcAlphaBetaVolt_100us_sys_ZeroCal_Parameter4 "SrvOpenLoopService/SVOL_CalcAlphaBetaVolt_100us_sys/ZeroCal/Parameter4" /begin REF_CHARACTERISTIC SVOL_ZeroCalStartFlag_C /end REF_CHARACTERISTIC /end GROUP
/end MODULE
/end PROJECT
/* (add any file trailer comments here) */
/* EOF SrvOpenLoopService.a2l*/
