/******************************************************************************
* ASAP2 file: CtlStateOrchestrator.a2l
* Code generation for model "CtlStateOrchestrator".
* Model version : 1.14
* Simulink Coder version : 10.6 R2022b
* C source code generated on : Thu May 28 16:42:52 2026
* Target selection: ert.tlc
* Embedded hardware selection: Infineon->TriCore
* Code generation objectives: Unspecified
* Validation result: Not run
* (add additional file header information here)
******************************************************************************/ ASAP2_VERSION 1 31
/* Version 1.31 */
/begin PROJECT ProjectName "Project Comment Goes Here"
/begin HEADER "Header Comments go here" /end HEADER
/begin MODULE ModuleName "Module Comment Goes Here"
/begin MOD_PAR "MOD PAR Comment Goes Here" /end MOD_PAR
/begin MOD_COMMON "Mod Common Comment Here" BYTE_ORDER MSB_LAST ALIGNMENT_BYTE 1 ALIGNMENT_WORD 2 ALIGNMENT_LONG 4 ALIGNMENT_FLOAT32_IEEE 4 ALIGNMENT_FLOAT64_IEEE 4 /end MOD_COMMON
/begin CHARACTERISTIC CTSO_DischargeFaultReset_C "Reset flag for discharge fault condition" VALUE 0x0000 /* @ECU_Address@CTSO_DischargeFaultReset_C@ */ Record_UBYTE 0 CtlStateOrchestrator_CM_uint8 0 255 /end CHARACTERISTIC
/begin CHARACTERISTIC CTSO_FaultRecoveryEnable_C "Enable falut mode recovery" VALUE 0x0000 /* @ECU_Address@CTSO_FaultRecoveryEnable_C@ */ Record_UBYTE 0 CtlStateOrchestrator_CM_uint8 0 255 /end CHARACTERISTIC
/begin CHARACTERISTIC CTSO_IGBTOffVoltThreshold_C "The threshold below the dc-link voltage up to which the error reaction IgbtsOff is admissible" VALUE 0x0000 /* @ECU_Address@CTSO_IGBTOffVoltThreshold_C@ */ Record_FLOAT32_IEEE 0 CtlStateOrchestrator_CM_single_V 0.000000 1000.000000 /end CHARACTERISTIC
/begin CHARACTERISTIC CTSO_InitWaitTime_C "time of waiting gate driver initialization" VALUE 0x0000 /* @ECU_Address@CTSO_InitWaitTime_C@ */ Record_FLOAT32_IEEE 0 CtlStateOrchestrator_CM_single_s -3.4E+38 3.4E+38 /end CHARACTERISTIC
/begin CHARACTERISTIC CTSO_LowVoltStandbyEnable_C "Enable transition to standby mode on low DC voltage" VALUE 0x0000 /* @ECU_Address@CTSO_LowVoltStandbyEnable_C@ */ Record_UBYTE 0 CtlStateOrchestrator_CM_uint8 0 255 /end CHARACTERISTIC
/begin CHARACTERISTIC CTSO_MinVoltControl_C "Minimum DC link voltage for motor control enable" VALUE 0x0000 /* @ECU_Address@CTSO_MinVoltControl_C@ */ Record_FLOAT32_IEEE 0 CtlStateOrchestrator_CM_single_V 0.000000 1000.000000 /end CHARACTERISTIC
/begin CHARACTERISTIC CTSO_OpModeCondition_C "Input condition for suitable operating state 0 - as given by customer, 1 - to include additional states not  required by customer" VALUE 0x0000 /* @ECU_Address@CTSO_OpModeCondition_C@ */ Record_UBYTE 0 CtlStateOrchestrator_CM_uint8_dash_ 0.000000 255.000000 /end CHARACTERISTIC
/begin CHARACTERISTIC CTSO_OpModeSelection_C "Operating mode selection parameter" VALUE 0x0000 /* @ECU_Address@CTSO_OpModeSelection_C@ */ Record_UBYTE 0 CtlStateOrchestrator_CM_uint8_dash_ 0.000000 255.000000 /end CHARACTERISTIC
/begin CHARACTERISTIC CTSO_PowerdownVoltLimit_C "Voltage threshold for system power-down sequence" VALUE 0x0000 /* @ECU_Address@CTSO_PowerdownVoltLimit_C@ */ Record_FLOAT32_IEEE 0 CtlStateOrchestrator_CM_single_V -3.4E+38 3.4E+38 /end CHARACTERISTIC
/begin CHARACTERISTIC CTSO_ServiceModeEnable_C "Enable Service controlmodes, openloopvoltage etc." VALUE 0x0000 /* @ECU_Address@CTSO_ServiceModeEnable_C@ */ Record_UBYTE 0 CtlStateOrchestrator_CM_uint8_dash_ 0.000000 255.000000 /end CHARACTERISTIC
/begin CHARACTERISTIC CTSO_SpeedLimit_C "Speed limit" VALUE 0x0000 /* @ECU_Address@CTSO_SpeedLimit_C@ */ Record_FLOAT32_IEEE 0 CtlStateOrchestrator_CM_single_rpm -3.4E+38 3.4E+38 /end CHARACTERISTIC
/begin CHARACTERISTIC CTSO_VoltASCThreshold_C "DC voltage threshold for active short circuit mode selection" VALUE 0x0000 /* @ECU_Address@CTSO_VoltASCThreshold_C@ */ Record_FLOAT32_IEEE 0 CtlStateOrchestrator_CM_single -3.4E+38 3.4E+38 /end CHARACTERISTIC
/begin CHARACTERISTIC CTSO_VoltDischargeHighThr_C "Upper voltage threshold for discharge activation trigger" VALUE 0x0000 /* @ECU_Address@CTSO_VoltDischargeHighThr_C@ */ Record_FLOAT32_IEEE 0 CtlStateOrchestrator_CM_single_V -3.4E+38 3.4E+38 /end CHARACTERISTIC
/begin CHARACTERISTIC CTSO_VoltDischargeLowThr_C "Lower voltage threshold for discharge completion detection" VALUE 0x0000 /* @ECU_Address@CTSO_VoltDischargeLowThr_C@ */ Record_FLOAT32_IEEE 0 CtlStateOrchestrator_CM_single_V -3.4E+38 3.4E+38 /end CHARACTERISTIC
/begin CHARACTERISTIC CTSO_VoltPerSpeedRatio_C "DC link voltage per motor speed constant ratio" VALUE 0x0000 /* @ECU_Address@CTSO_VoltPerSpeedRatio_C@ */ Record_FLOAT32_IEEE 0 CtlStateOrchestrator_CM_single_dash_ -100.000000 100.000000 /end CHARACTERISTIC
/begin CHARACTERISTIC CTSO_WindingDischargeMaxTime_C "Maximum time for motor winding discharge" VALUE 0x0000 /* @ECU_Address@CTSO_WindingDischargeMaxTime_C@ */ Record_FLOAT32_IEEE 0 CtlStateOrchestrator_CM_single_s -3.4E+38 3.4E+38 /end CHARACTERISTIC
/begin MEASUREMENT CTSO_CurrentIntegralDisable "Disable flag for current controller integral term" UBYTE CtlStateOrchestrator_CM_uint8 0 0 0 255 ARRAY_SIZE 1 ECU_ADDRESS 0x0000 /* @ECU_Address@CTSO_CurrentIntegralDisable@ */
 /begin IF_DATA XCP
  /begin DAQ_EVENT VARIABLE /begin DEFAULT_EVENT_LIST EVENT 0x0002 /end DEFAULT_EVENT_LIST /end DAQ_EVENT
 /end IF_DATA
/end MEASUREMENT
/begin MEASUREMENT CTSO_CurrentIntegralReset "Reset flag for current controller integral term" UBYTE CtlStateOrchestrator_CM_uint8 0 0 0 255 ARRAY_SIZE 1 ECU_ADDRESS 0x0000 /* @ECU_Address@CTSO_CurrentIntegralReset@ */
 /begin IF_DATA XCP
  /begin DAQ_EVENT VARIABLE /begin DEFAULT_EVENT_LIST EVENT 0x0002 /end DEFAULT_EVENT_LIST /end DAQ_EVENT
 /end IF_DATA
/end MEASUREMENT
/begin MEASUREMENT CTSO_DischargeFaultFlag "Active discharge fault status flag" UBYTE CtlStateOrchestrator_CM_uint8 0 0 0 255 ARRAY_SIZE 1 ECU_ADDRESS 0x0000 /* @ECU_Address@CTSO_DischargeFaultFlag@ */
 /begin IF_DATA XCP
  /begin DAQ_EVENT VARIABLE /begin DEFAULT_EVENT_LIST EVENT 0x0002 /end DEFAULT_EVENT_LIST /end DAQ_EVENT
 /end IF_DATA
/end MEASUREMENT
/begin MEASUREMENT CTSO_FaultModeRequest_IRV "Fault mode operation request signal" UBYTE CtlStateOrchestrator_CM_uint8 0 0 0 255 ECU_ADDRESS 0x0000 /* @ECU_Address@CTSO_FaultModeRequest_IRV@ */
 /begin IF_DATA XCP
  /begin DAQ_EVENT VARIABLE /begin DEFAULT_EVENT_LIST EVENT 0x0000 /end DEFAULT_EVENT_LIST /end DAQ_EVENT
 /end IF_DATA
/end MEASUREMENT
/begin MEASUREMENT CTSO_IGBTOffAllowed "IGBT off operation permission flag" UBYTE CtlStateOrchestrator_CM_uint8 0 0 0 255 ECU_ADDRESS 0x0000 /* @ECU_Address@CTSO_IGBTOffAllowed@ */
 /begin IF_DATA XCP
  /begin DAQ_EVENT VARIABLE /begin DEFAULT_EVENT_LIST EVENT 0x0000 /end DEFAULT_EVENT_LIST /end DAQ_EVENT
 /end IF_DATA
/end MEASUREMENT
/begin MEASUREMENT CTSO_ModeSetpoint "Target operating mode setpoint selection" UBYTE CtlStateOrchestrator_CM_uint8 0 0 0.000000 255.000000 ECU_ADDRESS 0x0000 /* @ECU_Address@CTSO_ModeSetpoint@ */
 /begin IF_DATA XCP
  /begin DAQ_EVENT VARIABLE /begin DEFAULT_EVENT_LIST EVENT 0x0002 /end DEFAULT_EVENT_LIST /end DAQ_EVENT
 /end IF_DATA
/end MEASUREMENT
/begin MEASUREMENT CTSO_OperationMode "System operation mode state" UBYTE CtlStateOrchestrator_CM_uint8 0 0 0 255 ARRAY_SIZE 1 ECU_ADDRESS 0x0000 /* @ECU_Address@CTSO_OperationMode@ */
 /begin IF_DATA XCP
  /begin DAQ_EVENT VARIABLE /begin DEFAULT_EVENT_LIST EVENT 0x0002 /end DEFAULT_EVENT_LIST /end DAQ_EVENT
 /end IF_DATA
/end MEASUREMENT
/begin MEASUREMENT CTSO_PWMControlState "PWM unit control state" UBYTE CtlStateOrchestrator_CM_uint8 0 0 0 255 ECU_ADDRESS 0x0000 /* @ECU_Address@CTSO_PWMControlState@ */
 /begin IF_DATA XCP
  /begin DAQ_EVENT VARIABLE /begin DEFAULT_EVENT_LIST EVENT 0x0000 /end DEFAULT_EVENT_LIST /end DAQ_EVENT
 /end IF_DATA
/end MEASUREMENT
/begin MEASUREMENT CTSO_PWMRequest_IRV "PWM control state request signal" UBYTE CtlStateOrchestrator_CM_uint8 0 0 0 255 ARRAY_SIZE 1 ECU_ADDRESS 0x0000 /* @ECU_Address@CTSO_PWMRequest_IRV@ */
 /begin IF_DATA XCP
  /begin DAQ_EVENT VARIABLE /begin DEFAULT_EVENT_LIST EVENT 0x0002 /end DEFAULT_EVENT_LIST /end DAQ_EVENT
 /end IF_DATA
/end MEASUREMENT
/begin MEASUREMENT CTSO_SpeedCalcReset "Reset signal for speed calculation low-pass filter" UBYTE CtlStateOrchestrator_CM_uint8 0 0 0 255 ARRAY_SIZE 1 ECU_ADDRESS 0x0000 /* @ECU_Address@CTSO_SpeedCalcReset@ */
 /begin IF_DATA XCP
  /begin DAQ_EVENT VARIABLE /begin DEFAULT_EVENT_LIST EVENT 0x0002 /end DEFAULT_EVENT_LIST /end DAQ_EVENT
 /end IF_DATA
/end MEASUREMENT
/begin MEASUREMENT CTSO_SpeedIntegralDisable "signal for disabling of integrlpart of speed control" UBYTE CtlStateOrchestrator_CM_uint8 0 0 0 255 ARRAY_SIZE 1 ECU_ADDRESS 0x0000 /* @ECU_Address@CTSO_SpeedIntegralDisable@ */
 /begin IF_DATA XCP
  /begin DAQ_EVENT VARIABLE /begin DEFAULT_EVENT_LIST EVENT 0x0002 /end DEFAULT_EVENT_LIST /end DAQ_EVENT
 /end IF_DATA
/end MEASUREMENT
/begin MEASUREMENT CTSO_SpeedIntegralReset "Reset flag for speed controller integral term" UBYTE CtlStateOrchestrator_CM_uint8 0 0 0 255 ARRAY_SIZE 1 ECU_ADDRESS 0x0000 /* @ECU_Address@CTSO_SpeedIntegralReset@ */
 /begin IF_DATA XCP
  /begin DAQ_EVENT VARIABLE /begin DEFAULT_EVENT_LIST EVENT 0x0002 /end DEFAULT_EVENT_LIST /end DAQ_EVENT
 /end IF_DATA
/end MEASUREMENT
/begin MEASUREMENT CtlStateOrchestrator_B.CTSO_StPwm "" UBYTE CtlStateOrchestrator_CM_EnumCtlPwmState 0 0 0 4 ECU_ADDRESS 0x0000 /* @ECU_Address@CtlStateOrchestrator_B.CTSO_StPwm@ */
 /begin IF_DATA XCP
  /begin DAQ_EVENT VARIABLE /begin DEFAULT_EVENT_LIST EVENT 0x0000 /end DEFAULT_EVENT_LIST /end DAQ_EVENT
 /end IF_DATA
/end MEASUREMENT
/begin MEASUREMENT CtlStateOrchestrator_DW.CTSO_StInin "" UBYTE CtlStateOrchestrator_CM_uint8 0 0 0 255 ECU_ADDRESS 0x0000 /* @ECU_Address@CtlStateOrchestrator_DW.CTSO_StInin@ */
 /begin IF_DATA XCP
  /begin DAQ_EVENT VARIABLE /begin DEFAULT_EVENT_LIST EVENT 0x0002 /end DEFAULT_EVENT_LIST /end DAQ_EVENT
 /end IF_DATA
/end MEASUREMENT
/begin MEASUREMENT CtlStateOrchestrator_DW.Delay_DSTATE "" FLOAT32_IEEE CtlStateOrchestrator_CM_single 0 0 -3.4E+38 3.4E+38 ECU_ADDRESS 0x0000 /* @ECU_Address@CtlStateOrchestrator_DW.Delay_DSTATE@ */
 /begin IF_DATA XCP
  /begin DAQ_EVENT VARIABLE /begin DEFAULT_EVENT_LIST EVENT 0x0002 /end DEFAULT_EVENT_LIST /end DAQ_EVENT
 /end IF_DATA
/end MEASUREMENT
/begin MEASUREMENT CtlStateOrchestrator_DW.Delay_DSTATE_f "" UBYTE CtlStateOrchestrator_CM_uint8 0 0 0 255 ECU_ADDRESS 0x0000 /* @ECU_Address@CtlStateOrchestrator_DW.Delay_DSTATE_f@ */
 /begin IF_DATA XCP
  /begin DAQ_EVENT VARIABLE /begin DEFAULT_EVENT_LIST EVENT 0x0002 /end DEFAULT_EVENT_LIST /end DAQ_EVENT
 /end IF_DATA
/end MEASUREMENT
/begin MEASUREMENT CtlStateOrchestrator_DW.TiInin "" FLOAT32_IEEE CtlStateOrchestrator_CM_single 0 0 -3.4E+38 3.4E+38 ECU_ADDRESS 0x0000 /* @ECU_Address@CtlStateOrchestrator_DW.TiInin@ */
 /begin IF_DATA XCP
  /begin DAQ_EVENT VARIABLE /begin DEFAULT_EVENT_LIST EVENT 0x0002 /end DEFAULT_EVENT_LIST /end DAQ_EVENT
 /end IF_DATA
/end MEASUREMENT
/begin MEASUREMENT CtlStateOrchestrator_DW.UnitDelay_DSTATE "" FLOAT32_IEEE CtlStateOrchestrator_CM_single 0 0 -3.4E+38 3.4E+38 ECU_ADDRESS 0x0000 /* @ECU_Address@CtlStateOrchestrator_DW.UnitDelay_DSTATE@ */
 /begin IF_DATA XCP
  /begin DAQ_EVENT VARIABLE /begin DEFAULT_EVENT_LIST EVENT 0x0002 /end DEFAULT_EVENT_LIST /end DAQ_EVENT
 /end IF_DATA
/end MEASUREMENT
/begin MEASUREMENT CtlStateOrchestrator_DW.UnitDelay_DSTATE_c "" UBYTE CtlStateOrchestrator_CM_logical 0 0 0 1 ECU_ADDRESS 0x0000 /* @ECU_Address@CtlStateOrchestrator_DW.UnitDelay_DSTATE_c@ */
 /begin IF_DATA XCP
  /begin DAQ_EVENT VARIABLE /begin DEFAULT_EVENT_LIST EVENT 0x0000 /end DEFAULT_EVENT_LIST /end DAQ_EVENT
 /end IF_DATA
/end MEASUREMENT
/begin MEASUREMENT CtlStateOrchestrator_DW.is_MainControl "" UBYTE CtlStateOrchestrator_CM_uint8 0 0 0 255 ECU_ADDRESS 0x0000 /* @ECU_Address@CtlStateOrchestrator_DW.is_MainControl@ */
 /begin IF_DATA XCP
  /begin DAQ_EVENT VARIABLE /begin DEFAULT_EVENT_LIST EVENT 0x0002 /end DEFAULT_EVENT_LIST /end DAQ_EVENT
 /end IF_DATA
/end MEASUREMENT
/begin MEASUREMENT CtlStateOrchestrator_DW.is_active_c1_CtlStateOrchestrator "" UBYTE CtlStateOrchestrator_CM_uint8 0 0 0 255 ECU_ADDRESS 0x0000 /* @ECU_Address@CtlStateOrchestrator_DW.is_active_c1_CtlStateOrchestrator@ */
 /begin IF_DATA XCP
  /begin DAQ_EVENT VARIABLE /begin DEFAULT_EVENT_LIST EVENT 0x0000 /end DEFAULT_EVENT_LIST /end DAQ_EVENT
 /end IF_DATA
/end MEASUREMENT
/begin MEASUREMENT CtlStateOrchestrator_DW.is_c1_CtlStateOrchestrator "" UBYTE CtlStateOrchestrator_CM_uint8 0 0 0 255 ECU_ADDRESS 0x0000 /* @ECU_Address@CtlStateOrchestrator_DW.is_c1_CtlStateOrchestrator@ */
 /begin IF_DATA XCP
  /begin DAQ_EVENT VARIABLE /begin DEFAULT_EVENT_LIST EVENT 0x0000 /end DEFAULT_EVENT_LIST /end DAQ_EVENT
 /end IF_DATA
/end MEASUREMENT
/begin MEASUREMENT CtlStateOrchestrator_DW.is_c3_CtlStateOrchestrator "" UBYTE CtlStateOrchestrator_CM_uint8 0 0 0 255 ECU_ADDRESS 0x0000 /* @ECU_Address@CtlStateOrchestrator_DW.is_c3_CtlStateOrchestrator@ */
 /begin IF_DATA XCP
  /begin DAQ_EVENT VARIABLE /begin DEFAULT_EVENT_LIST EVENT 0x0002 /end DEFAULT_EVENT_LIST /end DAQ_EVENT
 /end IF_DATA
/end MEASUREMENT
/begin MEASUREMENT FLDG_ActiveShortHsReq "" UBYTE CtlStateOrchestrator_CM_uint8 0 0 0 255 ECU_ADDRESS 0x0000 /* @ECU_Address@FLDG_ActiveShortHsReq@ */
 /begin IF_DATA XCP
  /begin DAQ_EVENT VARIABLE /begin DEFAULT_EVENT_LIST EVENT 0x0000 /end DEFAULT_EVENT_LIST /end DAQ_EVENT
 /end IF_DATA
/end MEASUREMENT
/begin MEASUREMENT FLDG_HwHsShortErr "" UBYTE CtlStateOrchestrator_CM_uint8 0 0 0 255 ECU_ADDRESS 0x0000 /* @ECU_Address@FLDG_HwHsShortErr@ */
 /begin IF_DATA XCP
  /begin DAQ_EVENT VARIABLE /begin DEFAULT_EVENT_LIST EVENT 0x0000 /end DEFAULT_EVENT_LIST /end DAQ_EVENT
 /end IF_DATA
/end MEASUREMENT
/begin MEASUREMENT FLDG_HwLsShortErr "" UBYTE CtlStateOrchestrator_CM_uint8 0 0 0 255 ECU_ADDRESS 0x0000 /* @ECU_Address@FLDG_HwLsShortErr@ */
 /begin IF_DATA XCP
  /begin DAQ_EVENT VARIABLE /begin DEFAULT_EVENT_LIST EVENT 0x0000 /end DEFAULT_EVENT_LIST /end DAQ_EVENT
 /end IF_DATA
/end MEASUREMENT
/begin MEASUREMENT FLDG_PowerSwitchOffReq "" UBYTE CtlStateOrchestrator_CM_uint8 0 0 0 255 ECU_ADDRESS 0x0000 /* @ECU_Address@FLDG_PowerSwitchOffReq@ */
 /begin IF_DATA XCP
  /begin DAQ_EVENT VARIABLE /begin DEFAULT_EVENT_LIST EVENT 0x0000 /end DEFAULT_EVENT_LIST /end DAQ_EVENT
 /end IF_DATA
/end MEASUREMENT
/begin MEASUREMENT FLDG_ResolverError "" UBYTE CtlStateOrchestrator_CM_uint8 0 0 0 255 ARRAY_SIZE 1 ECU_ADDRESS 0x0000 /* @ECU_Address@FLDG_ResolverError@ */
 /begin IF_DATA XCP
  /begin DAQ_EVENT VARIABLE /begin DEFAULT_EVENT_LIST EVENT 0x0000 /end DEFAULT_EVENT_LIST /end DAQ_EVENT
 /end IF_DATA
/end MEASUREMENT
/begin MEASUREMENT FLDG_ShutdownReq "" UBYTE CtlStateOrchestrator_CM_uint8 0 0 0 255 ECU_ADDRESS 0x0000 /* @ECU_Address@FLDG_ShutdownReq@ */
 /begin IF_DATA XCP
  /begin DAQ_EVENT VARIABLE /begin DEFAULT_EVENT_LIST EVENT 0x0000 /end DEFAULT_EVENT_LIST /end DAQ_EVENT
 /end IF_DATA
/end MEASUREMENT
/begin MEASUREMENT SGPP_DcLinkVoltMeas "" FLOAT32_IEEE CtlStateOrchestrator_CM_single 0 0 -3.4E+38 3.4E+38 ECU_ADDRESS 0x0000 /* @ECU_Address@SGPP_DcLinkVoltMeas@ */ /end MEASUREMENT
/begin MEASUREMENT SGPP_IgnitionStatus "" UBYTE CtlStateOrchestrator_CM_uint8 0 0 0 255 ECU_ADDRESS 0x0000 /* @ECU_Address@SGPP_IgnitionStatus@ */
 /begin IF_DATA XCP
  /begin DAQ_EVENT VARIABLE /begin DEFAULT_EVENT_LIST EVENT 0x0002 /end DEFAULT_EVENT_LIST /end DAQ_EVENT
 /end IF_DATA
/end MEASUREMENT
/begin MEASUREMENT SGPP_MechSpeedAbsolute "" FLOAT32_IEEE CtlStateOrchestrator_CM_single 0 0 -3.4E+38 3.4E+38 ECU_ADDRESS 0x0000 /* @ECU_Address@SGPP_MechSpeedAbsolute@ */ /end MEASUREMENT
/begin MEASUREMENT SGPP_SampleTime1 "" FLOAT32_IEEE CtlStateOrchestrator_CM_single 0 0 -3.4E+38 3.4E+38 ECU_ADDRESS 0x0000 /* @ECU_Address@SGPP_SampleTime1@ */
 /begin IF_DATA XCP
  /begin DAQ_EVENT VARIABLE /begin DEFAULT_EVENT_LIST EVENT 0x0000 /end DEFAULT_EVENT_LIST /end DAQ_EVENT
 /end IF_DATA
/end MEASUREMENT
/begin MEASUREMENT SGPP_SampleTime2 "" FLOAT32_IEEE CtlStateOrchestrator_CM_single 0 0 -3.4E+38 3.4E+38 ECU_ADDRESS 0x0000 /* @ECU_Address@SGPP_SampleTime2@ */
 /begin IF_DATA XCP
  /begin DAQ_EVENT VARIABLE /begin DEFAULT_EVENT_LIST EVENT 0x0002 /end DEFAULT_EVENT_LIST /end DAQ_EVENT
 /end IF_DATA
/end MEASUREMENT
/begin MEASUREMENT SGSA_BswInit "" UBYTE CtlStateOrchestrator_CM_uint8 0 0 0 255 ECU_ADDRESS 0x0000 /* @ECU_Address@SGSA_BswInit@ */
 /begin IF_DATA XCP
  /begin DAQ_EVENT VARIABLE /begin DEFAULT_EVENT_LIST EVENT 0x0002 /end DEFAULT_EVENT_LIST /end DAQ_EVENT
 /end IF_DATA
/end MEASUREMENT
/begin MEASUREMENT SGSA_ModeRequest "" UBYTE CtlStateOrchestrator_CM_uint8 0 0 0 255 ECU_ADDRESS 0x0000 /* @ECU_Address@SGSA_ModeRequest@ */
 /begin IF_DATA XCP
  /begin DAQ_EVENT VARIABLE /begin DEFAULT_EVENT_LIST EVENT 0x0002 /end DEFAULT_EVENT_LIST /end DAQ_EVENT
 /end IF_DATA
/end MEASUREMENT
/begin COMPU_METHOD CtlStateOrchestrator_CM_EnumCtlPwmState "Enumerated data type: EnumCtlPwmState" TAB_VERB "%0.6" "" /* Conversion Table */ COMPU_TAB_REF VTAB_FOR_CtlStateOrchestrator_CM_EnumCtlPwmState /end COMPU_METHOD
/begin COMPU_VTAB /* Name of Table */ VTAB_FOR_CtlStateOrchestrator_CM_EnumCtlPwmState "Enumerated data type: EnumCtlPwmState" TAB_VERB /* Number of Elements */ 5 0 "Unused" 1 "Run" 2 "AscLow" 3 "Off" 4 "AscHigh" /end COMPU_VTAB
/begin COMPU_METHOD CtlStateOrchestrator_CM_logical "Q = V" RAT_FUNC "%1.0" "" COEFFS 0 1 0 0 0 1 /end COMPU_METHOD
/begin COMPU_METHOD CtlStateOrchestrator_CM_single "Q = V" RAT_FUNC "%8.6" "" COEFFS 0 1 0 0 0 1 /end COMPU_METHOD
/begin COMPU_METHOD CtlStateOrchestrator_CM_single_V "Q = V" RAT_FUNC "%8.6" "V" COEFFS 0 1 0 0 0 1 /end COMPU_METHOD
/begin COMPU_METHOD CtlStateOrchestrator_CM_single_dash_ "Q = V" RAT_FUNC "%8.6" "-" COEFFS 0 1 0 0 0 1 /end COMPU_METHOD
/begin COMPU_METHOD CtlStateOrchestrator_CM_single_rpm "Q = V" RAT_FUNC "%8.6" "rpm" COEFFS 0 1 0 0 0 1 /end COMPU_METHOD
/begin COMPU_METHOD CtlStateOrchestrator_CM_single_s "Q = V" RAT_FUNC "%8.6" "s" COEFFS 0 1 0 0 0 1 /end COMPU_METHOD
/begin COMPU_METHOD CtlStateOrchestrator_CM_uint8 "Q = V" RAT_FUNC "%3.0" "" COEFFS 0 1 0 0 0 1 /end COMPU_METHOD
/begin COMPU_METHOD CtlStateOrchestrator_CM_uint8_dash_ "Q = V" RAT_FUNC "%3.0" "-" COEFFS 0 1 0 0 0 1 /end COMPU_METHOD
/begin RECORD_LAYOUT Record_BOOLEAN FNC_VALUES 1 UBYTE COLUMN_DIR DIRECT /end RECORD_LAYOUT
/begin RECORD_LAYOUT Record_FLOAT32_IEEE FNC_VALUES 1 FLOAT32_IEEE COLUMN_DIR DIRECT /end RECORD_LAYOUT
/begin RECORD_LAYOUT Record_UBYTE FNC_VALUES 1 UBYTE COLUMN_DIR DIRECT /end RECORD_LAYOUT
/begin GROUP CtlStateOrchestrator "CtlStateOrchestrator" /* Root */ ROOT
 /begin SUB_GROUP CtlStateOrchestrator_CTSO_ControlPwmState_100us_sys CtlStateOrchestrator_CTSO_ManageStateMode_1ms_sys /end SUB_GROUP
 /begin REF_MEASUREMENT FLDG_ActiveShortHsReq FLDG_HwHsShortErr FLDG_HwLsShortErr FLDG_PowerSwitchOffReq FLDG_ResolverError FLDG_ShutdownReq SGPP_DcLinkVoltMeas SGPP_IgnitionStatus SGPP_MechSpeedAbsolute SGPP_SampleTime1 SGPP_SampleTime2 SGSA_BswInit SGSA_ModeRequest /end REF_MEASUREMENT
/end GROUP
/begin GROUP CtlStateOrchestrator_CTSO_ControlPwmState_100us_sys "CtlStateOrchestrator/CTSO_ControlPwmState_100us_sys"
 /begin SUB_GROUP CtlStateOrchestrator_CTSO_ControlPwmState_100us_sys_SwitchOffCondition /end SUB_GROUP
 /begin REF_MEASUREMENT CTSO_FaultModeRequest_IRV CTSO_PWMRequest_IRV CtlStateOrchestrator_B.CTSO_StPwm CtlStateOrchestrator_DW.is_active_c1_CtlStateOrchestrator CtlStateOrchestrator_DW.is_c1_CtlStateOrchestrator FLDG_ActiveShortHsReq FLDG_HwHsShortErr FLDG_HwLsShortErr FLDG_PowerSwitchOffReq FLDG_ShutdownReq /end REF_MEASUREMENT
/end GROUP
/begin GROUP CtlStateOrchestrator_CTSO_ControlPwmState_100us_sys_SwitchOffCondition "CtlStateOrchestrator/CTSO_ControlPwmState_100us_sys/SwitchOffCondition"
 /begin SUB_GROUP CtlStateOrchestrator_CTSO_ControlPwmState_100us_sys_SwitchOffCondition_Local_Variable_Storage1 CtlStateOrchestrator_CTSO_ControlPwmState_100us_sys_SwitchOffCondition_Parameter1 CtlStateOrchestrator_CTSO_ControlPwmState_100us_sys_SwitchOffCondition_Parameter2 CtlStateOrchestrator_CTSO_ControlPwmState_100us_sys_SwitchOffCondition_Parameter3 CtlStateOrchestrator_CTSO_ControlPwmState_100us_sys_SwitchOffCondition_Parameter4 /end SUB_GROUP
 /begin REF_MEASUREMENT CtlStateOrchestrator_DW.UnitDelay_DSTATE_c FLDG_ResolverError SGPP_DcLinkVoltMeas SGPP_MechSpeedAbsolute /end REF_MEASUREMENT
/end GROUP
/begin GROUP CtlStateOrchestrator_CTSO_ControlPwmState_100us_sys_SwitchOffCondition_Local_Variable_Storage1 "CtlStateOrchestrator/CTSO_ControlPwmState_100us_sys/SwitchOffCondition/Local Variable Storage1" /begin REF_MEASUREMENT CTSO_IGBTOffAllowed /end REF_MEASUREMENT /end GROUP
/begin GROUP CtlStateOrchestrator_CTSO_ControlPwmState_100us_sys_SwitchOffCondition_Parameter1 "CtlStateOrchestrator/CTSO_ControlPwmState_100us_sys/SwitchOffCondition/Parameter1" /begin REF_CHARACTERISTIC CTSO_IGBTOffVoltThreshold_C /end REF_CHARACTERISTIC /end GROUP
/begin GROUP CtlStateOrchestrator_CTSO_ControlPwmState_100us_sys_SwitchOffCondition_Parameter2 "CtlStateOrchestrator/CTSO_ControlPwmState_100us_sys/SwitchOffCondition/Parameter2" /begin REF_CHARACTERISTIC CTSO_IGBTOffVoltThreshold_C /end REF_CHARACTERISTIC /end GROUP
/begin GROUP CtlStateOrchestrator_CTSO_ControlPwmState_100us_sys_SwitchOffCondition_Parameter3 "CtlStateOrchestrator/CTSO_ControlPwmState_100us_sys/SwitchOffCondition/Parameter3" /begin REF_CHARACTERISTIC CTSO_VoltPerSpeedRatio_C /end REF_CHARACTERISTIC /end GROUP
/begin GROUP CtlStateOrchestrator_CTSO_ControlPwmState_100us_sys_SwitchOffCondition_Parameter4 "CtlStateOrchestrator/CTSO_ControlPwmState_100us_sys/SwitchOffCondition/Parameter4" /begin REF_CHARACTERISTIC CTSO_VoltASCThreshold_C /end REF_CHARACTERISTIC /end GROUP
/begin GROUP CtlStateOrchestrator_CTSO_ManageStateMode_1ms_sys "CtlStateOrchestrator/CTSO_ManageStateMode_1ms_sys"
 /begin SUB_GROUP CtlStateOrchestrator_CTSO_ManageStateMode_1ms_sys_DischargeTransitionLogic CtlStateOrchestrator_CTSO_ManageStateMode_1ms_sys_ModeCmdPreprocess CtlStateOrchestrator_CTSO_ManageStateMode_1ms_sys_StandbyTransitionLogic /end SUB_GROUP
 /begin REF_CHARACTERISTIC CTSO_FaultRecoveryEnable_C CTSO_InitWaitTime_C CTSO_MinVoltControl_C CTSO_PowerdownVoltLimit_C CTSO_ServiceModeEnable_C CTSO_SpeedLimit_C CTSO_VoltDischargeLowThr_C /end REF_CHARACTERISTIC
 /begin REF_MEASUREMENT CTSO_FaultModeRequest_IRV CTSO_PWMRequest_IRV CtlStateOrchestrator_DW.CTSO_StInin CtlStateOrchestrator_DW.TiInin CtlStateOrchestrator_DW.is_MainControl CtlStateOrchestrator_DW.is_c3_CtlStateOrchestrator SGPP_DcLinkVoltMeas SGPP_IgnitionStatus SGPP_MechSpeedAbsolute SGPP_SampleTime2 SGSA_BswInit /end REF_MEASUREMENT
/end GROUP
/begin GROUP CtlStateOrchestrator_CTSO_ManageStateMode_1ms_sys_DischargeTransitionLogic "CtlStateOrchestrator/CTSO_ManageStateMode_1ms_sys/DischargeTransitionLogic"
 /begin SUB_GROUP CtlStateOrchestrator_CTSO_ManageStateMode_1ms_sys_DischargeTransitionLogic_AcvDchaDiag CtlStateOrchestrator_CTSO_ManageStateMode_1ms_sys_DischargeTransitionLogic_Parameter1 CtlStateOrchestrator_CTSO_ManageStateMode_1ms_sys_DischargeTransitionLogic_Parameter4 /end SUB_GROUP
 /begin REF_MEASUREMENT SGPP_DcLinkVoltMeas /end REF_MEASUREMENT
/end GROUP
/begin GROUP CtlStateOrchestrator_CTSO_ManageStateMode_1ms_sys_DischargeTransitionLogic_AcvDchaDiag "CtlStateOrchestrator/CTSO_ManageStateMode_1ms_sys/DischargeTransitionLogic/AcvDchaDiag"
 /begin SUB_GROUP CtlStateOrchestrator_CTSO_ManageStateMode_1ms_sys_DischargeTransitionLogic_AcvDchaDiag_HoldLatch CtlStateOrchestrator_CTSO_ManageStateMode_1ms_sys_DischargeTransitionLogic_AcvDchaDiag_Parameter2 CtlStateOrchestrator_CTSO_ManageStateMode_1ms_sys_DischargeTransitionLogic_AcvDchaDiag_Parameter3 CtlStateOrchestrator_CTSO_ManageStateMode_1ms_sys_DischargeTransitionLogic_AcvDchaDiag_TimeMeter /end SUB_GROUP
 /begin REF_MEASUREMENT CtlStateOrchestrator_DW.Delay_DSTATE_f SGPP_IgnitionStatus /end REF_MEASUREMENT
/end GROUP
/begin GROUP CtlStateOrchestrator_CTSO_ManageStateMode_1ms_sys_DischargeTransitionLogic_AcvDchaDiag_HoldLatch "CtlStateOrchestrator/CTSO_ManageStateMode_1ms_sys/DischargeTransitionLogic/AcvDchaDiag/HoldLatch" /begin REF_MEASUREMENT CtlStateOrchestrator_DW.UnitDelay_DSTATE /end REF_MEASUREMENT /end GROUP
/begin GROUP CtlStateOrchestrator_CTSO_ManageStateMode_1ms_sys_DischargeTransitionLogic_AcvDchaDiag_Parameter2 "CtlStateOrchestrator/CTSO_ManageStateMode_1ms_sys/DischargeTransitionLogic/AcvDchaDiag/Parameter2" /begin REF_CHARACTERISTIC CTSO_WindingDischargeMaxTime_C /end REF_CHARACTERISTIC /end GROUP
/begin GROUP CtlStateOrchestrator_CTSO_ManageStateMode_1ms_sys_DischargeTransitionLogic_AcvDchaDiag_Parameter3 "CtlStateOrchestrator/CTSO_ManageStateMode_1ms_sys/DischargeTransitionLogic/AcvDchaDiag/Parameter3" /begin REF_CHARACTERISTIC CTSO_DischargeFaultReset_C /end REF_CHARACTERISTIC /end GROUP
/begin GROUP CtlStateOrchestrator_CTSO_ManageStateMode_1ms_sys_DischargeTransitionLogic_AcvDchaDiag_TimeMeter "CtlStateOrchestrator/CTSO_ManageStateMode_1ms_sys/DischargeTransitionLogic/AcvDchaDiag/TimeMeter" /begin REF_MEASUREMENT CtlStateOrchestrator_DW.Delay_DSTATE SGPP_SampleTime2 /end REF_MEASUREMENT /end GROUP
/begin GROUP CtlStateOrchestrator_CTSO_ManageStateMode_1ms_sys_DischargeTransitionLogic_Parameter1 "CtlStateOrchestrator/CTSO_ManageStateMode_1ms_sys/DischargeTransitionLogic/Parameter1" /begin REF_CHARACTERISTIC CTSO_VoltDischargeLowThr_C /end REF_CHARACTERISTIC /end GROUP
/begin GROUP CtlStateOrchestrator_CTSO_ManageStateMode_1ms_sys_DischargeTransitionLogic_Parameter4 "CtlStateOrchestrator/CTSO_ManageStateMode_1ms_sys/DischargeTransitionLogic/Parameter4" /begin REF_CHARACTERISTIC CTSO_VoltDischargeHighThr_C /end REF_CHARACTERISTIC /end GROUP
/begin GROUP CtlStateOrchestrator_CTSO_ManageStateMode_1ms_sys_ModeCmdPreprocess "CtlStateOrchestrator/CTSO_ManageStateMode_1ms_sys/ModeCmdPreprocess"
 /begin SUB_GROUP CtlStateOrchestrator_CTSO_ManageStateMode_1ms_sys_ModeCmdPreprocess_Local_Variable_Storage1 CtlStateOrchestrator_CTSO_ManageStateMode_1ms_sys_ModeCmdPreprocess_Parameter1 CtlStateOrchestrator_CTSO_ManageStateMode_1ms_sys_ModeCmdPreprocess_Parameter4 /end SUB_GROUP
 /begin REF_MEASUREMENT SGSA_ModeRequest /end REF_MEASUREMENT
/end GROUP
/begin GROUP CtlStateOrchestrator_CTSO_ManageStateMode_1ms_sys_ModeCmdPreprocess_Local_Variable_Storage1 "CtlStateOrchestrator/CTSO_ManageStateMode_1ms_sys/ModeCmdPreprocess/Local Variable Storage1" /begin REF_MEASUREMENT CTSO_ModeSetpoint /end REF_MEASUREMENT /end GROUP
/begin GROUP CtlStateOrchestrator_CTSO_ManageStateMode_1ms_sys_ModeCmdPreprocess_Parameter1 "CtlStateOrchestrator/CTSO_ManageStateMode_1ms_sys/ModeCmdPreprocess/Parameter1" /begin REF_CHARACTERISTIC CTSO_OpModeCondition_C /end REF_CHARACTERISTIC /end GROUP
/begin GROUP CtlStateOrchestrator_CTSO_ManageStateMode_1ms_sys_ModeCmdPreprocess_Parameter4 "CtlStateOrchestrator/CTSO_ManageStateMode_1ms_sys/ModeCmdPreprocess/Parameter4" /begin REF_CHARACTERISTIC CTSO_OpModeSelection_C /end REF_CHARACTERISTIC /end GROUP
/begin GROUP CtlStateOrchestrator_CTSO_ManageStateMode_1ms_sys_StandbyTransitionLogic "CtlStateOrchestrator/CTSO_ManageStateMode_1ms_sys/StandbyTransitionLogic"
 /begin SUB_GROUP CtlStateOrchestrator_CTSO_ManageStateMode_1ms_sys_StandbyTransitionLogic_Parameter1 CtlStateOrchestrator_CTSO_ManageStateMode_1ms_sys_StandbyTransitionLogic_Parameter4 /end SUB_GROUP
 /begin REF_MEASUREMENT SGPP_DcLinkVoltMeas SGPP_IgnitionStatus /end REF_MEASUREMENT
/end GROUP
/begin GROUP CtlStateOrchestrator_CTSO_ManageStateMode_1ms_sys_StandbyTransitionLogic_Parameter1 "CtlStateOrchestrator/CTSO_ManageStateMode_1ms_sys/StandbyTransitionLogic/Parameter1" /begin REF_CHARACTERISTIC CTSO_LowVoltStandbyEnable_C /end REF_CHARACTERISTIC /end GROUP
/begin GROUP CtlStateOrchestrator_CTSO_ManageStateMode_1ms_sys_StandbyTransitionLogic_Parameter4 "CtlStateOrchestrator/CTSO_ManageStateMode_1ms_sys/StandbyTransitionLogic/Parameter4" /begin REF_CHARACTERISTIC CTSO_PowerdownVoltLimit_C /end REF_CHARACTERISTIC /end GROUP
/end MODULE
/end PROJECT
/* (add any file trailer comments here) */
/* EOF CtlStateOrchestrator.a2l*/
