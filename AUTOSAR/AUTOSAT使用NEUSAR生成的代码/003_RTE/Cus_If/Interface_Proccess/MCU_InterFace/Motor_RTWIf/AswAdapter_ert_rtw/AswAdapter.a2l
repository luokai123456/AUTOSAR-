/******************************************************************************
* ASAP2 file: AswAdapter.a2l
* Code generation for model "AswAdapter".
* Model version : 1.328
* Simulink Coder version : 10.6 R2022b
* C source code generated on : Fri Jul 10 10:59:25 2026
* Target selection: ert.tlc
* Embedded hardware selection: Infineon->TriCore
* Code generation objectives: Unspecified
* Validation result: Not run
* (add additional file header information here)
******************************************************************************/ ASAP2_VERSION 1 31
/* Version 1.31 */
/begin PROJECT ProjectName "Project Comment Goes Here"
/begin HEADER "Header Comments go here" /end HEADER
/begin MODULE ModuleName "Module Comment Goes Here"
/begin MOD_PAR "MOD PAR Comment Goes Here" /end MOD_PAR
/begin MOD_COMMON "Mod Common Comment Here" BYTE_ORDER MSB_LAST ALIGNMENT_BYTE 1 ALIGNMENT_WORD 2 ALIGNMENT_LONG 4 ALIGNMENT_FLOAT32_IEEE 4 ALIGNMENT_FLOAT64_IEEE 4 /end MOD_COMMON
/begin CHARACTERISTIC SGSA_OperatingModeSource_C "Operating mode source selection: 0=parameter, 1=CAN" VALUE 0x0000 /* @ECU_Address@SGSA_OperatingModeSource_C@ */ Record_UBYTE 0 AswAdapter_CM_uint8_dash_ 0.000000 1.000000 /end CHARACTERISTIC
/begin CHARACTERISTIC SGSA_OperatingModeSp_C "Operating mode selection parameter" VALUE 0x0000 /* @ECU_Address@SGSA_OperatingModeSp_C@ */ Record_UBYTE 0 AswAdapter_CM_uint8_dash_ 0.000000 255.000000 /end CHARACTERISTIC
/begin CHARACTERISTIC SGSA_SpeedSpSource_C "Speed setpoint source: 0=external, 1=parameter" VALUE 0x0000 /* @ECU_Address@SGSA_SpeedSpSource_C@ */ Record_UBYTE 0 AswAdapter_CM_uint8_dash_ 0.000000 1.000000 /end CHARACTERISTIC
/begin CHARACTERISTIC SGSA_SpeedSp_C "Speed setpoint parameter" VALUE 0x0000 /* @ECU_Address@SGSA_SpeedSp_C@ */ Record_FLOAT32_IEEE 0 AswAdapter_CM_single_rpm -30000.000000 30000.000000 /end CHARACTERISTIC
/begin CHARACTERISTIC SGSA_TorqueSpSource_C "Torque setpoint source: 0=external, 1=parameter" VALUE 0x0000 /* @ECU_Address@SGSA_TorqueSpSource_C@ */ Record_UBYTE 0 AswAdapter_CM_uint8_dash_ 0.000000 255.000000 /end CHARACTERISTIC
/begin CHARACTERISTIC SGSA_TorqueSp_C "Torque setpoint parameter" VALUE 0x0000 /* @ECU_Address@SGSA_TorqueSp_C@ */ Record_FLOAT32_IEEE 0 AswAdapter_CM_single_Nm -20000.000000 20000.000000 /end CHARACTERISTIC
/begin MEASUREMENT CTSO_PWMControlState "" UBYTE AswAdapter_CM_uint8 0 0 0 255 ECU_ADDRESS 0x0000 /* @ECU_Address@CTSO_PWMControlState@ */ /end MEASUREMENT
/begin MEASUREMENT SGPP_BSW_f32_DriveHBridg_Error "" UBYTE AswAdapter_CM_uint8 0 0 0 255 ARRAY_SIZE 1 ECU_ADDRESS 0x0000 /* @ECU_Address@SGPP_BSW_f32_DriveHBridg_Error@ */ /end MEASUREMENT
/begin MEASUREMENT SGPP_BSW_f32_DriveLBridg_Error "" UBYTE AswAdapter_CM_uint8 0 0 0 255 ARRAY_SIZE 1 ECU_ADDRESS 0x0000 /* @ECU_Address@SGPP_BSW_f32_DriveLBridg_Error@ */ /end MEASUREMENT
/begin MEASUREMENT SGPP_BSW_u8_ASC_Enable "can signal" UBYTE AswAdapter_CM_uint8 0 0 0.000000 1.000000 ECU_ADDRESS 0x0000 /* @ECU_Address@SGPP_BSW_u8_ASC_Enable@ */ /end MEASUREMENT
/begin MEASUREMENT SGPP_BSW_u8_ClearFlt_Roty_En "can signal" UBYTE AswAdapter_CM_uint8 0 0 0.000000 1.000000 ECU_ADDRESS 0x0000 /* @ECU_Address@SGPP_BSW_u8_ClearFlt_Roty_En@ */ /end MEASUREMENT
/begin MEASUREMENT SGPP_BSW_u8_ClearFlt_Volt_Curr_En "can signal" UBYTE AswAdapter_CM_boolean 0 0 0.000000 1.000000 ECU_ADDRESS 0x0000 /* @ECU_Address@SGPP_BSW_u8_ClearFlt_Volt_Curr_En@ */ /end MEASUREMENT
/begin MEASUREMENT SGPP_BSW_u8_CutOffDelayEn_flg "can signal" UBYTE AswAdapter_CM_boolean 0 0 0.000000 1.000000 ECU_ADDRESS 0x0000 /* @ECU_Address@SGPP_BSW_u8_CutOffDelayEn_flg@ */ /end MEASUREMENT
/begin MEASUREMENT SGPP_BSW_u8_PWM_Enable "can signal" UBYTE AswAdapter_CM_uint8 0 0 0.000000 1.000000 ECU_ADDRESS 0x0000 /* @ECU_Address@SGPP_BSW_u8_PWM_Enable@ */ /end MEASUREMENT
/begin MEASUREMENT SGPP_ElecSpeed "" FLOAT32_IEEE AswAdapter_CM_single 0 0 -3.4E+38 3.4E+38 ECU_ADDRESS 0x0000 /* @ECU_Address@SGPP_ElecSpeed@ */ /end MEASUREMENT
/begin MEASUREMENT SGPP_ElecSpeedAbsolute "can signal" FLOAT32_IEEE AswAdapter_CM_single 0 0 0.000000 20000.000000 ECU_ADDRESS 0x0000 /* @ECU_Address@SGPP_ElecSpeedAbsolute@ */ /end MEASUREMENT
/begin MEASUREMENT SGPP_FOC_f32_Uduty_Null "can signal" FLOAT32_IEEE AswAdapter_CM_single 0 0 0.000000 1.000000 ECU_ADDRESS 0x0000 /* @ECU_Address@SGPP_FOC_f32_Uduty_Null@ */ /end MEASUREMENT
/begin MEASUREMENT SGPP_FOC_f32_Vduty_Null "can signal" FLOAT32_IEEE AswAdapter_CM_single 0 0 0.000000 1.000000 ECU_ADDRESS 0x0000 /* @ECU_Address@SGPP_FOC_f32_Vduty_Null@ */ /end MEASUREMENT
/begin MEASUREMENT SGPP_FOC_f32_Wduty_Null "can signal" FLOAT32_IEEE AswAdapter_CM_single 0 0 0.000000 1.000000 ECU_ADDRESS 0x0000 /* @ECU_Address@SGPP_FOC_f32_Wduty_Null@ */ /end MEASUREMENT
/begin MEASUREMENT SGPP_MechSpeed "" FLOAT32_IEEE AswAdapter_CM_single 0 0 -3.4E+38 3.4E+38 ECU_ADDRESS 0x0000 /* @ECU_Address@SGPP_MechSpeed@ */ /end MEASUREMENT
/begin MEASUREMENT SGPP_MechSpeedAbsolute "can signal" FLOAT32_IEEE AswAdapter_CM_single 0 0 0.000000 20000.000000 ECU_ADDRESS 0x0000 /* @ECU_Address@SGPP_MechSpeedAbsolute@ */ /end MEASUREMENT
/begin MEASUREMENT SGPP_kFOC_f32_PWMFreq_Hz "can signal" FLOAT32_IEEE AswAdapter_CM_single 0 0 0.000000 10000.000000 ECU_ADDRESS 0x0000 /* @ECU_Address@SGPP_kFOC_f32_PWMFreq_Hz@ */ /end MEASUREMENT
/begin MEASUREMENT SGSA_BswInit "can signal" UBYTE AswAdapter_CM_uint8 0 0 0.000000 1.000000 ECU_ADDRESS 0x0000 /* @ECU_Address@SGSA_BswInit@ */ /end MEASUREMENT
/begin MEASUREMENT SGSA_HwHsIntBSt "can signal" UBYTE AswAdapter_CM_uint8 0 0 0.000000 1.000000 ARRAY_SIZE 1 ECU_ADDRESS 0x0000 /* @ECU_Address@SGSA_HwHsIntBSt@ */ /end MEASUREMENT
/begin MEASUREMENT SGSA_HwLsIntBSt "can signal" UBYTE AswAdapter_CM_uint8 0 0 0.000000 1.000000 ARRAY_SIZE 1 ECU_ADDRESS 0x0000 /* @ECU_Address@SGSA_HwLsIntBSt@ */ /end MEASUREMENT
/begin MEASUREMENT SGSA_ModeRequest "can signal" UBYTE AswAdapter_CM_uint8 0 0 0.000000 255.000000 ECU_ADDRESS 0x0000 /* @ECU_Address@SGSA_ModeRequest@ */ /end MEASUREMENT
/begin MEASUREMENT SGSA_SpeedCommand "can signal" FLOAT32_IEEE AswAdapter_CM_single 0 0 -20000.000000 20000.000000 ECU_ADDRESS 0x0000 /* @ECU_Address@SGSA_SpeedCommand@ */ /end MEASUREMENT
/begin MEASUREMENT SGSA_TorqueCommand "can signal" FLOAT32_IEEE AswAdapter_CM_single 0 0 -1000.000000 1000.000000 ECU_ADDRESS 0x0000 /* @ECU_Address@SGSA_TorqueCommand@ */ /end MEASUREMENT
/begin MEASUREMENT TFPM_PhaseADuty "" FLOAT32_IEEE AswAdapter_CM_single 0 0 -3.4E+38 3.4E+38 ECU_ADDRESS 0x0000 /* @ECU_Address@TFPM_PhaseADuty@ */ /end MEASUREMENT
/begin MEASUREMENT TFPM_PhaseBDuty "" FLOAT32_IEEE AswAdapter_CM_single 0 0 -3.4E+38 3.4E+38 ECU_ADDRESS 0x0000 /* @ECU_Address@TFPM_PhaseBDuty@ */ /end MEASUREMENT
/begin MEASUREMENT TFPM_PhaseCDuty "" FLOAT32_IEEE AswAdapter_CM_single 0 0 -3.4E+38 3.4E+38 ECU_ADDRESS 0x0000 /* @ECU_Address@TFPM_PhaseCDuty@ */ /end MEASUREMENT
/begin COMPU_METHOD AswAdapter_CM_boolean "Q = V" RAT_FUNC "%1.0" "" COEFFS 0 1 0 0 0 1 /end COMPU_METHOD
/begin COMPU_METHOD AswAdapter_CM_logical "Q = V" RAT_FUNC "%1.0" "" COEFFS 0 1 0 0 0 1 /end COMPU_METHOD
/begin COMPU_METHOD AswAdapter_CM_single "Q = V" RAT_FUNC "%8.6" "" COEFFS 0 1 0 0 0 1 /end COMPU_METHOD
/begin COMPU_METHOD AswAdapter_CM_single_Nm "Q = V" RAT_FUNC "%8.6" "Nm" COEFFS 0 1 0 0 0 1 /end COMPU_METHOD
/begin COMPU_METHOD AswAdapter_CM_single_rpm "Q = V" RAT_FUNC "%8.6" "rpm" COEFFS 0 1 0 0 0 1 /end COMPU_METHOD
/begin COMPU_METHOD AswAdapter_CM_uint8 "Q = V" RAT_FUNC "%3.0" "" COEFFS 0 1 0 0 0 1 /end COMPU_METHOD
/begin COMPU_METHOD AswAdapter_CM_uint8_dash_ "Q = V" RAT_FUNC "%3.0" "-" COEFFS 0 1 0 0 0 1 /end COMPU_METHOD
/begin RECORD_LAYOUT Record_BOOLEAN FNC_VALUES 1 UBYTE COLUMN_DIR DIRECT /end RECORD_LAYOUT
/begin RECORD_LAYOUT Record_FLOAT32_IEEE FNC_VALUES 1 FLOAT32_IEEE COLUMN_DIR DIRECT /end RECORD_LAYOUT
/begin RECORD_LAYOUT Record_UBYTE FNC_VALUES 1 UBYTE COLUMN_DIR DIRECT /end RECORD_LAYOUT
/begin GROUP AswAdapter "AswAdapter" /* Root */ ROOT
 /begin SUB_GROUP AswAdapter_ASWA_Write_100us_sys AswAdapter_SGPP_ReadTempVolt_1ms_sys /end SUB_GROUP
 /begin REF_MEASUREMENT CTSO_PWMControlState SGPP_BSW_f32_DriveHBridg_Error SGPP_BSW_f32_DriveLBridg_Error SGPP_ElecSpeed SGPP_MechSpeed TFPM_PhaseADuty TFPM_PhaseBDuty TFPM_PhaseCDuty /end REF_MEASUREMENT
/end GROUP
/begin GROUP AswAdapter_ASWA_Write_100us_sys "AswAdapter/ASWA_Write_100us_sys"
 /begin REF_MEASUREMENT AswAdapter_ConstB.Constant1 AswAdapter_ConstB.Constant2 AswAdapter_ConstB.Constant3 AswAdapter_ConstB.Constant4 CTSO_PWMControlState TFPM_PhaseADuty TFPM_PhaseBDuty TFPM_PhaseCDuty /end REF_MEASUREMENT
/end GROUP
/begin GROUP AswAdapter_SGPP_ReadTempVolt_1ms_sys "AswAdapter/SGPP_ReadTempVolt_1ms_sys"
 /begin SUB_GROUP AswAdapter_SGPP_ReadTempVolt_1ms_sys_CAN_Signals AswAdapter_SGPP_ReadTempVolt_1ms_sys_SpeedAbsCalc AswAdapter_SGPP_ReadTempVolt_1ms_sys_Variant_Subsystem1 /end SUB_GROUP
 /begin REF_MEASUREMENT SGSA_HwLsIntBSt /end REF_MEASUREMENT
/end GROUP
/begin GROUP AswAdapter_SGPP_ReadTempVolt_1ms_sys_CAN_Signals "AswAdapter/SGPP_ReadTempVolt_1ms_sys/CAN Signals"
 /begin SUB_GROUP AswAdapter_SGPP_ReadTempVolt_1ms_sys_CAN_Signals_Parameter1 AswAdapter_SGPP_ReadTempVolt_1ms_sys_CAN_Signals_Parameter10 AswAdapter_SGPP_ReadTempVolt_1ms_sys_CAN_Signals_Parameter2 AswAdapter_SGPP_ReadTempVolt_1ms_sys_CAN_Signals_Parameter3 AswAdapter_SGPP_ReadTempVolt_1ms_sys_CAN_Signals_Parameter4 AswAdapter_SGPP_ReadTempVolt_1ms_sys_CAN_Signals_Parameter5 /end SUB_GROUP
 /begin REF_MEASUREMENT AswAdapter_ConstB.DataTypeConversion AswAdapter_ConstB.DataTypeConversion1 AswAdapter_ConstB.DataTypeConversion2 /end REF_MEASUREMENT
/end GROUP
/begin GROUP AswAdapter_SGPP_ReadTempVolt_1ms_sys_CAN_Signals_Parameter1 "AswAdapter/SGPP_ReadTempVolt_1ms_sys/CAN Signals/Parameter1" /begin REF_CHARACTERISTIC SGSA_OperatingModeSp_C /end REF_CHARACTERISTIC /end GROUP
/begin GROUP AswAdapter_SGPP_ReadTempVolt_1ms_sys_CAN_Signals_Parameter10 "AswAdapter/SGPP_ReadTempVolt_1ms_sys/CAN Signals/Parameter10" /begin REF_CHARACTERISTIC SGSA_OperatingModeSource_C /end REF_CHARACTERISTIC /end GROUP
/begin GROUP AswAdapter_SGPP_ReadTempVolt_1ms_sys_CAN_Signals_Parameter2 "AswAdapter/SGPP_ReadTempVolt_1ms_sys/CAN Signals/Parameter2" /begin REF_CHARACTERISTIC SGSA_TorqueSpSource_C /end REF_CHARACTERISTIC /end GROUP
/begin GROUP AswAdapter_SGPP_ReadTempVolt_1ms_sys_CAN_Signals_Parameter3 "AswAdapter/SGPP_ReadTempVolt_1ms_sys/CAN Signals/Parameter3" /begin REF_CHARACTERISTIC SGSA_TorqueSp_C /end REF_CHARACTERISTIC /end GROUP
/begin GROUP AswAdapter_SGPP_ReadTempVolt_1ms_sys_CAN_Signals_Parameter4 "AswAdapter/SGPP_ReadTempVolt_1ms_sys/CAN Signals/Parameter4" /begin REF_CHARACTERISTIC SGSA_SpeedSpSource_C /end REF_CHARACTERISTIC /end GROUP
/begin GROUP AswAdapter_SGPP_ReadTempVolt_1ms_sys_CAN_Signals_Parameter5 "AswAdapter/SGPP_ReadTempVolt_1ms_sys/CAN Signals/Parameter5" /begin REF_CHARACTERISTIC SGSA_SpeedSp_C /end REF_CHARACTERISTIC /end GROUP
/begin GROUP AswAdapter_SGPP_ReadTempVolt_1ms_sys_SpeedAbsCalc "AswAdapter/SGPP_ReadTempVolt_1ms_sys/SpeedAbsCalc" /begin REF_MEASUREMENT SGPP_ElecSpeed SGPP_MechSpeed /end REF_MEASUREMENT /end GROUP
/begin GROUP AswAdapter_SGPP_ReadTempVolt_1ms_sys_Variant_Subsystem1 "AswAdapter/SGPP_ReadTempVolt_1ms_sys/Variant Subsystem1"
 /begin SUB_GROUP AswAdapter_SGPP_ReadTempVolt_1ms_sys_Variant_Subsystem1_XCU_Code /end SUB_GROUP
/end GROUP
/begin GROUP AswAdapter_SGPP_ReadTempVolt_1ms_sys_Variant_Subsystem1_XCU_Code "AswAdapter/SGPP_ReadTempVolt_1ms_sys/Variant Subsystem1/XCU_Code" /begin REF_MEASUREMENT AswAdapter_ConstB.Constant /end REF_MEASUREMENT /end GROUP
/end MODULE
/end PROJECT
/* (add any file trailer comments here) */
/* EOF AswAdapter.a2l*/
