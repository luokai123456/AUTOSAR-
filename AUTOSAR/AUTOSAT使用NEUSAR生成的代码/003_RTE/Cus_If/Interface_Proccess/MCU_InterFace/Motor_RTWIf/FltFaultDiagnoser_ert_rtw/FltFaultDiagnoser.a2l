/******************************************************************************
* ASAP2 file: FltFaultDiagnoser.a2l
* Code generation for model "FltFaultDiagnoser".
* Model version : 1.23
* Simulink Coder version : 10.6 R2022b
* C source code generated on : Thu May 28 16:38:46 2026
* Target selection: ert.tlc
* Embedded hardware selection: Infineon->TriCore
* Code generation objectives: Unspecified
* Validation result: Not run
* (add additional file header information here)
******************************************************************************/ ASAP2_VERSION 1 31
/* Version 1.31 */
/begin PROJECT ProjectName "Project Comment Goes Here"
/begin HEADER "Header Comments go here" /end HEADER
/begin MODULE ModuleName "Module Comment Goes Here"
/begin MOD_PAR "MOD PAR Comment Goes Here" /end MOD_PAR
/begin MOD_COMMON "Mod Common Comment Here" BYTE_ORDER MSB_LAST ALIGNMENT_BYTE 1 ALIGNMENT_WORD 2 ALIGNMENT_LONG 4 ALIGNMENT_FLOAT32_IEEE 4 ALIGNMENT_FLOAT64_IEEE 4 /end MOD_COMMON
/begin CHARACTERISTIC FLDG_DebounceDecrDcVoltHi_C "Debounce decrement value for diagnostic of DC overvoltage" VALUE 0x0000 /* @ECU_Address@FLDG_DebounceDecrDcVoltHi_C@ */ Record_UWORD 0 FltFaultDiagnoser_CM_uint16_dash_ 0.000000 65535.000000 /end CHARACTERISTIC
/begin CHARACTERISTIC FLDG_DebounceDecrInvTMonitor_C "Debounce decrement value for diagnostic of IGBT overtemperature" VALUE 0x0000 /* @ECU_Address@FLDG_DebounceDecrInvTMonitor_C@ */ Record_UBYTE 0 FltFaultDiagnoser_CM_uint8_dash_ 0.000000 255.000000 /end CHARACTERISTIC
/begin CHARACTERISTIC FLDG_DebounceDecrPhaCur_C "Debounce decrement value for diagnostic of phase overcurrent" VALUE 0x0000 /* @ECU_Address@FLDG_DebounceDecrPhaCur_C@ */ Record_UBYTE 0 FltFaultDiagnoser_CM_uint8_dash_ 0.000000 255.000000 /end CHARACTERISTIC
/begin CHARACTERISTIC FLDG_DebounceDecrResolverSpdMonitor_C "Debounce decrement value for diagnostic of overspeed from position sensor" VALUE 0x0000 /* @ECU_Address@FLDG_DebounceDecrResolverSpdMonitor_C@ */ Record_UBYTE 0 FltFaultDiagnoser_CM_uint8_dash_ 0.000000 255.000000 /end CHARACTERISTIC
/begin CHARACTERISTIC FLDG_DebounceDecrWindingTMonitor_C "Debounce decrement value for winding temperatue monitoring" VALUE 0x0000 /* @ECU_Address@FLDG_DebounceDecrWindingTMonitor_C@ */ Record_UBYTE 0 FltFaultDiagnoser_CM_uint8_dash_ 0.000000 255.000000 /end CHARACTERISTIC
/begin CHARACTERISTIC FLDG_DebounceIncrDcVoltHi_C "Debounce increment value for diagnostic of DC overvoltage" VALUE 0x0000 /* @ECU_Address@FLDG_DebounceIncrDcVoltHi_C@ */ Record_UWORD 0 FltFaultDiagnoser_CM_uint16_dash_ 0.000000 65535.000000 /end CHARACTERISTIC
/begin CHARACTERISTIC FLDG_DebounceIncrInvTMonitor_C "Debounce increment value for diagnostic of IGBT overtemperature" VALUE 0x0000 /* @ECU_Address@FLDG_DebounceIncrInvTMonitor_C@ */ Record_UBYTE 0 FltFaultDiagnoser_CM_uint8_dash_ 0.000000 255.000000 /end CHARACTERISTIC
/begin CHARACTERISTIC FLDG_DebounceIncrPhaCur_C "Debounce increment value for diagnostic of phase overcurrent" VALUE 0x0000 /* @ECU_Address@FLDG_DebounceIncrPhaCur_C@ */ Record_UBYTE 0 FltFaultDiagnoser_CM_uint8_dash_ 0.000000 255.000000 /end CHARACTERISTIC
/begin CHARACTERISTIC FLDG_DebounceIncrResolverSpdMonitor_C "Debounce increment value for diagnostic of overspeed from position sensor" VALUE 0x0000 /* @ECU_Address@FLDG_DebounceIncrResolverSpdMonitor_C@ */ Record_UBYTE 0 FltFaultDiagnoser_CM_uint8_dash_ 0.000000 255.000000 /end CHARACTERISTIC
/begin CHARACTERISTIC FLDG_DebounceIncrWindingTMonitor_C "Debounce increment value for winding temperature monitoring" VALUE 0x0000 /* @ECU_Address@FLDG_DebounceIncrWindingTMonitor_C@ */ Record_UBYTE 0 FltFaultDiagnoser_CM_uint8_dash_ 0.000000 255.000000 /end CHARACTERISTIC
/begin CHARACTERISTIC FLDG_DebounceMaxDcVoltHi_C "Debounce maximum value for diagnostic of DC overvoltage" VALUE 0x0000 /* @ECU_Address@FLDG_DebounceMaxDcVoltHi_C@ */ Record_UWORD 0 FltFaultDiagnoser_CM_uint16_dash_ 0.000000 65535.000000 /end CHARACTERISTIC
/begin CHARACTERISTIC FLDG_DebounceMaxInvTMonitor_C "Debounce maximum value for diagnostic of IGBT overtemperature" VALUE 0x0000 /* @ECU_Address@FLDG_DebounceMaxInvTMonitor_C@ */ Record_UBYTE 0 FltFaultDiagnoser_CM_uint8_dash_ 0.000000 255.000000 /end CHARACTERISTIC
/begin CHARACTERISTIC FLDG_DebounceMaxPhaCur_C "Debounce maximum value for diagnostic of phase overcurrent" VALUE 0x0000 /* @ECU_Address@FLDG_DebounceMaxPhaCur_C@ */ Record_UBYTE 0 FltFaultDiagnoser_CM_uint8_dash_ 0.000000 255.000000 /end CHARACTERISTIC
/begin CHARACTERISTIC FLDG_DebounceMaxResolverSpdMonitor_C "Debounce maximum value for diagnostic of overspeed from position sensor" VALUE 0x0000 /* @ECU_Address@FLDG_DebounceMaxResolverSpdMonitor_C@ */ Record_UBYTE 0 FltFaultDiagnoser_CM_uint8_dash_ 0.000000 255.000000 /end CHARACTERISTIC
/begin CHARACTERISTIC FLDG_DebounceMaxWindingTMonitor_C "Debounce maximum value for winding temperature monitoring" VALUE 0x0000 /* @ECU_Address@FLDG_DebounceMaxWindingTMonitor_C@ */ Record_UBYTE 0 FltFaultDiagnoser_CM_uint8_dash_ 0.000000 255.000000 /end CHARACTERISTIC
/begin CHARACTERISTIC FLDG_DebounceMinDcVoltHi_C "Debounce minimum value for diagnostic of DC overvoltage" VALUE 0x0000 /* @ECU_Address@FLDG_DebounceMinDcVoltHi_C@ */ Record_UWORD 0 FltFaultDiagnoser_CM_uint16_dash_ 0.000000 65535.000000 /end CHARACTERISTIC
/begin CHARACTERISTIC FLDG_DebounceMinInvTMonitor_C "Debounce minimum value for diagnostic of IGBT overtemperature" VALUE 0x0000 /* @ECU_Address@FLDG_DebounceMinInvTMonitor_C@ */ Record_UBYTE 0 FltFaultDiagnoser_CM_uint8_dash_ 0.000000 255.000000 /end CHARACTERISTIC
/begin CHARACTERISTIC FLDG_DebounceMinPhaCur_C "Debounce minimum value for diagnostic of phase overcurrent" VALUE 0x0000 /* @ECU_Address@FLDG_DebounceMinPhaCur_C@ */ Record_UBYTE 0 FltFaultDiagnoser_CM_uint8_dash_ 0.000000 255.000000 /end CHARACTERISTIC
/begin CHARACTERISTIC FLDG_DebounceMinResolverSpdMonitor_C "Debounce minimum value for diagnostic of overspeed from position sensor" VALUE 0x0000 /* @ECU_Address@FLDG_DebounceMinResolverSpdMonitor_C@ */ Record_UBYTE 0 FltFaultDiagnoser_CM_uint8_dash_ 0.000000 255.000000 /end CHARACTERISTIC
/begin CHARACTERISTIC FLDG_DebounceMinWindingTMonitor_C "Debounce minimum value for winding temperature monitoring" VALUE 0x0000 /* @ECU_Address@FLDG_DebounceMinWindingTMonitor_C@ */ Record_UBYTE 0 FltFaultDiagnoser_CM_uint8_dash_ 0.000000 255.000000 /end CHARACTERISTIC
/begin CHARACTERISTIC FLDG_EnableDiagHwDcLinkVoltDiag_C "Enable flag for hardware monitor DC link voltage diagnostic" VALUE 0x0000 /* @ECU_Address@FLDG_EnableDiagHwDcLinkVoltDiag_C@ */ Record_UBYTE 0 FltFaultDiagnoser_CM_uint8_dash_ 0.000000 255.000000 /end CHARACTERISTIC
/begin CHARACTERISTIC FLDG_EnableDiagHwErrPhaCurDiag_C "Enable flag for hardware monitor phase current diagnostic" VALUE 0x0000 /* @ECU_Address@FLDG_EnableDiagHwErrPhaCurDiag_C@ */ Record_UBYTE 0 FltFaultDiagnoser_CM_uint8_dash_ 0.000000 255.000000 /end CHARACTERISTIC
/begin CHARACTERISTIC FLDG_EnableDiagHwFltHiSideB_C "Enable flag for hardware monitor DC fault B HS diagnostic" VALUE 0x0000 /* @ECU_Address@FLDG_EnableDiagHwFltHiSideB_C@ */ Record_UBYTE 0 FltFaultDiagnoser_CM_uint8_dash_ 0.000000 255.000000 /end CHARACTERISTIC
/begin CHARACTERISTIC FLDG_EnableDiagHwFltLoSideB_C "Enable flag for hardware monitor DC fault B LS diagnostic" VALUE 0x0000 /* @ECU_Address@FLDG_EnableDiagHwFltLoSideB_C@ */ Record_UBYTE 0 FltFaultDiagnoser_CM_uint8_dash_ 0.000000 255.000000 /end CHARACTERISTIC
/begin CHARACTERISTIC FLDG_EnableDiagResolverCosLosDiag_C "Enable flag for Resolver diagnostic of tracking" VALUE 0x0000 /* @ECU_Address@FLDG_EnableDiagResolverCosLosDiag_C@ */ Record_UBYTE 0 FltFaultDiagnoser_CM_uint8_dash_ 0.000000 255.000000 /end CHARACTERISTIC
/begin CHARACTERISTIC FLDG_EnableDiagResolverDiagDos_C "Enable flag for Resolver diagnostic of phase lock range error" VALUE 0x0000 /* @ECU_Address@FLDG_EnableDiagResolverDiagDos_C@ */ Record_UBYTE 0 FltFaultDiagnoser_CM_uint8_dash_ 0.000000 255.000000 /end CHARACTERISTIC
/begin CHARACTERISTIC FLDG_EnableDiagResolverDiagSigLot_C "Enable flag for Resolver diagnostic of LOS (loss of signal)  threshold" VALUE 0x0000 /* @ECU_Address@FLDG_EnableDiagResolverDiagSigLot_C@ */ Record_UBYTE 0 FltFaultDiagnoser_CM_uint8_dash_ 0.000000 255.000000 /end CHARACTERISTIC
/begin CHARACTERISTIC FLDG_EnableDiagResolverSineLosDiag_C "Enable flag for Resolver diagnostic of velocity tracking rate" VALUE 0x0000 /* @ECU_Address@FLDG_EnableDiagResolverSineLosDiag_C@ */ Record_UBYTE 0 FltFaultDiagnoser_CM_uint8_dash_ 0.000000 255.000000 /end CHARACTERISTIC
/begin CHARACTERISTIC FLDG_EnableShutdownReq_C "Enable flag for shutdown request function" VALUE 0x0000 /* @ECU_Address@FLDG_EnableShutdownReq_C@ */ Record_UBYTE 0 FltFaultDiagnoser_CM_uint8_dash_ 0.000000 255.000000 /end CHARACTERISTIC
/begin CHARACTERISTIC FLDG_IHiThr_C "Max permissible current" VALUE 0x0000 /* @ECU_Address@FLDG_IHiThr_C@ */ Record_FLOAT32_IEEE 0 FltFaultDiagnoser_CM_single_A 0.000000 2000.000000 /end CHARACTERISTIC
/begin CHARACTERISTIC FLDG_ResetDcDiagUHi_C "Reset for diagnostic of DC Link overvoltage" VALUE 0x0000 /* @ECU_Address@FLDG_ResetDcDiagUHi_C@ */ Record_UBYTE 0 FltFaultDiagnoser_CM_uint8_dash_ 0.000000 255.000000 /end CHARACTERISTIC
/begin CHARACTERISTIC FLDG_ResetDiagPhaCur_C "Reset for diagnostic of phase current" VALUE 0x0000 /* @ECU_Address@FLDG_ResetDiagPhaCur_C@ */ Record_UBYTE 0 FltFaultDiagnoser_CM_uint8_dash_ 0.000000 255.000000 /end CHARACTERISTIC
/begin CHARACTERISTIC FLDG_ResetInvTMonitor_C "Rst for Temperature monitoring of Inverter" VALUE 0x0000 /* @ECU_Address@FLDG_ResetInvTMonitor_C@ */ Record_UBYTE 0 FltFaultDiagnoser_CM_uint8_dash_ 0.000000 255.000000 /end CHARACTERISTIC
/begin CHARACTERISTIC FLDG_ResetLatchDcVoltHi_C "Fault detection flag" VALUE 0x0000 /* @ECU_Address@FLDG_ResetLatchDcVoltHi_C@ */ Record_UBYTE 0 FltFaultDiagnoser_CM_uint8_dash_ 0.000000 255.000000 /end CHARACTERISTIC
/begin CHARACTERISTIC FLDG_ResetLatchHwDcLinkVolt_C "clear to enable latching." VALUE 0x0000 /* @ECU_Address@FLDG_ResetLatchHwDcLinkVolt_C@ */ Record_UBYTE 0 FltFaultDiagnoser_CM_uint8_dash_ 0.000000 255.000000 /end CHARACTERISTIC
/begin CHARACTERISTIC FLDG_ResetLatchHwFltLoSideB_C "clear to enable latching." VALUE 0x0000 /* @ECU_Address@FLDG_ResetLatchHwFltLoSideB_C@ */ Record_UBYTE 0 FltFaultDiagnoser_CM_uint8_dash_ 0.000000 255.000000 /end CHARACTERISTIC
/begin CHARACTERISTIC FLDG_ResetLatchHwPhaCur_C "clear to enable latching." VALUE 0x0000 /* @ECU_Address@FLDG_ResetLatchHwPhaCur_C@ */ Record_UBYTE 0 FltFaultDiagnoser_CM_uint8_dash_ 0.000000 255.000000 /end CHARACTERISTIC
/begin CHARACTERISTIC FLDG_ResetLatchResolverCosLos_C "clear to enable latching." VALUE 0x0000 /* @ECU_Address@FLDG_ResetLatchResolverCosLos_C@ */ Record_UBYTE 0 FltFaultDiagnoser_CM_uint8_dash_ 0.000000 255.000000 /end CHARACTERISTIC
/begin CHARACTERISTIC FLDG_ResetLatchResolverDos_C "clear to enable latching." VALUE 0x0000 /* @ECU_Address@FLDG_ResetLatchResolverDos_C@ */ Record_UBYTE 0 FltFaultDiagnoser_CM_uint8_dash_ 0.000000 255.000000 /end CHARACTERISTIC
/begin CHARACTERISTIC FLDG_ResetLatchResolverSigLot_C "clear to enable latching." VALUE 0x0000 /* @ECU_Address@FLDG_ResetLatchResolverSigLot_C@ */ Record_UBYTE 0 FltFaultDiagnoser_CM_uint8_dash_ 0.000000 255.000000 /end CHARACTERISTIC
/begin CHARACTERISTIC FLDG_ResetLatchResolverSineLos_C "clear to enable latching." VALUE 0x0000 /* @ECU_Address@FLDG_ResetLatchResolverSineLos_C@ */ Record_UBYTE 0 FltFaultDiagnoser_CM_uint8_dash_ 0.000000 255.000000 /end CHARACTERISTIC
/begin CHARACTERISTIC FLDG_ResetLatchShutdownReq_C "Reset control for shutdown request latched error functionality" VALUE 0x0000 /* @ECU_Address@FLDG_ResetLatchShutdownReq_C@ */ Record_UBYTE 0 FltFaultDiagnoser_CM_uint8_dash_ 0.000000 1.000000 /end CHARACTERISTIC
/begin CHARACTERISTIC FLDG_ResetResolverNMonitor_C "Reset for speed monitoring from position sensor" VALUE 0x0000 /* @ECU_Address@FLDG_ResetResolverNMonitor_C@ */ Record_UBYTE 0 FltFaultDiagnoser_CM_uint8_dash_ 0.000000 255.000000 /end CHARACTERISTIC
/begin CHARACTERISTIC FLDG_ResetWindingTMonitor_C "Reset for Temperature monitoring of Winding" VALUE 0x0000 /* @ECU_Address@FLDG_ResetWindingTMonitor_C@ */ Record_UBYTE 0 FltFaultDiagnoser_CM_uint8_dash_ 0.000000 255.000000 /end CHARACTERISTIC
/begin CHARACTERISTIC FLDG_SpdResolverThrFaiRcvrr_C "over speed recovery Threshold" VALUE 0x0000 /* @ECU_Address@FLDG_SpdResolverThrFaiRcvrr_C@ */ Record_FLOAT32_IEEE 0 FltFaultDiagnoser_CM_single_rpm 0.000000 500000.000000 /end CHARACTERISTIC
/begin CHARACTERISTIC FLDG_SpdResolverThrFai_C "Threshold speed from position sensor above which the machine should be shut down" VALUE 0x0000 /* @ECU_Address@FLDG_SpdResolverThrFai_C@ */ Record_FLOAT32_IEEE 0 FltFaultDiagnoser_CM_single_rpm 0.000000 500000.000000 /end CHARACTERISTIC
/begin CHARACTERISTIC FLDG_TIgbtPha1Thr_C "Threshold value for power switch temperature at phase A" VALUE 0x0000 /* @ECU_Address@FLDG_TIgbtPha1Thr_C@ */ Record_FLOAT32_IEEE 0 FltFaultDiagnoser_CM_single_dash_ 0.000000 65535.000000 /end CHARACTERISTIC
/begin CHARACTERISTIC FLDG_TWindingThr_C "Winding temp above which error is set to 1" VALUE 0x0000 /* @ECU_Address@FLDG_TWindingThr_C@ */ Record_FLOAT32_IEEE 0 FltFaultDiagnoser_CM_single_dash_ 0.000000 65535.000000 /end CHARACTERISTIC
/begin CHARACTERISTIC FLDG_UBattVoltThrHiRcvrr_C "OVER voltage RECOVERY threshold of battery voltage" VALUE 0x0000 /* @ECU_Address@FLDG_UBattVoltThrHiRcvrr_C@ */ Record_FLOAT32_IEEE 0 FltFaultDiagnoser_CM_single_V 0.000000 65535.000000 /end CHARACTERISTIC
/begin CHARACTERISTIC FLDG_UBattVoltThrHi_C "OVER voltage threshold of battery voltage" VALUE 0x0000 /* @ECU_Address@FLDG_UBattVoltThrHi_C@ */ Record_FLOAT32_IEEE 0 FltFaultDiagnoser_CM_single_V 0.000000 65535.000000 /end CHARACTERISTIC
/begin CHARACTERISTIC FLDG_UBattVoltThrLoRcvrr_C "UNDER voltage recovery threshold of battery voltage" VALUE 0x0000 /* @ECU_Address@FLDG_UBattVoltThrLoRcvrr_C@ */ Record_FLOAT32_IEEE 0 FltFaultDiagnoser_CM_single_V 0.000000 65535.000000 /end CHARACTERISTIC
/begin CHARACTERISTIC FLDG_UBattVoltThrLo_C "Voltage at battery voltage below which a DEM error entry is set" VALUE 0x0000 /* @ECU_Address@FLDG_UBattVoltThrLo_C@ */ Record_FLOAT32_IEEE 0 FltFaultDiagnoser_CM_single_V 0.000000 65535.000000 /end CHARACTERISTIC
/begin CHARACTERISTIC FLDG_UDcThrHi_C "DC voltage above which error is set to 1" VALUE 0x0000 /* @ECU_Address@FLDG_UDcThrHi_C@ */ Record_FLOAT32_IEEE 0 FltFaultDiagnoser_CM_single_V 0.000000 65535.000000 /end CHARACTERISTIC
/begin MEASUREMENT CTSO_DischargeFaultFlag "" UBYTE FltFaultDiagnoser_CM_uint8 0 0 0 255 ARRAY_SIZE 1 ECU_ADDRESS 0x0000 /* @ECU_Address@CTSO_DischargeFaultFlag@ */ /end MEASUREMENT
/begin MEASUREMENT FLDG_ActiveShortHsReq "Active short circuit request for high-side switches" UBYTE FltFaultDiagnoser_CM_uint8_dash_ 0 0 0.000000 255.000000 ARRAY_SIZE 1 ECU_ADDRESS 0x0000 /* @ECU_Address@FLDG_ActiveShortHsReq@ */ /end MEASUREMENT
/begin MEASUREMENT FLDG_BattVoltHiErr "Fault detection active when the voltage at battery voltage is above a threshold value" UBYTE FltFaultDiagnoser_CM_uint8_dash_ 0 0 0.000000 1.000000 ARRAY_SIZE 1 ECU_ADDRESS 0x0000 /* @ECU_Address@FLDG_BattVoltHiErr@ */ /end MEASUREMENT
/begin MEASUREMENT FLDG_BattVoltLoErr "Fault detection active when the voltage at battery voltage is below a threshold value" UBYTE FltFaultDiagnoser_CM_uint8_dash_ 0 0 0.000000 1.000000 ARRAY_SIZE 1 ECU_ADDRESS 0x0000 /* @ECU_Address@FLDG_BattVoltLoErr@ */ /end MEASUREMENT
/begin MEASUREMENT FLDG_DcVoltHiWarn "Warning flag is set when DC bus voltage is above the critical value" UBYTE FltFaultDiagnoser_CM_uint8_dash_ 0 0 0.000000 1.000000 ARRAY_SIZE 1 ECU_ADDRESS 0x0000 /* @ECU_Address@FLDG_DcVoltHiWarn@ */ /end MEASUREMENT
/begin MEASUREMENT FLDG_DischargeErr "Discharge Error" UBYTE FltFaultDiagnoser_CM_uint8 0 0 0.000000 255.000000 ARRAY_SIZE 1 ECU_ADDRESS 0x0000 /* @ECU_Address@FLDG_DischargeErr@ */ /end MEASUREMENT
/begin MEASUREMENT FLDG_HwDcLinkVoltErr "Scanned errors of hardware monitor Bit 9: DC link overvoltage" UBYTE FltFaultDiagnoser_CM_uint8_dash_ 0 0 0.000000 255.000000 ARRAY_SIZE 1 ECU_ADDRESS 0x0000 /* @ECU_Address@FLDG_HwDcLinkVoltErr@ */ /end MEASUREMENT
/begin MEASUREMENT FLDG_HwHsShortErr "Scanned errors of hardware monitor Bit 11: Fault B HS" UBYTE FltFaultDiagnoser_CM_uint8_dash_ 0 0 0.000000 255.000000 ARRAY_SIZE 1 ECU_ADDRESS 0x0000 /* @ECU_Address@FLDG_HwHsShortErr@ */ /end MEASUREMENT
/begin MEASUREMENT FLDG_HwLsShortErr "Scanned errors of hardware monitor Bit 14: Fault B LS" UBYTE FltFaultDiagnoser_CM_uint8_dash_ 0 0 0.000000 255.000000 ARRAY_SIZE 1 ECU_ADDRESS 0x0000 /* @ECU_Address@FLDG_HwLsShortErr@ */ /end MEASUREMENT
/begin MEASUREMENT FLDG_HwPhaCurErr "hardware monitor Phase Current Error" UBYTE FltFaultDiagnoser_CM_uint8_dash_ 0 0 0.000000 255.000000 ARRAY_SIZE 1 ECU_ADDRESS 0x0000 /* @ECU_Address@FLDG_HwPhaCurErr@ */ /end MEASUREMENT
/begin MEASUREMENT FLDG_IgbtTemp1Err "Fault detection active when power switch at phase A temperature above threshold value" UBYTE FltFaultDiagnoser_CM_uint8_dash_ 0 0 0.000000 255.000000 ARRAY_SIZE 1 ECU_ADDRESS 0x0000 /* @ECU_Address@FLDG_IgbtTemp1Err@ */ /end MEASUREMENT
/begin MEASUREMENT FLDG_IgbtTemp2Err "Fault detection active when power switch at phase B temperature above threshold value" UBYTE FltFaultDiagnoser_CM_uint8_dash_ 0 0 0.000000 255.000000 ARRAY_SIZE 1 ECU_ADDRESS 0x0000 /* @ECU_Address@FLDG_IgbtTemp2Err@ */ /end MEASUREMENT
/begin MEASUREMENT FLDG_IgbtTemp3Err "Fault detection active when power switch at phase C temperature above threshold value" UBYTE FltFaultDiagnoser_CM_uint8_dash_ 0 0 0.000000 255.000000 ARRAY_SIZE 1 ECU_ADDRESS 0x0000 /* @ECU_Address@FLDG_IgbtTemp3Err@ */ /end MEASUREMENT
/begin MEASUREMENT FLDG_PhaCur1Err "Fault indicator active when maximum allowable current at phase A is  exceeds limit" UBYTE FltFaultDiagnoser_CM_uint8_dash_ 0 0 0.000000 255.000000 ARRAY_SIZE 1 ECU_ADDRESS 0x0000 /* @ECU_Address@FLDG_PhaCur1Err@ */ /end MEASUREMENT
/begin MEASUREMENT FLDG_PhaCur1Err_IRV "Fault indicator active when maximum allowable current at phase A is  exceeds limit" UBYTE FltFaultDiagnoser_CM_uint8_dash_ 0 0 0.000000 255.000000 ARRAY_SIZE 1 ECU_ADDRESS 0x0000 /* @ECU_Address@FLDG_PhaCur1Err_IRV@ */ /end MEASUREMENT
/begin MEASUREMENT FLDG_PhaCur2Err "Fault indicator active when maximum allowable current exceeds limit at phase B" UBYTE FltFaultDiagnoser_CM_uint8_dash_ 0 0 0.000000 255.000000 ARRAY_SIZE 1 ECU_ADDRESS 0x0000 /* @ECU_Address@FLDG_PhaCur2Err@ */ /end MEASUREMENT
/begin MEASUREMENT FLDG_PhaCur2Err_IRV "Fault indicator active when maximum allowable current exceeds limit at phase B" UBYTE FltFaultDiagnoser_CM_uint8_dash_ 0 0 0.000000 255.000000 ARRAY_SIZE 1 ECU_ADDRESS 0x0000 /* @ECU_Address@FLDG_PhaCur2Err_IRV@ */ /end MEASUREMENT
/begin MEASUREMENT FLDG_PhaCur3Err "Fault indicator active when maximum allowable current exceeds limit at phase C" UBYTE FltFaultDiagnoser_CM_uint8_dash_ 0 0 0.000000 255.000000 ARRAY_SIZE 1 ECU_ADDRESS 0x0000 /* @ECU_Address@FLDG_PhaCur3Err@ */ /end MEASUREMENT
/begin MEASUREMENT FLDG_PhaCur3Err_IRV "Fault indicator active when maximum allowable current exceeds limit at phase C" UBYTE FltFaultDiagnoser_CM_uint8_dash_ 0 0 0.000000 255.000000 ARRAY_SIZE 1 ECU_ADDRESS 0x0000 /* @ECU_Address@FLDG_PhaCur3Err_IRV@ */ /end MEASUREMENT
/begin MEASUREMENT FLDG_PowerSwitchOffReq "Error reaction request for power switches off (freewheeling mode)" UBYTE FltFaultDiagnoser_CM_uint8_dash_ 0 0 0.000000 255.000000 ARRAY_SIZE 1 ECU_ADDRESS 0x0000 /* @ECU_Address@FLDG_PowerSwitchOffReq@ */ /end MEASUREMENT
/begin MEASUREMENT FLDG_ResolverCosLosErr "Scanned errors of Resolver Bit 3: tracking error exceeds LOT (Loss of tracking) threshold" UBYTE FltFaultDiagnoser_CM_uint8_dash_ 0 0 0.000000 255.000000 ARRAY_SIZE 1 ECU_ADDRESS 0x0000 /* @ECU_Address@FLDG_ResolverCosLosErr@ */ /end MEASUREMENT
/begin MEASUREMENT FLDG_ResolverDosErr "Scanned errors of Resolver Bit 1: phase error exceeds phase lock range" UBYTE FltFaultDiagnoser_CM_uint8_dash_ 0 0 0.000000 255.000000 ARRAY_SIZE 1 ECU_ADDRESS 0x0000 /* @ECU_Address@FLDG_ResolverDosErr@ */ /end MEASUREMENT
/begin MEASUREMENT FLDG_ResolverError "Resolver Error" UBYTE FltFaultDiagnoser_CM_uint8_dash_ 0 0 0.000000 255.000000 ARRAY_SIZE 1 ECU_ADDRESS 0x0000 /* @ECU_Address@FLDG_ResolverError@ */ /end MEASUREMENT
/begin MEASUREMENT FLDG_ResolverSigLotErr "Scanned errors of Resolver Bit 6: sin/cos below LOS (loss of signa)l threshold" UBYTE FltFaultDiagnoser_CM_uint8_dash_ 0 0 0.000000 255.000000 ARRAY_SIZE 1 ECU_ADDRESS 0x0000 /* @ECU_Address@FLDG_ResolverSigLotErr@ */ /end MEASUREMENT
/begin MEASUREMENT FLDG_ResolverSineLosErr "Scanned errors of Resolver Bit 2: velocity exceeds maximum tracking rate" UBYTE FltFaultDiagnoser_CM_uint8_dash_ 0 0 0.000000 255.000000 ARRAY_SIZE 1 ECU_ADDRESS 0x0000 /* @ECU_Address@FLDG_ResolverSineLosErr@ */ /end MEASUREMENT
/begin MEASUREMENT FLDG_ResolverSpdErr "When the absolut value of measured rotor speed exceeds the maximum threshold value, this flag is set to one" UBYTE FltFaultDiagnoser_CM_uint8_dash_ 0 0 0.000000 255.000000 ARRAY_SIZE 1 ECU_ADDRESS 0x0000 /* @ECU_Address@FLDG_ResolverSpdErr@ */ /end MEASUREMENT
/begin MEASUREMENT FLDG_ShutdownReq "System shutdown request flag indicator" UBYTE FltFaultDiagnoser_CM_uint8_dash_ 0 0 0.000000 255.000000 ARRAY_SIZE 1 ECU_ADDRESS 0x0000 /* @ECU_Address@FLDG_ShutdownReq@ */ /end MEASUREMENT
/begin MEASUREMENT FLDG_WindingTempErr "Fault detection active when motor winding temperature above threshold value" UBYTE FltFaultDiagnoser_CM_uint8_dash_ 0 0 0.000000 255.000000 ARRAY_SIZE 1 ECU_ADDRESS 0x0000 /* @ECU_Address@FLDG_WindingTempErr@ */ /end MEASUREMENT
/begin MEASUREMENT FLDG_WindingTempErr_IRV "Fault detection active when motor winding temperature above threshold value" UBYTE FltFaultDiagnoser_CM_uint8_dash_ 0 0 0.000000 255.000000 ARRAY_SIZE 1 ECU_ADDRESS 0x0000 /* @ECU_Address@FLDG_WindingTempErr_IRV@ */ /end MEASUREMENT
/begin MEASUREMENT FltFaultDiagnoser_DW.BareUnitDelay_DSTATE "" UWORD FltFaultDiagnoser_CM_uint16 0 0 0 65535 ECU_ADDRESS 0x0000 /* @ECU_Address@FltFaultDiagnoser_DW.BareUnitDelay_DSTATE@ */ /end MEASUREMENT
/begin MEASUREMENT FltFaultDiagnoser_DW.BareUnitDelay_DSTATE_d "" UBYTE FltFaultDiagnoser_CM_uint8 0 0 0 255 ECU_ADDRESS 0x0000 /* @ECU_Address@FltFaultDiagnoser_DW.BareUnitDelay_DSTATE_d@ */ /end MEASUREMENT
/begin MEASUREMENT FltFaultDiagnoser_DW.BareUnitDelay_DSTATE_e "" UBYTE FltFaultDiagnoser_CM_uint8 0 0 0 255 ARRAY_SIZE 3 ECU_ADDRESS 0x0000 /* @ECU_Address@FltFaultDiagnoser_DW.BareUnitDelay_DSTATE_e@ */ /end MEASUREMENT
/begin MEASUREMENT FltFaultDiagnoser_DW.BareUnitDelay_DSTATE_e2 "" UBYTE FltFaultDiagnoser_CM_uint8 0 0 0 255 ECU_ADDRESS 0x0000 /* @ECU_Address@FltFaultDiagnoser_DW.BareUnitDelay_DSTATE_e2@ */ /end MEASUREMENT
/begin MEASUREMENT FltFaultDiagnoser_DW.BareUnitDelay_DSTATE_k "" UBYTE FltFaultDiagnoser_CM_uint8 0 0 0 255 ECU_ADDRESS 0x0000 /* @ECU_Address@FltFaultDiagnoser_DW.BareUnitDelay_DSTATE_k@ */ /end MEASUREMENT
/begin MEASUREMENT FltFaultDiagnoser_DW.BareUnitDelay_DSTATE_o "" UBYTE FltFaultDiagnoser_CM_uint8 0 0 0 255 ECU_ADDRESS 0x0000 /* @ECU_Address@FltFaultDiagnoser_DW.BareUnitDelay_DSTATE_o@ */ /end MEASUREMENT
/begin MEASUREMENT FltFaultDiagnoser_DW.BareUnitDelay_DSTATE_p "" UBYTE FltFaultDiagnoser_CM_uint8 0 0 0 255 ARRAY_SIZE 3 ECU_ADDRESS 0x0000 /* @ECU_Address@FltFaultDiagnoser_DW.BareUnitDelay_DSTATE_p@ */ /end MEASUREMENT
/begin MEASUREMENT FltFaultDiagnoser_DW.Delay_DSTATE "" UBYTE FltFaultDiagnoser_CM_logical 0 0 0 1 ECU_ADDRESS 0x0000 /* @ECU_Address@FltFaultDiagnoser_DW.Delay_DSTATE@ */ /end MEASUREMENT
/begin MEASUREMENT FltFaultDiagnoser_DW.Delay_DSTATE_b "" UBYTE FltFaultDiagnoser_CM_logical 0 0 0 1 ECU_ADDRESS 0x0000 /* @ECU_Address@FltFaultDiagnoser_DW.Delay_DSTATE_b@ */ /end MEASUREMENT
/begin MEASUREMENT FltFaultDiagnoser_DW.Delay_DSTATE_i "" UBYTE FltFaultDiagnoser_CM_logical 0 0 0 1 ECU_ADDRESS 0x0000 /* @ECU_Address@FltFaultDiagnoser_DW.Delay_DSTATE_i@ */ /end MEASUREMENT
/begin MEASUREMENT FltFaultDiagnoser_DW.Memory_PreviousInput "" UBYTE FltFaultDiagnoser_CM_logical 0 0 0 1 ECU_ADDRESS 0x0000 /* @ECU_Address@FltFaultDiagnoser_DW.Memory_PreviousInput@ */ /end MEASUREMENT
/begin MEASUREMENT FltFaultDiagnoser_DW.Memory_PreviousInput_i "" UBYTE FltFaultDiagnoser_CM_logical 0 0 0 1 ARRAY_SIZE 3 ECU_ADDRESS 0x0000 /* @ECU_Address@FltFaultDiagnoser_DW.Memory_PreviousInput_i@ */ /end MEASUREMENT
/begin MEASUREMENT FltFaultDiagnoser_DW.Memory_PreviousInput_k "" UBYTE FltFaultDiagnoser_CM_logical 0 0 0 1 ECU_ADDRESS 0x0000 /* @ECU_Address@FltFaultDiagnoser_DW.Memory_PreviousInput_k@ */ /end MEASUREMENT
/begin MEASUREMENT FltFaultDiagnoser_DW.Memory_PreviousInput_l "" UBYTE FltFaultDiagnoser_CM_logical 0 0 0 1 ECU_ADDRESS 0x0000 /* @ECU_Address@FltFaultDiagnoser_DW.Memory_PreviousInput_l@ */ /end MEASUREMENT
/begin MEASUREMENT FltFaultDiagnoser_DW.Memory_PreviousInput_m "" UBYTE FltFaultDiagnoser_CM_logical 0 0 0 1 ECU_ADDRESS 0x0000 /* @ECU_Address@FltFaultDiagnoser_DW.Memory_PreviousInput_m@ */ /end MEASUREMENT
/begin MEASUREMENT FltFaultDiagnoser_DW.Memory_PreviousInput_n "" UBYTE FltFaultDiagnoser_CM_logical 0 0 0 1 ECU_ADDRESS 0x0000 /* @ECU_Address@FltFaultDiagnoser_DW.Memory_PreviousInput_n@ */ /end MEASUREMENT
/begin MEASUREMENT FltFaultDiagnoser_DW.Memory_PreviousInput_nc "" UBYTE FltFaultDiagnoser_CM_logical 0 0 0 1 ARRAY_SIZE 3 ECU_ADDRESS 0x0000 /* @ECU_Address@FltFaultDiagnoser_DW.Memory_PreviousInput_nc@ */ /end MEASUREMENT
/begin MEASUREMENT FltFaultDiagnoser_DW.UnitDelay_DSTATE "" UBYTE FltFaultDiagnoser_CM_uint8 0 0 0 255 ECU_ADDRESS 0x0000 /* @ECU_Address@FltFaultDiagnoser_DW.UnitDelay_DSTATE@ */ /end MEASUREMENT
/begin MEASUREMENT FltFaultDiagnoser_DW.UnitDelay_DSTATE_a "" UBYTE FltFaultDiagnoser_CM_uint8 0 0 0 255 ECU_ADDRESS 0x0000 /* @ECU_Address@FltFaultDiagnoser_DW.UnitDelay_DSTATE_a@ */ /end MEASUREMENT
/begin MEASUREMENT FltFaultDiagnoser_DW.UnitDelay_DSTATE_ax "" UBYTE FltFaultDiagnoser_CM_uint8 0 0 0 255 ECU_ADDRESS 0x0000 /* @ECU_Address@FltFaultDiagnoser_DW.UnitDelay_DSTATE_ax@ */ /end MEASUREMENT
/begin MEASUREMENT FltFaultDiagnoser_DW.UnitDelay_DSTATE_d "" UBYTE FltFaultDiagnoser_CM_uint8 0 0 0 255 ECU_ADDRESS 0x0000 /* @ECU_Address@FltFaultDiagnoser_DW.UnitDelay_DSTATE_d@ */ /end MEASUREMENT
/begin MEASUREMENT FltFaultDiagnoser_DW.UnitDelay_DSTATE_f "" UBYTE FltFaultDiagnoser_CM_uint8 0 0 0 255 ECU_ADDRESS 0x0000 /* @ECU_Address@FltFaultDiagnoser_DW.UnitDelay_DSTATE_f@ */ /end MEASUREMENT
/begin MEASUREMENT FltFaultDiagnoser_DW.UnitDelay_DSTATE_h "" UBYTE FltFaultDiagnoser_CM_uint8 0 0 0 255 ECU_ADDRESS 0x0000 /* @ECU_Address@FltFaultDiagnoser_DW.UnitDelay_DSTATE_h@ */ /end MEASUREMENT
/begin MEASUREMENT FltFaultDiagnoser_DW.UnitDelay_DSTATE_i "" UBYTE FltFaultDiagnoser_CM_uint8 0 0 0 255 ECU_ADDRESS 0x0000 /* @ECU_Address@FltFaultDiagnoser_DW.UnitDelay_DSTATE_i@ */ /end MEASUREMENT
/begin MEASUREMENT FltFaultDiagnoser_DW.UnitDelay_DSTATE_k "" UBYTE FltFaultDiagnoser_CM_uint8 0 0 0 255 ECU_ADDRESS 0x0000 /* @ECU_Address@FltFaultDiagnoser_DW.UnitDelay_DSTATE_k@ */ /end MEASUREMENT
/begin MEASUREMENT FltFaultDiagnoser_DW.UnitDelay_DSTATE_kt "" UBYTE FltFaultDiagnoser_CM_uint8 0 0 0 255 ECU_ADDRESS 0x0000 /* @ECU_Address@FltFaultDiagnoser_DW.UnitDelay_DSTATE_kt@ */ /end MEASUREMENT
/begin MEASUREMENT FltFaultDiagnoser_DW.UnitDelay_DSTATE_l "" UBYTE FltFaultDiagnoser_CM_uint8 0 0 0 255 ECU_ADDRESS 0x0000 /* @ECU_Address@FltFaultDiagnoser_DW.UnitDelay_DSTATE_l@ */ /end MEASUREMENT
/begin MEASUREMENT FltFaultDiagnoser_DW.UnitDelay_DSTATE_m "" UBYTE FltFaultDiagnoser_CM_uint8 0 0 0 255 ECU_ADDRESS 0x0000 /* @ECU_Address@FltFaultDiagnoser_DW.UnitDelay_DSTATE_m@ */ /end MEASUREMENT
/begin MEASUREMENT FltFaultDiagnoser_DW.UnitDelay_DSTATE_o "" UBYTE FltFaultDiagnoser_CM_uint8 0 0 0 255 ECU_ADDRESS 0x0000 /* @ECU_Address@FltFaultDiagnoser_DW.UnitDelay_DSTATE_o@ */ /end MEASUREMENT
/begin MEASUREMENT SGPP_DcLinkVoltMeas "" FLOAT32_IEEE FltFaultDiagnoser_CM_single 0 0 -3.4E+38 3.4E+38 ECU_ADDRESS 0x0000 /* @ECU_Address@SGPP_DcLinkVoltMeas@ */ /end MEASUREMENT
/begin MEASUREMENT SGPP_MechSpeedAbsolute "" FLOAT32_IEEE FltFaultDiagnoser_CM_single 0 0 -3.4E+38 3.4E+38 ECU_ADDRESS 0x0000 /* @ECU_Address@SGPP_MechSpeedAbsolute@ */ /end MEASUREMENT
/begin MEASUREMENT SGPP_MotorTemp1 "" FLOAT32_IEEE FltFaultDiagnoser_CM_single 0 0 -3.4E+38 3.4E+38 ECU_ADDRESS 0x0000 /* @ECU_Address@SGPP_MotorTemp1@ */ /end MEASUREMENT
/begin MEASUREMENT SGPP_PhaseACurrent "" FLOAT32_IEEE FltFaultDiagnoser_CM_single 0 0 -3.4E+38 3.4E+38 ECU_ADDRESS 0x0000 /* @ECU_Address@SGPP_PhaseACurrent@ */ /end MEASUREMENT
/begin MEASUREMENT SGPP_PhaseBCurrent "" FLOAT32_IEEE FltFaultDiagnoser_CM_single 0 0 -3.4E+38 3.4E+38 ECU_ADDRESS 0x0000 /* @ECU_Address@SGPP_PhaseBCurrent@ */ /end MEASUREMENT
/begin MEASUREMENT SGPP_PhaseCCurrent "" FLOAT32_IEEE FltFaultDiagnoser_CM_single 0 0 -3.4E+38 3.4E+38 ECU_ADDRESS 0x0000 /* @ECU_Address@SGPP_PhaseCCurrent@ */ /end MEASUREMENT
/begin MEASUREMENT SGSA_BatteryVolt "" FLOAT32_IEEE FltFaultDiagnoser_CM_single 0 0 -3.4E+38 3.4E+38 ECU_ADDRESS 0x0000 /* @ECU_Address@SGSA_BatteryVolt@ */ /end MEASUREMENT
/begin MEASUREMENT SGSA_HwHsIntBSt "" UBYTE FltFaultDiagnoser_CM_uint8 0 0 0 255 ARRAY_SIZE 1 ECU_ADDRESS 0x0000 /* @ECU_Address@SGSA_HwHsIntBSt@ */ /end MEASUREMENT
/begin MEASUREMENT SGSA_HwLsIntBSt "" UBYTE FltFaultDiagnoser_CM_uint8 0 0 0 255 ARRAY_SIZE 1 ECU_ADDRESS 0x0000 /* @ECU_Address@SGSA_HwLsIntBSt@ */ /end MEASUREMENT
/begin MEASUREMENT SGSA_HwOvercurSt "" UBYTE FltFaultDiagnoser_CM_uint8 0 0 0 255 ARRAY_SIZE 1 ECU_ADDRESS 0x0000 /* @ECU_Address@SGSA_HwOvercurSt@ */ /end MEASUREMENT
/begin MEASUREMENT SGSA_HwOvervoltSt "" UBYTE FltFaultDiagnoser_CM_uint8 0 0 0 255 ARRAY_SIZE 1 ECU_ADDRESS 0x0000 /* @ECU_Address@SGSA_HwOvervoltSt@ */ /end MEASUREMENT
/begin MEASUREMENT SGSA_PhaseASwitchTemp "" FLOAT32_IEEE FltFaultDiagnoser_CM_single 0 0 -3.4E+38 3.4E+38 ECU_ADDRESS 0x0000 /* @ECU_Address@SGSA_PhaseASwitchTemp@ */ /end MEASUREMENT
/begin MEASUREMENT SGSA_PhaseBSwitchTemp "" FLOAT32_IEEE FltFaultDiagnoser_CM_single 0 0 -3.4E+38 3.4E+38 ECU_ADDRESS 0x0000 /* @ECU_Address@SGSA_PhaseBSwitchTemp@ */ /end MEASUREMENT
/begin MEASUREMENT SGSA_PhaseCSwitchTemp "" FLOAT32_IEEE FltFaultDiagnoser_CM_single 0 0 -3.4E+38 3.4E+38 ECU_ADDRESS 0x0000 /* @ECU_Address@SGSA_PhaseCSwitchTemp@ */ /end MEASUREMENT
/begin MEASUREMENT SGSA_ResolverError "" UBYTE FltFaultDiagnoser_CM_uint8 0 0 0 255 ARRAY_SIZE 1 ECU_ADDRESS 0x0000 /* @ECU_Address@SGSA_ResolverError@ */ /end MEASUREMENT
/begin COMPU_METHOD FltFaultDiagnoser_CM_logical "Q = V" RAT_FUNC "%1.0" "" COEFFS 0 1 0 0 0 1 /end COMPU_METHOD
/begin COMPU_METHOD FltFaultDiagnoser_CM_single "Q = V" RAT_FUNC "%8.6" "" COEFFS 0 1 0 0 0 1 /end COMPU_METHOD
/begin COMPU_METHOD FltFaultDiagnoser_CM_single_A "Q = V" RAT_FUNC "%8.6" "A" COEFFS 0 1 0 0 0 1 /end COMPU_METHOD
/begin COMPU_METHOD FltFaultDiagnoser_CM_single_V "Q = V" RAT_FUNC "%8.6" "V" COEFFS 0 1 0 0 0 1 /end COMPU_METHOD
/begin COMPU_METHOD FltFaultDiagnoser_CM_single_dash_ "Q = V" RAT_FUNC "%8.6" "-" COEFFS 0 1 0 0 0 1 /end COMPU_METHOD
/begin COMPU_METHOD FltFaultDiagnoser_CM_single_rpm "Q = V" RAT_FUNC "%8.6" "rpm" COEFFS 0 1 0 0 0 1 /end COMPU_METHOD
/begin COMPU_METHOD FltFaultDiagnoser_CM_uint16 "Q = V" RAT_FUNC "%5.0" "" COEFFS 0 1 0 0 0 1 /end COMPU_METHOD
/begin COMPU_METHOD FltFaultDiagnoser_CM_uint16_dash_ "Q = V" RAT_FUNC "%5.0" "-" COEFFS 0 1 0 0 0 1 /end COMPU_METHOD
/begin COMPU_METHOD FltFaultDiagnoser_CM_uint8 "Q = V" RAT_FUNC "%3.0" "" COEFFS 0 1 0 0 0 1 /end COMPU_METHOD
/begin COMPU_METHOD FltFaultDiagnoser_CM_uint8_dash_ "Q = V" RAT_FUNC "%3.0" "-" COEFFS 0 1 0 0 0 1 /end COMPU_METHOD
/begin RECORD_LAYOUT Record_BOOLEAN FNC_VALUES 1 UBYTE COLUMN_DIR DIRECT /end RECORD_LAYOUT
/begin RECORD_LAYOUT Record_FLOAT32_IEEE FNC_VALUES 1 FLOAT32_IEEE COLUMN_DIR DIRECT /end RECORD_LAYOUT
/begin RECORD_LAYOUT Record_UBYTE FNC_VALUES 1 UBYTE COLUMN_DIR DIRECT /end RECORD_LAYOUT
/begin RECORD_LAYOUT Record_UWORD FNC_VALUES 1 UWORD COLUMN_DIR DIRECT /end RECORD_LAYOUT
/begin GROUP FltFaultDiagnoser "FltFaultDiagnoser" /* Root */ ROOT
 /begin SUB_GROUP FltFaultDiagnoser_FLDG_DiagCurrentFast_100us_sys FltFaultDiagnoser_FLDG_DiagFaultResponse_1ms_sys FltFaultDiagnoser_FLDG_DiagTempSlow_10ms_sys /end SUB_GROUP
 /begin REF_MEASUREMENT CTSO_DischargeFaultFlag SGPP_DcLinkVoltMeas SGPP_MechSpeedAbsolute SGPP_MotorTemp1 SGPP_PhaseACurrent SGPP_PhaseBCurrent SGPP_PhaseCCurrent SGSA_BatteryVolt SGSA_HwHsIntBSt SGSA_HwLsIntBSt SGSA_HwOvercurSt SGSA_HwOvervoltSt SGSA_PhaseASwitchTemp SGSA_PhaseBSwitchTemp SGSA_PhaseCSwitchTemp SGSA_ResolverError /end REF_MEASUREMENT
/end GROUP
/begin GROUP FltFaultDiagnoser_FLDG_DiagCurrentFast_100us_sys "FltFaultDiagnoser/FLDG_DiagCurrentFast_100us_sys"
 /begin SUB_GROUP FltFaultDiagnoser_FLDG_DiagCurrentFast_100us_sys_OverCurrentDiag /end SUB_GROUP
/end GROUP
/begin GROUP FltFaultDiagnoser_FLDG_DiagCurrentFast_100us_sys_OverCurrentDiag "FltFaultDiagnoser/FLDG_DiagCurrentFast_100us_sys/OverCurrentDiag"
 /begin SUB_GROUP FltFaultDiagnoser_FLDG_DiagCurrentFast_100us_sys_OverCurrentDiag_FaultDebounce FltFaultDiagnoser_FLDG_DiagCurrentFast_100us_sys_OverCurrentDiag_Parameter1 FltFaultDiagnoser_FLDG_DiagCurrentFast_100us_sys_OverCurrentDiag_Parameter2 FltFaultDiagnoser_FLDG_DiagCurrentFast_100us_sys_OverCurrentDiag_Parameter3 FltFaultDiagnoser_FLDG_DiagCurrentFast_100us_sys_OverCurrentDiag_Parameter4 FltFaultDiagnoser_FLDG_DiagCurrentFast_100us_sys_OverCurrentDiag_Parameter5 FltFaultDiagnoser_FLDG_DiagCurrentFast_100us_sys_OverCurrentDiag_Parameter6 /end SUB_GROUP
/end GROUP
/begin GROUP FltFaultDiagnoser_FLDG_DiagCurrentFast_100us_sys_OverCurrentDiag_FaultDebounce "FltFaultDiagnoser/FLDG_DiagCurrentFast_100us_sys/OverCurrentDiag/FaultDebounce"
 /begin SUB_GROUP FltFaultDiagnoser_FLDG_DiagCurrentFast_100us_sys_OverCurrentDiag_FaultDebounce_Subsystem FltFaultDiagnoser_FLDG_DiagCurrentFast_100us_sys_OverCurrentDiag_FaultDebounce_UnitDelay /end SUB_GROUP
/end GROUP
/begin GROUP FltFaultDiagnoser_FLDG_DiagCurrentFast_100us_sys_OverCurrentDiag_FaultDebounce_Subsystem "FltFaultDiagnoser/FLDG_DiagCurrentFast_100us_sys/OverCurrentDiag/FaultDebounce/Subsystem" /begin REF_MEASUREMENT FltFaultDiagnoser_DW.Memory_PreviousInput_nc /end REF_MEASUREMENT /end GROUP
/begin GROUP FltFaultDiagnoser_FLDG_DiagCurrentFast_100us_sys_OverCurrentDiag_FaultDebounce_UnitDelay "FltFaultDiagnoser/FLDG_DiagCurrentFast_100us_sys/OverCurrentDiag/FaultDebounce/UnitDelay" /begin REF_MEASUREMENT FltFaultDiagnoser_DW.BareUnitDelay_DSTATE_p /end REF_MEASUREMENT /end GROUP
/begin GROUP FltFaultDiagnoser_FLDG_DiagCurrentFast_100us_sys_OverCurrentDiag_Parameter1 "FltFaultDiagnoser/FLDG_DiagCurrentFast_100us_sys/OverCurrentDiag/Parameter1" /begin REF_CHARACTERISTIC FLDG_IHiThr_C /end REF_CHARACTERISTIC /end GROUP
/begin GROUP FltFaultDiagnoser_FLDG_DiagCurrentFast_100us_sys_OverCurrentDiag_Parameter2 "FltFaultDiagnoser/FLDG_DiagCurrentFast_100us_sys/OverCurrentDiag/Parameter2" /begin REF_CHARACTERISTIC FLDG_ResetDiagPhaCur_C /end REF_CHARACTERISTIC /end GROUP
/begin GROUP FltFaultDiagnoser_FLDG_DiagCurrentFast_100us_sys_OverCurrentDiag_Parameter3 "FltFaultDiagnoser/FLDG_DiagCurrentFast_100us_sys/OverCurrentDiag/Parameter3" /begin REF_CHARACTERISTIC FLDG_DebounceMaxPhaCur_C /end REF_CHARACTERISTIC /end GROUP
/begin GROUP FltFaultDiagnoser_FLDG_DiagCurrentFast_100us_sys_OverCurrentDiag_Parameter4 "FltFaultDiagnoser/FLDG_DiagCurrentFast_100us_sys/OverCurrentDiag/Parameter4" /begin REF_CHARACTERISTIC FLDG_DebounceMinPhaCur_C /end REF_CHARACTERISTIC /end GROUP
/begin GROUP FltFaultDiagnoser_FLDG_DiagCurrentFast_100us_sys_OverCurrentDiag_Parameter5 "FltFaultDiagnoser/FLDG_DiagCurrentFast_100us_sys/OverCurrentDiag/Parameter5" /begin REF_CHARACTERISTIC FLDG_DebounceIncrPhaCur_C /end REF_CHARACTERISTIC /end GROUP
/begin GROUP FltFaultDiagnoser_FLDG_DiagCurrentFast_100us_sys_OverCurrentDiag_Parameter6 "FltFaultDiagnoser/FLDG_DiagCurrentFast_100us_sys/OverCurrentDiag/Parameter6" /begin REF_CHARACTERISTIC FLDG_DebounceDecrPhaCur_C /end REF_CHARACTERISTIC /end GROUP
/begin GROUP FltFaultDiagnoser_FLDG_DiagFaultResponse_1ms_sys "FltFaultDiagnoser/FLDG_DiagFaultResponse_1ms_sys"
 /begin SUB_GROUP FltFaultDiagnoser_FLDG_DiagFaultResponse_1ms_sys_ErrorReaction FltFaultDiagnoser_FLDG_DiagFaultResponse_1ms_sys_HwFaultLatch FltFaultDiagnoser_FLDG_DiagFaultResponse_1ms_sys_KL30VoltageDiag FltFaultDiagnoser_FLDG_DiagFaultResponse_1ms_sys_PowerModuleTemperatureDiag FltFaultDiagnoser_FLDG_DiagFaultResponse_1ms_sys_ResolverFaultDecode FltFaultDiagnoser_FLDG_DiagFaultResponse_1ms_sys_SpeedDiag FltFaultDiagnoser_FLDG_DiagFaultResponse_1ms_sys_UdcVoltageDiag /end SUB_GROUP
/end GROUP
/begin GROUP FltFaultDiagnoser_FLDG_DiagFaultResponse_1ms_sys_ErrorReaction "FltFaultDiagnoser/FLDG_DiagFaultResponse_1ms_sys/ErrorReaction"
 /begin SUB_GROUP FltFaultDiagnoser_FLDG_DiagFaultResponse_1ms_sys_ErrorReaction_HoldLatch FltFaultDiagnoser_FLDG_DiagFaultResponse_1ms_sys_ErrorReaction_HoldLatch1 FltFaultDiagnoser_FLDG_DiagFaultResponse_1ms_sys_ErrorReaction_HoldLatch2 FltFaultDiagnoser_FLDG_DiagFaultResponse_1ms_sys_ErrorReaction_Parameter1 FltFaultDiagnoser_FLDG_DiagFaultResponse_1ms_sys_ErrorReaction_Parameter2 FltFaultDiagnoser_FLDG_DiagFaultResponse_1ms_sys_ErrorReaction_Parameter3 FltFaultDiagnoser_FLDG_DiagFaultResponse_1ms_sys_ErrorReaction_Parameter4 FltFaultDiagnoser_FLDG_DiagFaultResponse_1ms_sys_ErrorReaction_Parameter5 FltFaultDiagnoser_FLDG_DiagFaultResponse_1ms_sys_ErrorReaction_Parameter6 /end SUB_GROUP
 /begin REF_MEASUREMENT FLDG_PhaCur1Err_IRV FLDG_PhaCur2Err_IRV FLDG_PhaCur3Err_IRV FLDG_WindingTempErr_IRV /end REF_MEASUREMENT
/end GROUP
/begin GROUP FltFaultDiagnoser_FLDG_DiagFaultResponse_1ms_sys_ErrorReaction_HoldLatch "FltFaultDiagnoser/FLDG_DiagFaultResponse_1ms_sys/ErrorReaction/HoldLatch" /begin REF_MEASUREMENT FltFaultDiagnoser_DW.UnitDelay_DSTATE_i /end REF_MEASUREMENT /end GROUP
/begin GROUP FltFaultDiagnoser_FLDG_DiagFaultResponse_1ms_sys_ErrorReaction_HoldLatch1 "FltFaultDiagnoser/FLDG_DiagFaultResponse_1ms_sys/ErrorReaction/HoldLatch1" /begin REF_MEASUREMENT FltFaultDiagnoser_DW.UnitDelay_DSTATE_k /end REF_MEASUREMENT /end GROUP
/begin GROUP FltFaultDiagnoser_FLDG_DiagFaultResponse_1ms_sys_ErrorReaction_HoldLatch2 "FltFaultDiagnoser/FLDG_DiagFaultResponse_1ms_sys/ErrorReaction/HoldLatch2" /begin REF_MEASUREMENT FltFaultDiagnoser_DW.UnitDelay_DSTATE_d /end REF_MEASUREMENT /end GROUP
/begin GROUP FltFaultDiagnoser_FLDG_DiagFaultResponse_1ms_sys_ErrorReaction_Parameter1 "FltFaultDiagnoser/FLDG_DiagFaultResponse_1ms_sys/ErrorReaction/Parameter1" /begin REF_CHARACTERISTIC FLDG_EnableShutdownReq_C /end REF_CHARACTERISTIC /end GROUP
/begin GROUP FltFaultDiagnoser_FLDG_DiagFaultResponse_1ms_sys_ErrorReaction_Parameter2 "FltFaultDiagnoser/FLDG_DiagFaultResponse_1ms_sys/ErrorReaction/Parameter2" /begin REF_CHARACTERISTIC FLDG_ResetLatchShutdownReq_C /end REF_CHARACTERISTIC /end GROUP
/begin GROUP FltFaultDiagnoser_FLDG_DiagFaultResponse_1ms_sys_ErrorReaction_Parameter3 "FltFaultDiagnoser/FLDG_DiagFaultResponse_1ms_sys/ErrorReaction/Parameter3" /begin REF_CHARACTERISTIC FLDG_EnableShutdownReq_C /end REF_CHARACTERISTIC /end GROUP
/begin GROUP FltFaultDiagnoser_FLDG_DiagFaultResponse_1ms_sys_ErrorReaction_Parameter4 "FltFaultDiagnoser/FLDG_DiagFaultResponse_1ms_sys/ErrorReaction/Parameter4" /begin REF_CHARACTERISTIC FLDG_ResetLatchShutdownReq_C /end REF_CHARACTERISTIC /end GROUP
/begin GROUP FltFaultDiagnoser_FLDG_DiagFaultResponse_1ms_sys_ErrorReaction_Parameter5 "FltFaultDiagnoser/FLDG_DiagFaultResponse_1ms_sys/ErrorReaction/Parameter5" /begin REF_CHARACTERISTIC FLDG_EnableShutdownReq_C /end REF_CHARACTERISTIC /end GROUP
/begin GROUP FltFaultDiagnoser_FLDG_DiagFaultResponse_1ms_sys_ErrorReaction_Parameter6 "FltFaultDiagnoser/FLDG_DiagFaultResponse_1ms_sys/ErrorReaction/Parameter6" /begin REF_CHARACTERISTIC FLDG_ResetLatchShutdownReq_C /end REF_CHARACTERISTIC /end GROUP
/begin GROUP FltFaultDiagnoser_FLDG_DiagFaultResponse_1ms_sys_HwFaultLatch "FltFaultDiagnoser/FLDG_DiagFaultResponse_1ms_sys/HwFaultLatch"
 /begin SUB_GROUP FltFaultDiagnoser_FLDG_DiagFaultResponse_1ms_sys_HwFaultLatch_HoldLatch FltFaultDiagnoser_FLDG_DiagFaultResponse_1ms_sys_HwFaultLatch_HoldLatch1 FltFaultDiagnoser_FLDG_DiagFaultResponse_1ms_sys_HwFaultLatch_HoldLatch2 FltFaultDiagnoser_FLDG_DiagFaultResponse_1ms_sys_HwFaultLatch_HoldLatch3 FltFaultDiagnoser_FLDG_DiagFaultResponse_1ms_sys_HwFaultLatch_Parameter1 FltFaultDiagnoser_FLDG_DiagFaultResponse_1ms_sys_HwFaultLatch_Parameter2 FltFaultDiagnoser_FLDG_DiagFaultResponse_1ms_sys_HwFaultLatch_Parameter3 FltFaultDiagnoser_FLDG_DiagFaultResponse_1ms_sys_HwFaultLatch_Parameter4 FltFaultDiagnoser_FLDG_DiagFaultResponse_1ms_sys_HwFaultLatch_Parameter5 FltFaultDiagnoser_FLDG_DiagFaultResponse_1ms_sys_HwFaultLatch_Parameter6 FltFaultDiagnoser_FLDG_DiagFaultResponse_1ms_sys_HwFaultLatch_Parameter7 FltFaultDiagnoser_FLDG_DiagFaultResponse_1ms_sys_HwFaultLatch_Parameter8 /end SUB_GROUP
 /begin REF_MEASUREMENT SGSA_HwHsIntBSt SGSA_HwLsIntBSt SGSA_HwOvercurSt SGSA_HwOvervoltSt /end REF_MEASUREMENT
/end GROUP
/begin GROUP FltFaultDiagnoser_FLDG_DiagFaultResponse_1ms_sys_HwFaultLatch_HoldLatch "FltFaultDiagnoser/FLDG_DiagFaultResponse_1ms_sys/HwFaultLatch/HoldLatch" /begin REF_MEASUREMENT FltFaultDiagnoser_DW.UnitDelay_DSTATE_kt /end REF_MEASUREMENT /end GROUP
/begin GROUP FltFaultDiagnoser_FLDG_DiagFaultResponse_1ms_sys_HwFaultLatch_HoldLatch1 "FltFaultDiagnoser/FLDG_DiagFaultResponse_1ms_sys/HwFaultLatch/HoldLatch1" /begin REF_MEASUREMENT FltFaultDiagnoser_DW.UnitDelay_DSTATE /end REF_MEASUREMENT /end GROUP
/begin GROUP FltFaultDiagnoser_FLDG_DiagFaultResponse_1ms_sys_HwFaultLatch_HoldLatch2 "FltFaultDiagnoser/FLDG_DiagFaultResponse_1ms_sys/HwFaultLatch/HoldLatch2" /begin REF_MEASUREMENT FltFaultDiagnoser_DW.UnitDelay_DSTATE_o /end REF_MEASUREMENT /end GROUP
/begin GROUP FltFaultDiagnoser_FLDG_DiagFaultResponse_1ms_sys_HwFaultLatch_HoldLatch3 "FltFaultDiagnoser/FLDG_DiagFaultResponse_1ms_sys/HwFaultLatch/HoldLatch3" /begin REF_MEASUREMENT FltFaultDiagnoser_DW.UnitDelay_DSTATE_a /end REF_MEASUREMENT /end GROUP
/begin GROUP FltFaultDiagnoser_FLDG_DiagFaultResponse_1ms_sys_HwFaultLatch_Parameter1 "FltFaultDiagnoser/FLDG_DiagFaultResponse_1ms_sys/HwFaultLatch/Parameter1" /begin REF_CHARACTERISTIC FLDG_EnableDiagHwDcLinkVoltDiag_C /end REF_CHARACTERISTIC /end GROUP
/begin GROUP FltFaultDiagnoser_FLDG_DiagFaultResponse_1ms_sys_HwFaultLatch_Parameter2 "FltFaultDiagnoser/FLDG_DiagFaultResponse_1ms_sys/HwFaultLatch/Parameter2" /begin REF_CHARACTERISTIC FLDG_ResetLatchHwDcLinkVolt_C /end REF_CHARACTERISTIC /end GROUP
/begin GROUP FltFaultDiagnoser_FLDG_DiagFaultResponse_1ms_sys_HwFaultLatch_Parameter3 "FltFaultDiagnoser/FLDG_DiagFaultResponse_1ms_sys/HwFaultLatch/Parameter3" /begin REF_CHARACTERISTIC FLDG_EnableDiagHwErrPhaCurDiag_C /end REF_CHARACTERISTIC /end GROUP
/begin GROUP FltFaultDiagnoser_FLDG_DiagFaultResponse_1ms_sys_HwFaultLatch_Parameter4 "FltFaultDiagnoser/FLDG_DiagFaultResponse_1ms_sys/HwFaultLatch/Parameter4" /begin REF_CHARACTERISTIC FLDG_ResetLatchHwPhaCur_C /end REF_CHARACTERISTIC /end GROUP
/begin GROUP FltFaultDiagnoser_FLDG_DiagFaultResponse_1ms_sys_HwFaultLatch_Parameter5 "FltFaultDiagnoser/FLDG_DiagFaultResponse_1ms_sys/HwFaultLatch/Parameter5" /begin REF_CHARACTERISTIC FLDG_EnableDiagHwFltHiSideB_C /end REF_CHARACTERISTIC /end GROUP
/begin GROUP FltFaultDiagnoser_FLDG_DiagFaultResponse_1ms_sys_HwFaultLatch_Parameter6 "FltFaultDiagnoser/FLDG_DiagFaultResponse_1ms_sys/HwFaultLatch/Parameter6" /begin REF_CHARACTERISTIC FLDG_ResetLatchHwFltLoSideB_C /end REF_CHARACTERISTIC /end GROUP
/begin GROUP FltFaultDiagnoser_FLDG_DiagFaultResponse_1ms_sys_HwFaultLatch_Parameter7 "FltFaultDiagnoser/FLDG_DiagFaultResponse_1ms_sys/HwFaultLatch/Parameter7" /begin REF_CHARACTERISTIC FLDG_EnableDiagHwFltLoSideB_C /end REF_CHARACTERISTIC /end GROUP
/begin GROUP FltFaultDiagnoser_FLDG_DiagFaultResponse_1ms_sys_HwFaultLatch_Parameter8 "FltFaultDiagnoser/FLDG_DiagFaultResponse_1ms_sys/HwFaultLatch/Parameter8" /begin REF_CHARACTERISTIC FLDG_ResetLatchHwFltLoSideB_C /end REF_CHARACTERISTIC /end GROUP
/begin GROUP FltFaultDiagnoser_FLDG_DiagFaultResponse_1ms_sys_KL30VoltageDiag "FltFaultDiagnoser/FLDG_DiagFaultResponse_1ms_sys/KL30VoltageDiag"
 /begin SUB_GROUP FltFaultDiagnoser_FLDG_DiagFaultResponse_1ms_sys_KL30VoltageDiag_FaultDebounce FltFaultDiagnoser_FLDG_DiagFaultResponse_1ms_sys_KL30VoltageDiag_FaultDebounce1 FltFaultDiagnoser_FLDG_DiagFaultResponse_1ms_sys_KL30VoltageDiag_HysteresisCtrl FltFaultDiagnoser_FLDG_DiagFaultResponse_1ms_sys_KL30VoltageDiag_HysteresisCtrl1 FltFaultDiagnoser_FLDG_DiagFaultResponse_1ms_sys_KL30VoltageDiag_Parameter1 FltFaultDiagnoser_FLDG_DiagFaultResponse_1ms_sys_KL30VoltageDiag_Parameter10 FltFaultDiagnoser_FLDG_DiagFaultResponse_1ms_sys_KL30VoltageDiag_Parameter11 FltFaultDiagnoser_FLDG_DiagFaultResponse_1ms_sys_KL30VoltageDiag_Parameter12 FltFaultDiagnoser_FLDG_DiagFaultResponse_1ms_sys_KL30VoltageDiag_Parameter13 FltFaultDiagnoser_FLDG_DiagFaultResponse_1ms_sys_KL30VoltageDiag_Parameter14 FltFaultDiagnoser_FLDG_DiagFaultResponse_1ms_sys_KL30VoltageDiag_Parameter2 FltFaultDiagnoser_FLDG_DiagFaultResponse_1ms_sys_KL30VoltageDiag_Parameter3 FltFaultDiagnoser_FLDG_DiagFaultResponse_1ms_sys_KL30VoltageDiag_Parameter4 FltFaultDiagnoser_FLDG_DiagFaultResponse_1ms_sys_KL30VoltageDiag_Parameter5 FltFaultDiagnoser_FLDG_DiagFaultResponse_1ms_sys_KL30VoltageDiag_Parameter6 FltFaultDiagnoser_FLDG_DiagFaultResponse_1ms_sys_KL30VoltageDiag_Parameter7 FltFaultDiagnoser_FLDG_DiagFaultResponse_1ms_sys_KL30VoltageDiag_Parameter8 FltFaultDiagnoser_FLDG_DiagFaultResponse_1ms_sys_KL30VoltageDiag_Parameter9 /end SUB_GROUP
/end GROUP
/begin GROUP FltFaultDiagnoser_FLDG_DiagFaultResponse_1ms_sys_KL30VoltageDiag_FaultDebounce "FltFaultDiagnoser/FLDG_DiagFaultResponse_1ms_sys/KL30VoltageDiag/FaultDebounce"
 /begin SUB_GROUP FltFaultDiagnoser_FLDG_DiagFaultResponse_1ms_sys_KL30VoltageDiag_FaultDebounce_Subsystem FltFaultDiagnoser_FLDG_DiagFaultResponse_1ms_sys_KL30VoltageDiag_FaultDebounce_UnitDelay /end SUB_GROUP
/end GROUP
/begin GROUP FltFaultDiagnoser_FLDG_DiagFaultResponse_1ms_sys_KL30VoltageDiag_FaultDebounce1 "FltFaultDiagnoser/FLDG_DiagFaultResponse_1ms_sys/KL30VoltageDiag/FaultDebounce1"
 /begin SUB_GROUP FltFaultDiagnoser_FLDG_DiagFaultResponse_1ms_sys_KL30VoltageDiag_FaultDebounce1_Subsystem FltFaultDiagnoser_FLDG_DiagFaultResponse_1ms_sys_KL30VoltageDiag_FaultDebounce1_UnitDelay /end SUB_GROUP
/end GROUP
/begin GROUP FltFaultDiagnoser_FLDG_DiagFaultResponse_1ms_sys_KL30VoltageDiag_FaultDebounce1_Subsystem "FltFaultDiagnoser/FLDG_DiagFaultResponse_1ms_sys/KL30VoltageDiag/FaultDebounce1/Subsystem" /begin REF_MEASUREMENT FltFaultDiagnoser_DW.Memory_PreviousInput_k /end REF_MEASUREMENT /end GROUP
/begin GROUP FltFaultDiagnoser_FLDG_DiagFaultResponse_1ms_sys_KL30VoltageDiag_FaultDebounce1_UnitDelay "FltFaultDiagnoser/FLDG_DiagFaultResponse_1ms_sys/KL30VoltageDiag/FaultDebounce1/UnitDelay" /begin REF_MEASUREMENT FltFaultDiagnoser_DW.BareUnitDelay_DSTATE_o /end REF_MEASUREMENT /end GROUP
/begin GROUP FltFaultDiagnoser_FLDG_DiagFaultResponse_1ms_sys_KL30VoltageDiag_FaultDebounce_Subsystem "FltFaultDiagnoser/FLDG_DiagFaultResponse_1ms_sys/KL30VoltageDiag/FaultDebounce/Subsystem" /begin REF_MEASUREMENT FltFaultDiagnoser_DW.Memory_PreviousInput_n /end REF_MEASUREMENT /end GROUP
/begin GROUP FltFaultDiagnoser_FLDG_DiagFaultResponse_1ms_sys_KL30VoltageDiag_FaultDebounce_UnitDelay "FltFaultDiagnoser/FLDG_DiagFaultResponse_1ms_sys/KL30VoltageDiag/FaultDebounce/UnitDelay" /begin REF_MEASUREMENT FltFaultDiagnoser_DW.BareUnitDelay_DSTATE_d /end REF_MEASUREMENT /end GROUP
/begin GROUP FltFaultDiagnoser_FLDG_DiagFaultResponse_1ms_sys_KL30VoltageDiag_HysteresisCtrl "FltFaultDiagnoser/FLDG_DiagFaultResponse_1ms_sys/KL30VoltageDiag/HysteresisCtrl" /begin REF_MEASUREMENT FltFaultDiagnoser_DW.Delay_DSTATE SGSA_BatteryVolt /end REF_MEASUREMENT /end GROUP
/begin GROUP FltFaultDiagnoser_FLDG_DiagFaultResponse_1ms_sys_KL30VoltageDiag_HysteresisCtrl1 "FltFaultDiagnoser/FLDG_DiagFaultResponse_1ms_sys/KL30VoltageDiag/HysteresisCtrl1" /begin REF_MEASUREMENT FltFaultDiagnoser_DW.Delay_DSTATE_b SGSA_BatteryVolt /end REF_MEASUREMENT /end GROUP
/begin GROUP FltFaultDiagnoser_FLDG_DiagFaultResponse_1ms_sys_KL30VoltageDiag_Parameter1 "FltFaultDiagnoser/FLDG_DiagFaultResponse_1ms_sys/KL30VoltageDiag/Parameter1" /begin REF_CHARACTERISTIC FLDG_UBattVoltThrLoRcvrr_C /end REF_CHARACTERISTIC /end GROUP
/begin GROUP FltFaultDiagnoser_FLDG_DiagFaultResponse_1ms_sys_KL30VoltageDiag_Parameter10 "FltFaultDiagnoser/FLDG_DiagFaultResponse_1ms_sys/KL30VoltageDiag/Parameter10" /begin REF_CHARACTERISTIC FLDG_DebounceMinResolverSpdMonitor_C /end REF_CHARACTERISTIC /end GROUP
/begin GROUP FltFaultDiagnoser_FLDG_DiagFaultResponse_1ms_sys_KL30VoltageDiag_Parameter11 "FltFaultDiagnoser/FLDG_DiagFaultResponse_1ms_sys/KL30VoltageDiag/Parameter11" /begin REF_CHARACTERISTIC FLDG_DebounceIncrResolverSpdMonitor_C /end REF_CHARACTERISTIC /end GROUP
/begin GROUP FltFaultDiagnoser_FLDG_DiagFaultResponse_1ms_sys_KL30VoltageDiag_Parameter12 "FltFaultDiagnoser/FLDG_DiagFaultResponse_1ms_sys/KL30VoltageDiag/Parameter12" /begin REF_CHARACTERISTIC FLDG_DebounceDecrResolverSpdMonitor_C /end REF_CHARACTERISTIC /end GROUP
/begin GROUP FltFaultDiagnoser_FLDG_DiagFaultResponse_1ms_sys_KL30VoltageDiag_Parameter13 "FltFaultDiagnoser/FLDG_DiagFaultResponse_1ms_sys/KL30VoltageDiag/Parameter13" /begin REF_CHARACTERISTIC FLDG_UBattVoltThrHi_C /end REF_CHARACTERISTIC /end GROUP
/begin GROUP FltFaultDiagnoser_FLDG_DiagFaultResponse_1ms_sys_KL30VoltageDiag_Parameter14 "FltFaultDiagnoser/FLDG_DiagFaultResponse_1ms_sys/KL30VoltageDiag/Parameter14" /begin REF_CHARACTERISTIC FLDG_UBattVoltThrHiRcvrr_C /end REF_CHARACTERISTIC /end GROUP
/begin GROUP FltFaultDiagnoser_FLDG_DiagFaultResponse_1ms_sys_KL30VoltageDiag_Parameter2 "FltFaultDiagnoser/FLDG_DiagFaultResponse_1ms_sys/KL30VoltageDiag/Parameter2" /begin REF_CHARACTERISTIC FLDG_ResetResolverNMonitor_C /end REF_CHARACTERISTIC /end GROUP
/begin GROUP FltFaultDiagnoser_FLDG_DiagFaultResponse_1ms_sys_KL30VoltageDiag_Parameter3 "FltFaultDiagnoser/FLDG_DiagFaultResponse_1ms_sys/KL30VoltageDiag/Parameter3" /begin REF_CHARACTERISTIC FLDG_DebounceMaxResolverSpdMonitor_C /end REF_CHARACTERISTIC /end GROUP
/begin GROUP FltFaultDiagnoser_FLDG_DiagFaultResponse_1ms_sys_KL30VoltageDiag_Parameter4 "FltFaultDiagnoser/FLDG_DiagFaultResponse_1ms_sys/KL30VoltageDiag/Parameter4" /begin REF_CHARACTERISTIC FLDG_DebounceMinResolverSpdMonitor_C /end REF_CHARACTERISTIC /end GROUP
/begin GROUP FltFaultDiagnoser_FLDG_DiagFaultResponse_1ms_sys_KL30VoltageDiag_Parameter5 "FltFaultDiagnoser/FLDG_DiagFaultResponse_1ms_sys/KL30VoltageDiag/Parameter5" /begin REF_CHARACTERISTIC FLDG_DebounceIncrResolverSpdMonitor_C /end REF_CHARACTERISTIC /end GROUP
/begin GROUP FltFaultDiagnoser_FLDG_DiagFaultResponse_1ms_sys_KL30VoltageDiag_Parameter6 "FltFaultDiagnoser/FLDG_DiagFaultResponse_1ms_sys/KL30VoltageDiag/Parameter6" /begin REF_CHARACTERISTIC FLDG_DebounceDecrResolverSpdMonitor_C /end REF_CHARACTERISTIC /end GROUP
/begin GROUP FltFaultDiagnoser_FLDG_DiagFaultResponse_1ms_sys_KL30VoltageDiag_Parameter7 "FltFaultDiagnoser/FLDG_DiagFaultResponse_1ms_sys/KL30VoltageDiag/Parameter7" /begin REF_CHARACTERISTIC FLDG_ResetResolverNMonitor_C /end REF_CHARACTERISTIC /end GROUP
/begin GROUP FltFaultDiagnoser_FLDG_DiagFaultResponse_1ms_sys_KL30VoltageDiag_Parameter8 "FltFaultDiagnoser/FLDG_DiagFaultResponse_1ms_sys/KL30VoltageDiag/Parameter8" /begin REF_CHARACTERISTIC FLDG_UBattVoltThrLo_C /end REF_CHARACTERISTIC /end GROUP
/begin GROUP FltFaultDiagnoser_FLDG_DiagFaultResponse_1ms_sys_KL30VoltageDiag_Parameter9 "FltFaultDiagnoser/FLDG_DiagFaultResponse_1ms_sys/KL30VoltageDiag/Parameter9" /begin REF_CHARACTERISTIC FLDG_DebounceMaxResolverSpdMonitor_C /end REF_CHARACTERISTIC /end GROUP
/begin GROUP FltFaultDiagnoser_FLDG_DiagFaultResponse_1ms_sys_PowerModuleTemperatureDiag "FltFaultDiagnoser/FLDG_DiagFaultResponse_1ms_sys/PowerModuleTemperatureDiag"
 /begin SUB_GROUP FltFaultDiagnoser_FLDG_DiagFaultResponse_1ms_sys_PowerModuleTemperatureDiag_FaultDebounce FltFaultDiagnoser_FLDG_DiagFaultResponse_1ms_sys_PowerModuleTemperatureDiag_Parameter1 FltFaultDiagnoser_FLDG_DiagFaultResponse_1ms_sys_PowerModuleTemperatureDiag_Parameter2 FltFaultDiagnoser_FLDG_DiagFaultResponse_1ms_sys_PowerModuleTemperatureDiag_Parameter3 FltFaultDiagnoser_FLDG_DiagFaultResponse_1ms_sys_PowerModuleTemperatureDiag_Parameter4 FltFaultDiagnoser_FLDG_DiagFaultResponse_1ms_sys_PowerModuleTemperatureDiag_Parameter5 FltFaultDiagnoser_FLDG_DiagFaultResponse_1ms_sys_PowerModuleTemperatureDiag_Parameter6 /end SUB_GROUP
/end GROUP
/begin GROUP FltFaultDiagnoser_FLDG_DiagFaultResponse_1ms_sys_PowerModuleTemperatureDiag_FaultDebounce "FltFaultDiagnoser/FLDG_DiagFaultResponse_1ms_sys/PowerModuleTemperatureDiag/FaultDebounce"
 /begin SUB_GROUP FltFaultDiagnoser_FLDG_DiagFaultResponse_1ms_sys_PowerModuleTemperatureDiag_FaultDebounce_Subsystem FltFaultDiagnoser_FLDG_DiagFaultResponse_1ms_sys_PowerModuleTemperatureDiag_FaultDebounce_UnitDelay /end SUB_GROUP
/end GROUP
/begin GROUP FltFaultDiagnoser_FLDG_DiagFaultResponse_1ms_sys_PowerModuleTemperatureDiag_FaultDebounce_Subsystem "FltFaultDiagnoser/FLDG_DiagFaultResponse_1ms_sys/PowerModuleTemperatureDiag/FaultDebounce/Subsystem" /begin REF_MEASUREMENT FltFaultDiagnoser_DW.Memory_PreviousInput_i /end REF_MEASUREMENT /end GROUP
/begin GROUP FltFaultDiagnoser_FLDG_DiagFaultResponse_1ms_sys_PowerModuleTemperatureDiag_FaultDebounce_UnitDelay "FltFaultDiagnoser/FLDG_DiagFaultResponse_1ms_sys/PowerModuleTemperatureDiag/FaultDebounce/UnitDelay" /begin REF_MEASUREMENT FltFaultDiagnoser_DW.BareUnitDelay_DSTATE_e /end REF_MEASUREMENT /end GROUP
/begin GROUP FltFaultDiagnoser_FLDG_DiagFaultResponse_1ms_sys_PowerModuleTemperatureDiag_Parameter1 "FltFaultDiagnoser/FLDG_DiagFaultResponse_1ms_sys/PowerModuleTemperatureDiag/Parameter1" /begin REF_CHARACTERISTIC FLDG_TIgbtPha1Thr_C /end REF_CHARACTERISTIC /end GROUP
/begin GROUP FltFaultDiagnoser_FLDG_DiagFaultResponse_1ms_sys_PowerModuleTemperatureDiag_Parameter2 "FltFaultDiagnoser/FLDG_DiagFaultResponse_1ms_sys/PowerModuleTemperatureDiag/Parameter2" /begin REF_CHARACTERISTIC FLDG_ResetInvTMonitor_C /end REF_CHARACTERISTIC /end GROUP
/begin GROUP FltFaultDiagnoser_FLDG_DiagFaultResponse_1ms_sys_PowerModuleTemperatureDiag_Parameter3 "FltFaultDiagnoser/FLDG_DiagFaultResponse_1ms_sys/PowerModuleTemperatureDiag/Parameter3" /begin REF_CHARACTERISTIC FLDG_DebounceMaxInvTMonitor_C /end REF_CHARACTERISTIC /end GROUP
/begin GROUP FltFaultDiagnoser_FLDG_DiagFaultResponse_1ms_sys_PowerModuleTemperatureDiag_Parameter4 "FltFaultDiagnoser/FLDG_DiagFaultResponse_1ms_sys/PowerModuleTemperatureDiag/Parameter4" /begin REF_CHARACTERISTIC FLDG_DebounceMinInvTMonitor_C /end REF_CHARACTERISTIC /end GROUP
/begin GROUP FltFaultDiagnoser_FLDG_DiagFaultResponse_1ms_sys_PowerModuleTemperatureDiag_Parameter5 "FltFaultDiagnoser/FLDG_DiagFaultResponse_1ms_sys/PowerModuleTemperatureDiag/Parameter5" /begin REF_CHARACTERISTIC FLDG_DebounceIncrInvTMonitor_C /end REF_CHARACTERISTIC /end GROUP
/begin GROUP FltFaultDiagnoser_FLDG_DiagFaultResponse_1ms_sys_PowerModuleTemperatureDiag_Parameter6 "FltFaultDiagnoser/FLDG_DiagFaultResponse_1ms_sys/PowerModuleTemperatureDiag/Parameter6" /begin REF_CHARACTERISTIC FLDG_DebounceDecrInvTMonitor_C /end REF_CHARACTERISTIC /end GROUP
/begin GROUP FltFaultDiagnoser_FLDG_DiagFaultResponse_1ms_sys_ResolverFaultDecode "FltFaultDiagnoser/FLDG_DiagFaultResponse_1ms_sys/ResolverFaultDecode"
 /begin SUB_GROUP FltFaultDiagnoser_FLDG_DiagFaultResponse_1ms_sys_ResolverFaultDecode_HoldLatch FltFaultDiagnoser_FLDG_DiagFaultResponse_1ms_sys_ResolverFaultDecode_HoldLatch1 FltFaultDiagnoser_FLDG_DiagFaultResponse_1ms_sys_ResolverFaultDecode_HoldLatch2 FltFaultDiagnoser_FLDG_DiagFaultResponse_1ms_sys_ResolverFaultDecode_HoldLatch3 FltFaultDiagnoser_FLDG_DiagFaultResponse_1ms_sys_ResolverFaultDecode_Parameter1 FltFaultDiagnoser_FLDG_DiagFaultResponse_1ms_sys_ResolverFaultDecode_Parameter2 FltFaultDiagnoser_FLDG_DiagFaultResponse_1ms_sys_ResolverFaultDecode_Parameter3 FltFaultDiagnoser_FLDG_DiagFaultResponse_1ms_sys_ResolverFaultDecode_Parameter4 FltFaultDiagnoser_FLDG_DiagFaultResponse_1ms_sys_ResolverFaultDecode_Parameter5 FltFaultDiagnoser_FLDG_DiagFaultResponse_1ms_sys_ResolverFaultDecode_Parameter6 FltFaultDiagnoser_FLDG_DiagFaultResponse_1ms_sys_ResolverFaultDecode_Parameter7 FltFaultDiagnoser_FLDG_DiagFaultResponse_1ms_sys_ResolverFaultDecode_Parameter8 /end SUB_GROUP
 /begin REF_MEASUREMENT SGSA_ResolverError /end REF_MEASUREMENT
/end GROUP
/begin GROUP FltFaultDiagnoser_FLDG_DiagFaultResponse_1ms_sys_ResolverFaultDecode_HoldLatch "FltFaultDiagnoser/FLDG_DiagFaultResponse_1ms_sys/ResolverFaultDecode/HoldLatch" /begin REF_MEASUREMENT FltFaultDiagnoser_DW.UnitDelay_DSTATE_ax /end REF_MEASUREMENT /end GROUP
/begin GROUP FltFaultDiagnoser_FLDG_DiagFaultResponse_1ms_sys_ResolverFaultDecode_HoldLatch1 "FltFaultDiagnoser/FLDG_DiagFaultResponse_1ms_sys/ResolverFaultDecode/HoldLatch1" /begin REF_MEASUREMENT FltFaultDiagnoser_DW.UnitDelay_DSTATE_f /end REF_MEASUREMENT /end GROUP
/begin GROUP FltFaultDiagnoser_FLDG_DiagFaultResponse_1ms_sys_ResolverFaultDecode_HoldLatch2 "FltFaultDiagnoser/FLDG_DiagFaultResponse_1ms_sys/ResolverFaultDecode/HoldLatch2" /begin REF_MEASUREMENT FltFaultDiagnoser_DW.UnitDelay_DSTATE_l /end REF_MEASUREMENT /end GROUP
/begin GROUP FltFaultDiagnoser_FLDG_DiagFaultResponse_1ms_sys_ResolverFaultDecode_HoldLatch3 "FltFaultDiagnoser/FLDG_DiagFaultResponse_1ms_sys/ResolverFaultDecode/HoldLatch3" /begin REF_MEASUREMENT FltFaultDiagnoser_DW.UnitDelay_DSTATE_m /end REF_MEASUREMENT /end GROUP
/begin GROUP FltFaultDiagnoser_FLDG_DiagFaultResponse_1ms_sys_ResolverFaultDecode_Parameter1 "FltFaultDiagnoser/FLDG_DiagFaultResponse_1ms_sys/ResolverFaultDecode/Parameter1" /begin REF_CHARACTERISTIC FLDG_EnableDiagResolverDiagDos_C /end REF_CHARACTERISTIC /end GROUP
/begin GROUP FltFaultDiagnoser_FLDG_DiagFaultResponse_1ms_sys_ResolverFaultDecode_Parameter2 "FltFaultDiagnoser/FLDG_DiagFaultResponse_1ms_sys/ResolverFaultDecode/Parameter2" /begin REF_CHARACTERISTIC FLDG_ResetLatchResolverDos_C /end REF_CHARACTERISTIC /end GROUP
/begin GROUP FltFaultDiagnoser_FLDG_DiagFaultResponse_1ms_sys_ResolverFaultDecode_Parameter3 "FltFaultDiagnoser/FLDG_DiagFaultResponse_1ms_sys/ResolverFaultDecode/Parameter3" /begin REF_CHARACTERISTIC FLDG_EnableDiagResolverSineLosDiag_C /end REF_CHARACTERISTIC /end GROUP
/begin GROUP FltFaultDiagnoser_FLDG_DiagFaultResponse_1ms_sys_ResolverFaultDecode_Parameter4 "FltFaultDiagnoser/FLDG_DiagFaultResponse_1ms_sys/ResolverFaultDecode/Parameter4" /begin REF_CHARACTERISTIC FLDG_ResetLatchResolverSineLos_C /end REF_CHARACTERISTIC /end GROUP
/begin GROUP FltFaultDiagnoser_FLDG_DiagFaultResponse_1ms_sys_ResolverFaultDecode_Parameter5 "FltFaultDiagnoser/FLDG_DiagFaultResponse_1ms_sys/ResolverFaultDecode/Parameter5" /begin REF_CHARACTERISTIC FLDG_EnableDiagResolverCosLosDiag_C /end REF_CHARACTERISTIC /end GROUP
/begin GROUP FltFaultDiagnoser_FLDG_DiagFaultResponse_1ms_sys_ResolverFaultDecode_Parameter6 "FltFaultDiagnoser/FLDG_DiagFaultResponse_1ms_sys/ResolverFaultDecode/Parameter6" /begin REF_CHARACTERISTIC FLDG_ResetLatchResolverCosLos_C /end REF_CHARACTERISTIC /end GROUP
/begin GROUP FltFaultDiagnoser_FLDG_DiagFaultResponse_1ms_sys_ResolverFaultDecode_Parameter7 "FltFaultDiagnoser/FLDG_DiagFaultResponse_1ms_sys/ResolverFaultDecode/Parameter7" /begin REF_CHARACTERISTIC FLDG_EnableDiagResolverDiagSigLot_C /end REF_CHARACTERISTIC /end GROUP
/begin GROUP FltFaultDiagnoser_FLDG_DiagFaultResponse_1ms_sys_ResolverFaultDecode_Parameter8 "FltFaultDiagnoser/FLDG_DiagFaultResponse_1ms_sys/ResolverFaultDecode/Parameter8" /begin REF_CHARACTERISTIC FLDG_ResetLatchResolverSigLot_C /end REF_CHARACTERISTIC /end GROUP
/begin GROUP FltFaultDiagnoser_FLDG_DiagFaultResponse_1ms_sys_SpeedDiag "FltFaultDiagnoser/FLDG_DiagFaultResponse_1ms_sys/SpeedDiag"
 /begin SUB_GROUP FltFaultDiagnoser_FLDG_DiagFaultResponse_1ms_sys_SpeedDiag_FaultDebounce FltFaultDiagnoser_FLDG_DiagFaultResponse_1ms_sys_SpeedDiag_HysteresisCtrl FltFaultDiagnoser_FLDG_DiagFaultResponse_1ms_sys_SpeedDiag_Parameter1 FltFaultDiagnoser_FLDG_DiagFaultResponse_1ms_sys_SpeedDiag_Parameter2 FltFaultDiagnoser_FLDG_DiagFaultResponse_1ms_sys_SpeedDiag_Parameter3 FltFaultDiagnoser_FLDG_DiagFaultResponse_1ms_sys_SpeedDiag_Parameter4 FltFaultDiagnoser_FLDG_DiagFaultResponse_1ms_sys_SpeedDiag_Parameter5 FltFaultDiagnoser_FLDG_DiagFaultResponse_1ms_sys_SpeedDiag_Parameter6 FltFaultDiagnoser_FLDG_DiagFaultResponse_1ms_sys_SpeedDiag_Parameter8 /end SUB_GROUP
/end GROUP
/begin GROUP FltFaultDiagnoser_FLDG_DiagFaultResponse_1ms_sys_SpeedDiag_FaultDebounce "FltFaultDiagnoser/FLDG_DiagFaultResponse_1ms_sys/SpeedDiag/FaultDebounce"
 /begin SUB_GROUP FltFaultDiagnoser_FLDG_DiagFaultResponse_1ms_sys_SpeedDiag_FaultDebounce_Subsystem FltFaultDiagnoser_FLDG_DiagFaultResponse_1ms_sys_SpeedDiag_FaultDebounce_UnitDelay /end SUB_GROUP
/end GROUP
/begin GROUP FltFaultDiagnoser_FLDG_DiagFaultResponse_1ms_sys_SpeedDiag_FaultDebounce_Subsystem "FltFaultDiagnoser/FLDG_DiagFaultResponse_1ms_sys/SpeedDiag/FaultDebounce/Subsystem" /begin REF_MEASUREMENT FltFaultDiagnoser_DW.Memory_PreviousInput_l /end REF_MEASUREMENT /end GROUP
/begin GROUP FltFaultDiagnoser_FLDG_DiagFaultResponse_1ms_sys_SpeedDiag_FaultDebounce_UnitDelay "FltFaultDiagnoser/FLDG_DiagFaultResponse_1ms_sys/SpeedDiag/FaultDebounce/UnitDelay" /begin REF_MEASUREMENT FltFaultDiagnoser_DW.BareUnitDelay_DSTATE_e2 /end REF_MEASUREMENT /end GROUP
/begin GROUP FltFaultDiagnoser_FLDG_DiagFaultResponse_1ms_sys_SpeedDiag_HysteresisCtrl "FltFaultDiagnoser/FLDG_DiagFaultResponse_1ms_sys/SpeedDiag/HysteresisCtrl" /begin REF_MEASUREMENT FltFaultDiagnoser_DW.Delay_DSTATE_i SGPP_MechSpeedAbsolute /end REF_MEASUREMENT /end GROUP
/begin GROUP FltFaultDiagnoser_FLDG_DiagFaultResponse_1ms_sys_SpeedDiag_Parameter1 "FltFaultDiagnoser/FLDG_DiagFaultResponse_1ms_sys/SpeedDiag/Parameter1" /begin REF_CHARACTERISTIC FLDG_SpdResolverThrFai_C /end REF_CHARACTERISTIC /end GROUP
/begin GROUP FltFaultDiagnoser_FLDG_DiagFaultResponse_1ms_sys_SpeedDiag_Parameter2 "FltFaultDiagnoser/FLDG_DiagFaultResponse_1ms_sys/SpeedDiag/Parameter2" /begin REF_CHARACTERISTIC FLDG_ResetResolverNMonitor_C /end REF_CHARACTERISTIC /end GROUP
/begin GROUP FltFaultDiagnoser_FLDG_DiagFaultResponse_1ms_sys_SpeedDiag_Parameter3 "FltFaultDiagnoser/FLDG_DiagFaultResponse_1ms_sys/SpeedDiag/Parameter3" /begin REF_CHARACTERISTIC FLDG_DebounceMaxResolverSpdMonitor_C /end REF_CHARACTERISTIC /end GROUP
/begin GROUP FltFaultDiagnoser_FLDG_DiagFaultResponse_1ms_sys_SpeedDiag_Parameter4 "FltFaultDiagnoser/FLDG_DiagFaultResponse_1ms_sys/SpeedDiag/Parameter4" /begin REF_CHARACTERISTIC FLDG_DebounceMinResolverSpdMonitor_C /end REF_CHARACTERISTIC /end GROUP
/begin GROUP FltFaultDiagnoser_FLDG_DiagFaultResponse_1ms_sys_SpeedDiag_Parameter5 "FltFaultDiagnoser/FLDG_DiagFaultResponse_1ms_sys/SpeedDiag/Parameter5" /begin REF_CHARACTERISTIC FLDG_DebounceIncrResolverSpdMonitor_C /end REF_CHARACTERISTIC /end GROUP
/begin GROUP FltFaultDiagnoser_FLDG_DiagFaultResponse_1ms_sys_SpeedDiag_Parameter6 "FltFaultDiagnoser/FLDG_DiagFaultResponse_1ms_sys/SpeedDiag/Parameter6" /begin REF_CHARACTERISTIC FLDG_DebounceDecrResolverSpdMonitor_C /end REF_CHARACTERISTIC /end GROUP
/begin GROUP FltFaultDiagnoser_FLDG_DiagFaultResponse_1ms_sys_SpeedDiag_Parameter8 "FltFaultDiagnoser/FLDG_DiagFaultResponse_1ms_sys/SpeedDiag/Parameter8" /begin REF_CHARACTERISTIC FLDG_SpdResolverThrFaiRcvrr_C /end REF_CHARACTERISTIC /end GROUP
/begin GROUP FltFaultDiagnoser_FLDG_DiagFaultResponse_1ms_sys_UdcVoltageDiag "FltFaultDiagnoser/FLDG_DiagFaultResponse_1ms_sys/UdcVoltageDiag"
 /begin SUB_GROUP FltFaultDiagnoser_FLDG_DiagFaultResponse_1ms_sys_UdcVoltageDiag_FaultDebounce FltFaultDiagnoser_FLDG_DiagFaultResponse_1ms_sys_UdcVoltageDiag_HoldLatch FltFaultDiagnoser_FLDG_DiagFaultResponse_1ms_sys_UdcVoltageDiag_Parameter1 FltFaultDiagnoser_FLDG_DiagFaultResponse_1ms_sys_UdcVoltageDiag_Parameter2 FltFaultDiagnoser_FLDG_DiagFaultResponse_1ms_sys_UdcVoltageDiag_Parameter3 FltFaultDiagnoser_FLDG_DiagFaultResponse_1ms_sys_UdcVoltageDiag_Parameter4 FltFaultDiagnoser_FLDG_DiagFaultResponse_1ms_sys_UdcVoltageDiag_Parameter5 FltFaultDiagnoser_FLDG_DiagFaultResponse_1ms_sys_UdcVoltageDiag_Parameter6 FltFaultDiagnoser_FLDG_DiagFaultResponse_1ms_sys_UdcVoltageDiag_Parameter7 /end SUB_GROUP
 /begin REF_MEASUREMENT SGPP_DcLinkVoltMeas /end REF_MEASUREMENT
/end GROUP
/begin GROUP FltFaultDiagnoser_FLDG_DiagFaultResponse_1ms_sys_UdcVoltageDiag_FaultDebounce "FltFaultDiagnoser/FLDG_DiagFaultResponse_1ms_sys/UdcVoltageDiag/FaultDebounce"
 /begin SUB_GROUP FltFaultDiagnoser_FLDG_DiagFaultResponse_1ms_sys_UdcVoltageDiag_FaultDebounce_Subsystem FltFaultDiagnoser_FLDG_DiagFaultResponse_1ms_sys_UdcVoltageDiag_FaultDebounce_UnitDelay /end SUB_GROUP
/end GROUP
/begin GROUP FltFaultDiagnoser_FLDG_DiagFaultResponse_1ms_sys_UdcVoltageDiag_FaultDebounce_Subsystem "FltFaultDiagnoser/FLDG_DiagFaultResponse_1ms_sys/UdcVoltageDiag/FaultDebounce/Subsystem" /begin REF_MEASUREMENT FltFaultDiagnoser_DW.Memory_PreviousInput_m /end REF_MEASUREMENT /end GROUP
/begin GROUP FltFaultDiagnoser_FLDG_DiagFaultResponse_1ms_sys_UdcVoltageDiag_FaultDebounce_UnitDelay "FltFaultDiagnoser/FLDG_DiagFaultResponse_1ms_sys/UdcVoltageDiag/FaultDebounce/UnitDelay" /begin REF_MEASUREMENT FltFaultDiagnoser_DW.BareUnitDelay_DSTATE /end REF_MEASUREMENT /end GROUP
/begin GROUP FltFaultDiagnoser_FLDG_DiagFaultResponse_1ms_sys_UdcVoltageDiag_HoldLatch "FltFaultDiagnoser/FLDG_DiagFaultResponse_1ms_sys/UdcVoltageDiag/HoldLatch" /begin REF_MEASUREMENT FltFaultDiagnoser_DW.UnitDelay_DSTATE_h /end REF_MEASUREMENT /end GROUP
/begin GROUP FltFaultDiagnoser_FLDG_DiagFaultResponse_1ms_sys_UdcVoltageDiag_Parameter1 "FltFaultDiagnoser/FLDG_DiagFaultResponse_1ms_sys/UdcVoltageDiag/Parameter1" /begin REF_CHARACTERISTIC FLDG_UDcThrHi_C /end REF_CHARACTERISTIC /end GROUP
/begin GROUP FltFaultDiagnoser_FLDG_DiagFaultResponse_1ms_sys_UdcVoltageDiag_Parameter2 "FltFaultDiagnoser/FLDG_DiagFaultResponse_1ms_sys/UdcVoltageDiag/Parameter2" /begin REF_CHARACTERISTIC FLDG_ResetDcDiagUHi_C /end REF_CHARACTERISTIC /end GROUP
/begin GROUP FltFaultDiagnoser_FLDG_DiagFaultResponse_1ms_sys_UdcVoltageDiag_Parameter3 "FltFaultDiagnoser/FLDG_DiagFaultResponse_1ms_sys/UdcVoltageDiag/Parameter3" /begin REF_CHARACTERISTIC FLDG_DebounceMaxDcVoltHi_C /end REF_CHARACTERISTIC /end GROUP
/begin GROUP FltFaultDiagnoser_FLDG_DiagFaultResponse_1ms_sys_UdcVoltageDiag_Parameter4 "FltFaultDiagnoser/FLDG_DiagFaultResponse_1ms_sys/UdcVoltageDiag/Parameter4" /begin REF_CHARACTERISTIC FLDG_DebounceMinDcVoltHi_C /end REF_CHARACTERISTIC /end GROUP
/begin GROUP FltFaultDiagnoser_FLDG_DiagFaultResponse_1ms_sys_UdcVoltageDiag_Parameter5 "FltFaultDiagnoser/FLDG_DiagFaultResponse_1ms_sys/UdcVoltageDiag/Parameter5" /begin REF_CHARACTERISTIC FLDG_DebounceIncrDcVoltHi_C /end REF_CHARACTERISTIC /end GROUP
/begin GROUP FltFaultDiagnoser_FLDG_DiagFaultResponse_1ms_sys_UdcVoltageDiag_Parameter6 "FltFaultDiagnoser/FLDG_DiagFaultResponse_1ms_sys/UdcVoltageDiag/Parameter6" /begin REF_CHARACTERISTIC FLDG_DebounceDecrDcVoltHi_C /end REF_CHARACTERISTIC /end GROUP
/begin GROUP FltFaultDiagnoser_FLDG_DiagFaultResponse_1ms_sys_UdcVoltageDiag_Parameter7 "FltFaultDiagnoser/FLDG_DiagFaultResponse_1ms_sys/UdcVoltageDiag/Parameter7" /begin REF_CHARACTERISTIC FLDG_ResetLatchDcVoltHi_C /end REF_CHARACTERISTIC /end GROUP
/begin GROUP FltFaultDiagnoser_FLDG_DiagTempSlow_10ms_sys "FltFaultDiagnoser/FLDG_DiagTempSlow_10ms_sys"
 /begin SUB_GROUP FltFaultDiagnoser_FLDG_DiagTempSlow_10ms_sys_MotorTemperatureDiag /end SUB_GROUP
/end GROUP
/begin GROUP FltFaultDiagnoser_FLDG_DiagTempSlow_10ms_sys_MotorTemperatureDiag "FltFaultDiagnoser/FLDG_DiagTempSlow_10ms_sys/MotorTemperatureDiag"
 /begin SUB_GROUP FltFaultDiagnoser_FLDG_DiagTempSlow_10ms_sys_MotorTemperatureDiag_FaultDebounce FltFaultDiagnoser_FLDG_DiagTempSlow_10ms_sys_MotorTemperatureDiag_Parameter1 FltFaultDiagnoser_FLDG_DiagTempSlow_10ms_sys_MotorTemperatureDiag_Parameter2 FltFaultDiagnoser_FLDG_DiagTempSlow_10ms_sys_MotorTemperatureDiag_Parameter3 FltFaultDiagnoser_FLDG_DiagTempSlow_10ms_sys_MotorTemperatureDiag_Parameter4 FltFaultDiagnoser_FLDG_DiagTempSlow_10ms_sys_MotorTemperatureDiag_Parameter5 FltFaultDiagnoser_FLDG_DiagTempSlow_10ms_sys_MotorTemperatureDiag_Parameter6 /end SUB_GROUP
 /begin REF_MEASUREMENT SGPP_MotorTemp1 /end REF_MEASUREMENT
/end GROUP
/begin GROUP FltFaultDiagnoser_FLDG_DiagTempSlow_10ms_sys_MotorTemperatureDiag_FaultDebounce "FltFaultDiagnoser/FLDG_DiagTempSlow_10ms_sys/MotorTemperatureDiag/FaultDebounce"
 /begin SUB_GROUP FltFaultDiagnoser_FLDG_DiagTempSlow_10ms_sys_MotorTemperatureDiag_FaultDebounce_Subsystem FltFaultDiagnoser_FLDG_DiagTempSlow_10ms_sys_MotorTemperatureDiag_FaultDebounce_UnitDelay /end SUB_GROUP
/end GROUP
/begin GROUP FltFaultDiagnoser_FLDG_DiagTempSlow_10ms_sys_MotorTemperatureDiag_FaultDebounce_Subsystem "FltFaultDiagnoser/FLDG_DiagTempSlow_10ms_sys/MotorTemperatureDiag/FaultDebounce/Subsystem" /begin REF_MEASUREMENT FltFaultDiagnoser_DW.Memory_PreviousInput /end REF_MEASUREMENT /end GROUP
/begin GROUP FltFaultDiagnoser_FLDG_DiagTempSlow_10ms_sys_MotorTemperatureDiag_FaultDebounce_UnitDelay "FltFaultDiagnoser/FLDG_DiagTempSlow_10ms_sys/MotorTemperatureDiag/FaultDebounce/UnitDelay" /begin REF_MEASUREMENT FltFaultDiagnoser_DW.BareUnitDelay_DSTATE_k /end REF_MEASUREMENT /end GROUP
/begin GROUP FltFaultDiagnoser_FLDG_DiagTempSlow_10ms_sys_MotorTemperatureDiag_Parameter1 "FltFaultDiagnoser/FLDG_DiagTempSlow_10ms_sys/MotorTemperatureDiag/Parameter1" /begin REF_CHARACTERISTIC FLDG_TWindingThr_C /end REF_CHARACTERISTIC /end GROUP
/begin GROUP FltFaultDiagnoser_FLDG_DiagTempSlow_10ms_sys_MotorTemperatureDiag_Parameter2 "FltFaultDiagnoser/FLDG_DiagTempSlow_10ms_sys/MotorTemperatureDiag/Parameter2" /begin REF_CHARACTERISTIC FLDG_ResetWindingTMonitor_C /end REF_CHARACTERISTIC /end GROUP
/begin GROUP FltFaultDiagnoser_FLDG_DiagTempSlow_10ms_sys_MotorTemperatureDiag_Parameter3 "FltFaultDiagnoser/FLDG_DiagTempSlow_10ms_sys/MotorTemperatureDiag/Parameter3" /begin REF_CHARACTERISTIC FLDG_DebounceMaxWindingTMonitor_C /end REF_CHARACTERISTIC /end GROUP
/begin GROUP FltFaultDiagnoser_FLDG_DiagTempSlow_10ms_sys_MotorTemperatureDiag_Parameter4 "FltFaultDiagnoser/FLDG_DiagTempSlow_10ms_sys/MotorTemperatureDiag/Parameter4" /begin REF_CHARACTERISTIC FLDG_DebounceMinWindingTMonitor_C /end REF_CHARACTERISTIC /end GROUP
/begin GROUP FltFaultDiagnoser_FLDG_DiagTempSlow_10ms_sys_MotorTemperatureDiag_Parameter5 "FltFaultDiagnoser/FLDG_DiagTempSlow_10ms_sys/MotorTemperatureDiag/Parameter5" /begin REF_CHARACTERISTIC FLDG_DebounceIncrWindingTMonitor_C /end REF_CHARACTERISTIC /end GROUP
/begin GROUP FltFaultDiagnoser_FLDG_DiagTempSlow_10ms_sys_MotorTemperatureDiag_Parameter6 "FltFaultDiagnoser/FLDG_DiagTempSlow_10ms_sys/MotorTemperatureDiag/Parameter6" /begin REF_CHARACTERISTIC FLDG_DebounceDecrWindingTMonitor_C /end REF_CHARACTERISTIC /end GROUP
/end MODULE
/end PROJECT
/* (add any file trailer comments here) */
/* EOF FltFaultDiagnoser.a2l*/
