/******************************************************************************
* ASAP2 file: CtlDeratingManager.a2l
* Code generation for model "CtlDeratingManager".
* Model version : 1.8
* Simulink Coder version : 10.6 R2022b
* C source code generated on : Thu May 28 16:44:18 2026
* Target selection: ert.tlc
* Embedded hardware selection: Infineon->TriCore
* Code generation objectives: Unspecified
* Validation result: Not run
* (add additional file header information here)
******************************************************************************/ ASAP2_VERSION 1 31
/* Version 1.31 */
/begin PROJECT ProjectName "Project Comment Goes Here"
/begin HEADER "Header Comments go here" /end HEADER
/begin MODULE ModuleName "Module Comment Goes Here"
/begin MOD_PAR "MOD PAR Comment Goes Here" /end MOD_PAR
/begin MOD_COMMON "Mod Common Comment Here" BYTE_ORDER MSB_LAST ALIGNMENT_BYTE 1 ALIGNMENT_WORD 2 ALIGNMENT_LONG 4 ALIGNMENT_FLOAT32_IEEE 4 ALIGNMENT_FLOAT64_IEEE 4 /end MOD_COMMON
/begin CHARACTERISTIC CTDM_EnJunctionTempDerate_C "Enable junction temperature derate: 0=disabled, 1=enabled" VALUE 0x0000 /* @ECU_Address@CTDM_EnJunctionTempDerate_C@ */ Record_UBYTE 0 CtlDeratingManager_CM_uint8_dash_ 0.000000 1.000000 /end CHARACTERISTIC
/begin CHARACTERISTIC CTDM_EnMotorTempDerate_C "Enable motor temperature derate: 0=disabled, 1=enabled" VALUE 0x0000 /* @ECU_Address@CTDM_EnMotorTempDerate_C@ */ Record_UBYTE 0 CtlDeratingManager_CM_uint8_dash_ 0.000000 1.000000 /end CHARACTERISTIC
/begin CHARACTERISTIC CTDM_EnSpeedOverDerate_C "Enable speed overspeed derate: 0=disabled, 1=enabled" VALUE 0x0000 /* @ECU_Address@CTDM_EnSpeedOverDerate_C@ */ Record_UBYTE 0 CtlDeratingManager_CM_uint8_dash_ 0.000000 2.000000 /end CHARACTERISTIC
/begin CHARACTERISTIC CTDM_EnVoltDCOverDerate_C "Enable DC voltage overvoltage derate: 0=disabled, 1=enabled" VALUE 0x0000 /* @ECU_Address@CTDM_EnVoltDCOverDerate_C@ */ Record_UBYTE 0 CtlDeratingManager_CM_uint8_dash_ 0.000000 1.000000 /end CHARACTERISTIC
/begin CHARACTERISTIC CTDM_EnVoltDCUnderDerate_C "Enable DC voltage undervoltage derate: 0=disabled, 1=enabled" VALUE 0x0000 /* @ECU_Address@CTDM_EnVoltDCUnderDerate_C@ */ Record_UBYTE 0 CtlDeratingManager_CM_uint8_dash_ 0.000000 1.000000 /end CHARACTERISTIC
/begin CHARACTERISTIC CTDM_ScaleJunctionTempDerate_C "Junction temperature derate scale map (1.0=no derate, 0.0=full derate)" CURVE 0x0000 /* @ECU_Address@CTDM_ScaleJunctionTempDerate_C@ */ Record_FLOAT32_IEEE 0 CtlDeratingManager_CM_single -3.4E+38 3.4E+38
 /begin AXIS_DESCR COM_AXIS SGPP_SwitchTempMax CtlDeratingManager_CM_single_degC 10 -3.4E+38 3.4E+38 AXIS_PTS_REF CTDM_AxisJunctionTempDerate_C /end AXIS_DESCR
/end CHARACTERISTIC
/begin CHARACTERISTIC CTDM_ScaleMotorTempDerate_C "Motor temperature derate scale map (1.0=no derate, 0.0=full derate)" CURVE 0x0000 /* @ECU_Address@CTDM_ScaleMotorTempDerate_C@ */ Record_FLOAT32_IEEE 0 CtlDeratingManager_CM_single -3.4E+38 3.4E+38
 /begin AXIS_DESCR COM_AXIS SGPP_MotorTemp1 CtlDeratingManager_CM_single_degC 10 -3.4E+38 3.4E+38 AXIS_PTS_REF CTDM_AxisMotorTempDerate_C /end AXIS_DESCR
/end CHARACTERISTIC
/begin CHARACTERISTIC CTDM_ScaleRateDown_C "Derate scale decreasing rate limit (scale/s). Limit when derating becomes stronger" VALUE 0x0000 /* @ECU_Address@CTDM_ScaleRateDown_C@ */ Record_FLOAT32_IEEE 0 CtlDeratingManager_CM_single_1_per_s -100.000000 100.000000 /end CHARACTERISTIC
/begin CHARACTERISTIC CTDM_ScaleRateUp_C "Derate scale increasing rate limit (scale/s). Limit for recovery towards 1" VALUE 0x0000 /* @ECU_Address@CTDM_ScaleRateUp_C@ */ Record_FLOAT32_IEEE 0 CtlDeratingManager_CM_single_1_per_s 0.000000 3.4E+38 /end CHARACTERISTIC
/begin CHARACTERISTIC CTDM_ScaleSpeedOverDerate_C "Speed overspeed derate scale map (1.0=no derate, 0.0=full derate)" CURVE 0x0000 /* @ECU_Address@CTDM_ScaleSpeedOverDerate_C@ */ Record_FLOAT32_IEEE 0 CtlDeratingManager_CM_single -3.4E+38 3.4E+38
 /begin AXIS_DESCR COM_AXIS SGPP_MechSpeed CtlDeratingManager_CM_single_rpm 10 -3.4E+38 3.4E+38 AXIS_PTS_REF CTDM_SpeedOverDerate_C /end AXIS_DESCR
/end CHARACTERISTIC
/begin CHARACTERISTIC CTDM_ScaleVoltDCOverDerate_C "DC bus overvoltage derate scale map (1.0=no derate, 0.0=full derate)" CURVE 0x0000 /* @ECU_Address@CTDM_ScaleVoltDCOverDerate_C@ */ Record_FLOAT32_IEEE 0 CtlDeratingManager_CM_single -3.4E+38 3.4E+38
 /begin AXIS_DESCR COM_AXIS SGPP_DcLinkVoltMeas CtlDeratingManager_CM_single_V 5 -3.4E+38 3.4E+38 AXIS_PTS_REF CTDM_VoltDCOverDerate_C /end AXIS_DESCR
/end CHARACTERISTIC
/begin CHARACTERISTIC CTDM_ScaleVoltDCUnderDerate_C "DC bus undervoltage derate scale map (1.0=no derate, 0.0=full derate)" CURVE 0x0000 /* @ECU_Address@CTDM_ScaleVoltDCUnderDerate_C@ */ Record_FLOAT32_IEEE 0 CtlDeratingManager_CM_single -3.4E+38 3.4E+38
 /begin AXIS_DESCR COM_AXIS SGPP_DcLinkVoltMeas CtlDeratingManager_CM_single_V 5 -3.4E+38 3.4E+38 AXIS_PTS_REF CTDM_VoltDCUnderDerate_C /end AXIS_DESCR
/end CHARACTERISTIC
/begin CHARACTERISTIC CTDM_StallConfirmTime_C "Debounce time to confirm stall condition entry" VALUE 0x0000 /* @ECU_Address@CTDM_StallConfirmTime_C@ */ Record_FLOAT32_IEEE 0 CtlDeratingManager_CM_single 0.000000 10000.000000 /end CHARACTERISTIC
/begin CHARACTERISTIC CTDM_StallCurrentThreshold_C "Stator current amplitude threshold for stall condition detection" VALUE 0x0000 /* @ECU_Address@CTDM_StallCurrentThreshold_C@ */ Record_FLOAT32_IEEE 0 CtlDeratingManager_CM_single_Arms 0.000000 500.000000 /end CHARACTERISTIC
/begin CHARACTERISTIC CTDM_StallDerateFactor_C "Torque capability reduction factor when stall derate is active" VALUE 0x0000 /* @ECU_Address@CTDM_StallDerateFactor_C@ */ Record_FLOAT32_IEEE 0 CtlDeratingManager_CM_single_dash_ 0.000000 1.000000 /end CHARACTERISTIC
/begin CHARACTERISTIC CTDM_StallExitTime_C "Debounce time to exit stall condition" VALUE 0x0000 /* @ECU_Address@CTDM_StallExitTime_C@ */ Record_FLOAT32_IEEE 0 CtlDeratingManager_CM_single 0.000000 100000.000000 /end CHARACTERISTIC
/begin CHARACTERISTIC CTDM_StallSpeedThreshold_C "Speed threshold for stall condition detection" VALUE 0x0000 /* @ECU_Address@CTDM_StallSpeedThreshold_C@ */ Record_FLOAT32_IEEE 0 CtlDeratingManager_CM_single_rpm 0.000000 1000.000000 /end CHARACTERISTIC
/begin CHARACTERISTIC CTDM_TorqueSpRateLimit_C "Rate limit for torque setpoint after derating (Nm/s)" VALUE 0x0000 /* @ECU_Address@CTDM_TorqueSpRateLimit_C@ */ Record_FLOAT32_IEEE 0 CtlDeratingManager_CM_single_Nm_per_s 0.000000 3.4E+38 /end CHARACTERISTIC
/begin CHARACTERISTIC CTDM_TqCapabilityMaxLimit_C "Upper clipping limit for maximum torque capability" VALUE 0x0000 /* @ECU_Address@CTDM_TqCapabilityMaxLimit_C@ */ Record_FLOAT32_IEEE 0 CtlDeratingManager_CM_single_Nm 0.000000 500.000000 /end CHARACTERISTIC
/begin CHARACTERISTIC CTDM_TqCapabilityMinLimit_C "Lower clipping limit for minimum torque capability" VALUE 0x0000 /* @ECU_Address@CTDM_TqCapabilityMinLimit_C@ */ Record_FLOAT32_IEEE 0 CtlDeratingManager_CM_single_Nm -500.000000 0.000000 /end CHARACTERISTIC
/begin CHARACTERISTIC CTDM_TqVoltDerateMotoring_C "Maximum torque capability map for voltage derate in motoring operation" MAP 0x0000 /* @ECU_Address@CTDM_TqVoltDerateMotoring_C@ */ Record_FLOAT32_IEEE 0 CtlDeratingManager_CM_single_Nm -3.4E+38 3.4E+38
 /begin AXIS_DESCR COM_AXIS SGPP_DcLinkVoltMeas CtlDeratingManager_CM_single_V 5 -3.4E+38 3.4E+38 AXIS_PTS_REF CTDM_TqVoltDerateVolt_C /end AXIS_DESCR
 /begin AXIS_DESCR /* Description of Y-Axis Points */ COM_AXIS SGPP_MechSpeedAbsolute CtlDeratingManager_CM_single_rpm 10 -3.4E+38 3.4E+38 AXIS_PTS_REF CTDM_TqVoltDerateSpeed_C /end AXIS_DESCR
/end CHARACTERISTIC
/begin MEASUREMENT CTDM_DerateReason "Derate reason bitfield summary. See bit mapping in variable definition file" UWORD CtlDeratingManager_CM_uint16_dash_ 0 0 0.000000 65535.000000 ECU_ADDRESS 0x0000 /* @ECU_Address@CTDM_DerateReason@ */
 /begin IF_DATA XCP
  /begin DAQ_EVENT VARIABLE /begin DEFAULT_EVENT_LIST EVENT 0x0000 /end DEFAULT_EVENT_LIST /end DAQ_EVENT
 /end IF_DATA
/end MEASUREMENT
/begin MEASUREMENT CTDM_ScaleDerateArb "Arbitrated derate scale before rate limiter (0..1)" FLOAT32_IEEE CtlDeratingManager_CM_single_dash_ 0 0 0.000000 1.000000 ECU_ADDRESS 0x0000 /* @ECU_Address@CTDM_ScaleDerateArb@ */
 /begin IF_DATA XCP
  /begin DAQ_EVENT VARIABLE /begin DEFAULT_EVENT_LIST EVENT 0x0000 /end DEFAULT_EVENT_LIST /end DAQ_EVENT
 /end IF_DATA
/end MEASUREMENT
/begin MEASUREMENT CTDM_ScaleDerateFinal "Final derate scale after rate limiter (0..1)" FLOAT32_IEEE CtlDeratingManager_CM_single_dash_ 0 0 0.000000 1.000000 ECU_ADDRESS 0x0000 /* @ECU_Address@CTDM_ScaleDerateFinal@ */
 /begin IF_DATA XCP
  /begin DAQ_EVENT VARIABLE /begin DEFAULT_EVENT_LIST EVENT 0x0000 /end DEFAULT_EVENT_LIST /end DAQ_EVENT
 /end IF_DATA
/end MEASUREMENT
/begin MEASUREMENT CTDM_StallConditionActive "Active stall condition flag" UBYTE CtlDeratingManager_CM_uint8_dash_ 0 0 0.000000 1.000000 ECU_ADDRESS 0x0000 /* @ECU_Address@CTDM_StallConditionActive@ */
 /begin IF_DATA XCP
  /begin DAQ_EVENT VARIABLE /begin DEFAULT_EVENT_LIST EVENT 0x0000 /end DEFAULT_EVENT_LIST /end DAQ_EVENT
 /end IF_DATA
/end MEASUREMENT
/begin MEASUREMENT CTDM_StatorCurrentAmp "Stator current amplitude calculated from d-q axis currents (Is = sqrt(Id^2 + Iq^2))" FLOAT32_IEEE CtlDeratingManager_CM_single_Arms 0 0 0.000000 1000.000000 ECU_ADDRESS 0x0000 /* @ECU_Address@CTDM_StatorCurrentAmp@ */
 /begin IF_DATA XCP
  /begin DAQ_EVENT VARIABLE /begin DEFAULT_EVENT_LIST EVENT 0x0000 /end DEFAULT_EVENT_LIST /end DAQ_EVENT
 /end IF_DATA
/end MEASUREMENT
/begin MEASUREMENT CTDM_TorqueLimitNeg "Final negative torque capability limit after all derates (regen min)" FLOAT32_IEEE CtlDeratingManager_CM_single_Nm 0 0 -3.4E+38 3.4E+38 ARRAY_SIZE 1 ECU_ADDRESS 0x0000 /* @ECU_Address@CTDM_TorqueLimitNeg@ */
 /begin IF_DATA XCP
  /begin DAQ_EVENT VARIABLE /begin DEFAULT_EVENT_LIST EVENT 0x0000 /end DEFAULT_EVENT_LIST /end DAQ_EVENT
 /end IF_DATA
/end MEASUREMENT
/begin MEASUREMENT CTDM_TorqueLimitPos "Final positive torque capability limit after all derates (motoring max)" FLOAT32_IEEE CtlDeratingManager_CM_single_Nm 0 0 -3.4E+38 3.4E+38 ARRAY_SIZE 1 ECU_ADDRESS 0x0000 /* @ECU_Address@CTDM_TorqueLimitPos@ */
 /begin IF_DATA XCP
  /begin DAQ_EVENT VARIABLE /begin DEFAULT_EVENT_LIST EVENT 0x0000 /end DEFAULT_EVENT_LIST /end DAQ_EVENT
 /end IF_DATA
/end MEASUREMENT
/begin MEASUREMENT CTDM_TorqueSpLimited "Torque setpoint after derating, saturation, and rate limiter" FLOAT32_IEEE CtlDeratingManager_CM_single_Nm 0 0 -3.4E+38 3.4E+38 ECU_ADDRESS 0x0000 /* @ECU_Address@CTDM_TorqueSpLimited@ */
 /begin IF_DATA XCP
  /begin DAQ_EVENT VARIABLE /begin DEFAULT_EVENT_LIST EVENT 0x0000 /end DEFAULT_EVENT_LIST /end DAQ_EVENT
 /end IF_DATA
/end MEASUREMENT
/begin MEASUREMENT CTDM_TqVoltDerateMax "Maximum allowed torque based on voltage derate calculation" FLOAT32_IEEE CtlDeratingManager_CM_single_Nm 0 0 -500.000000 500.000000 ECU_ADDRESS 0x0000 /* @ECU_Address@CTDM_TqVoltDerateMax@ */
 /begin IF_DATA XCP
  /begin DAQ_EVENT VARIABLE /begin DEFAULT_EVENT_LIST EVENT 0x0000 /end DEFAULT_EVENT_LIST /end DAQ_EVENT
 /end IF_DATA
/end MEASUREMENT
/begin MEASUREMENT CTDM_TqVoltDerateMin "Minimum torque based on voltage derate calculation" FLOAT32_IEEE CtlDeratingManager_CM_single_Nm 0 0 -500.000000 500.000000 ECU_ADDRESS 0x0000 /* @ECU_Address@CTDM_TqVoltDerateMin@ */
 /begin IF_DATA XCP
  /begin DAQ_EVENT VARIABLE /begin DEFAULT_EVENT_LIST EVENT 0x0000 /end DEFAULT_EVENT_LIST /end DAQ_EVENT
 /end IF_DATA
/end MEASUREMENT
/begin MEASUREMENT CTDM_TqVoltDerateMotorRaw "Raw output torque from voltage derate maps for motoring operation" FLOAT32_IEEE CtlDeratingManager_CM_single_Nm 0 0 0.000000 500.000000 ECU_ADDRESS 0x0000 /* @ECU_Address@CTDM_TqVoltDerateMotorRaw@ */
 /begin IF_DATA XCP
  /begin DAQ_EVENT VARIABLE /begin DEFAULT_EVENT_LIST EVENT 0x0000 /end DEFAULT_EVENT_LIST /end DAQ_EVENT
 /end IF_DATA
/end MEASUREMENT
/begin MEASUREMENT CTLC_IdSpLimited "" FLOAT32_IEEE CtlDeratingManager_CM_single 0 0 -3.4E+38 3.4E+38 ARRAY_SIZE 1 ECU_ADDRESS 0x0000 /* @ECU_Address@CTLC_IdSpLimited@ */
 /begin IF_DATA XCP
  /begin DAQ_EVENT VARIABLE /begin DEFAULT_EVENT_LIST EVENT 0x0000 /end DEFAULT_EVENT_LIST /end DAQ_EVENT
 /end IF_DATA
/end MEASUREMENT
/begin MEASUREMENT CTLC_IqSpLimited "" FLOAT32_IEEE CtlDeratingManager_CM_single 0 0 -3.4E+38 3.4E+38 ARRAY_SIZE 1 ECU_ADDRESS 0x0000 /* @ECU_Address@CTLC_IqSpLimited@ */
 /begin IF_DATA XCP
  /begin DAQ_EVENT VARIABLE /begin DEFAULT_EVENT_LIST EVENT 0x0000 /end DEFAULT_EVENT_LIST /end DAQ_EVENT
 /end IF_DATA
/end MEASUREMENT
/begin MEASUREMENT CTSO_OperationMode "" UBYTE CtlDeratingManager_CM_uint8 0 0 0 255 ECU_ADDRESS 0x0000 /* @ECU_Address@CTSO_OperationMode@ */
 /begin IF_DATA XCP
  /begin DAQ_EVENT VARIABLE /begin DEFAULT_EVENT_LIST EVENT 0x0000 /end DEFAULT_EVENT_LIST /end DAQ_EVENT
 /end IF_DATA
/end MEASUREMENT
/begin MEASUREMENT CtlDeratingManager_DW.BareUnitDelay_DSTATE "" FLOAT32_IEEE CtlDeratingManager_CM_single 0 0 -3.4E+38 3.4E+38 ECU_ADDRESS 0x0000 /* @ECU_Address@CtlDeratingManager_DW.BareUnitDelay_DSTATE@ */
 /begin IF_DATA XCP
  /begin DAQ_EVENT VARIABLE /begin DEFAULT_EVENT_LIST EVENT 0x0000 /end DEFAULT_EVENT_LIST /end DAQ_EVENT
 /end IF_DATA
/end MEASUREMENT
/begin MEASUREMENT CtlDeratingManager_DW.Memory_PreviousInput "" UBYTE CtlDeratingManager_CM_logical 0 0 0 1 ECU_ADDRESS 0x0000 /* @ECU_Address@CtlDeratingManager_DW.Memory_PreviousInput@ */
 /begin IF_DATA XCP
  /begin DAQ_EVENT VARIABLE /begin DEFAULT_EVENT_LIST EVENT 0x0000 /end DEFAULT_EVENT_LIST /end DAQ_EVENT
 /end IF_DATA
/end MEASUREMENT
/begin MEASUREMENT CtlDeratingManager_DW.UnitDelay_DSTATE "" FLOAT32_IEEE CtlDeratingManager_CM_single 0 0 -3.4E+38 3.4E+38 ECU_ADDRESS 0x0000 /* @ECU_Address@CtlDeratingManager_DW.UnitDelay_DSTATE@ */
 /begin IF_DATA XCP
  /begin DAQ_EVENT VARIABLE /begin DEFAULT_EVENT_LIST EVENT 0x0000 /end DEFAULT_EVENT_LIST /end DAQ_EVENT
 /end IF_DATA
/end MEASUREMENT
/begin MEASUREMENT CtlDeratingManager_DW.UnitDelay_DSTATE_p "" UBYTE CtlDeratingManager_CM_uint8 0 0 0 255 ECU_ADDRESS 0x0000 /* @ECU_Address@CtlDeratingManager_DW.UnitDelay_DSTATE_p@ */
 /begin IF_DATA XCP
  /begin DAQ_EVENT VARIABLE /begin DEFAULT_EVENT_LIST EVENT 0x0000 /end DEFAULT_EVENT_LIST /end DAQ_EVENT
 /end IF_DATA
/end MEASUREMENT
/begin MEASUREMENT SGPP_DcLinkVoltMeas "" FLOAT32_IEEE CtlDeratingManager_CM_single 0 0 -3.4E+38 3.4E+38 ECU_ADDRESS 0x0000 /* @ECU_Address@SGPP_DcLinkVoltMeas@ */
 /begin IF_DATA XCP
  /begin DAQ_EVENT VARIABLE /begin DEFAULT_EVENT_LIST EVENT 0x0000 /end DEFAULT_EVENT_LIST /end DAQ_EVENT
 /end IF_DATA
/end MEASUREMENT
/begin MEASUREMENT SGPP_MechSpeed "" FLOAT32_IEEE CtlDeratingManager_CM_single 0 0 -3.4E+38 3.4E+38 ECU_ADDRESS 0x0000 /* @ECU_Address@SGPP_MechSpeed@ */
 /begin IF_DATA XCP
  /begin DAQ_EVENT VARIABLE /begin DEFAULT_EVENT_LIST EVENT 0x0000 /end DEFAULT_EVENT_LIST /end DAQ_EVENT
 /end IF_DATA
/end MEASUREMENT
/begin MEASUREMENT SGPP_MechSpeedAbsolute "" FLOAT32_IEEE CtlDeratingManager_CM_single 0 0 -3.4E+38 3.4E+38 ARRAY_SIZE 1 ECU_ADDRESS 0x0000 /* @ECU_Address@SGPP_MechSpeedAbsolute@ */
 /begin IF_DATA XCP
  /begin DAQ_EVENT VARIABLE /begin DEFAULT_EVENT_LIST EVENT 0x0000 /end DEFAULT_EVENT_LIST /end DAQ_EVENT
 /end IF_DATA
/end MEASUREMENT
/begin MEASUREMENT SGPP_MotorTemp1 "" FLOAT32_IEEE CtlDeratingManager_CM_single 0 0 -3.4E+38 3.4E+38 ECU_ADDRESS 0x0000 /* @ECU_Address@SGPP_MotorTemp1@ */
 /begin IF_DATA XCP
  /begin DAQ_EVENT VARIABLE /begin DEFAULT_EVENT_LIST EVENT 0x0000 /end DEFAULT_EVENT_LIST /end DAQ_EVENT
 /end IF_DATA
/end MEASUREMENT
/begin MEASUREMENT SGPP_SampleTime2 "" FLOAT32_IEEE CtlDeratingManager_CM_single 0 0 -3.4E+38 3.4E+38 ECU_ADDRESS 0x0000 /* @ECU_Address@SGPP_SampleTime2@ */
 /begin IF_DATA XCP
  /begin DAQ_EVENT VARIABLE /begin DEFAULT_EVENT_LIST EVENT 0x0000 /end DEFAULT_EVENT_LIST /end DAQ_EVENT
 /end IF_DATA
/end MEASUREMENT
/begin MEASUREMENT SGPP_SwitchTempMax "" FLOAT32_IEEE CtlDeratingManager_CM_single 0 0 -3.4E+38 3.4E+38 ECU_ADDRESS 0x0000 /* @ECU_Address@SGPP_SwitchTempMax@ */
 /begin IF_DATA XCP
  /begin DAQ_EVENT VARIABLE /begin DEFAULT_EVENT_LIST EVENT 0x0000 /end DEFAULT_EVENT_LIST /end DAQ_EVENT
 /end IF_DATA
/end MEASUREMENT
/begin MEASUREMENT SGSA_TorqueCommand "" FLOAT32_IEEE CtlDeratingManager_CM_single 0 0 -3.4E+38 3.4E+38 ECU_ADDRESS 0x0000 /* @ECU_Address@SGSA_TorqueCommand@ */
 /begin IF_DATA XCP
  /begin DAQ_EVENT VARIABLE /begin DEFAULT_EVENT_LIST EVENT 0x0000 /end DEFAULT_EVENT_LIST /end DAQ_EVENT
 /end IF_DATA
/end MEASUREMENT
/begin AXIS_PTS CTDM_AxisJunctionTempDerate_C "Junction temperature axis breakpoints for torque derate (switch module temperature)" 0x0000 /* @ECU_Address@CTDM_AxisJunctionTempDerate_C@ */ NO_INPUT_QUANTITY Axis_FLOAT32_IEEE 0 CtlDeratingManager_CM_single_degC 10 -3.4E+38 3.4E+38 /end AXIS_PTS
/begin AXIS_PTS CTDM_AxisMotorTempDerate_C "Motor winding temperature axis breakpoints for torque derate" 0x0000 /* @ECU_Address@CTDM_AxisMotorTempDerate_C@ */ NO_INPUT_QUANTITY Axis_FLOAT32_IEEE 0 CtlDeratingManager_CM_single_degC 10 -3.4E+38 3.4E+38 /end AXIS_PTS
/begin AXIS_PTS CTDM_SpeedOverDerate_C "Mechanical speed axis breakpoints for overspeed torque derate" 0x0000 /* @ECU_Address@CTDM_SpeedOverDerate_C@ */ NO_INPUT_QUANTITY Axis_FLOAT32_IEEE 0 CtlDeratingManager_CM_single_rpm 10 -3.4E+38 3.4E+38 /end AXIS_PTS
/begin AXIS_PTS CTDM_TqVoltDerateSpeed_C "Speed axis breakpoints for voltage derate torque capability lookup table" 0x0000 /* @ECU_Address@CTDM_TqVoltDerateSpeed_C@ */ NO_INPUT_QUANTITY Axis_FLOAT32_IEEE 0 CtlDeratingManager_CM_single_rpm 10 -3.4E+38 3.4E+38 /end AXIS_PTS
/begin AXIS_PTS CTDM_TqVoltDerateVolt_C "Voltage axis breakpoints for voltage derate torque capability lookup table" 0x0000 /* @ECU_Address@CTDM_TqVoltDerateVolt_C@ */ NO_INPUT_QUANTITY Axis_FLOAT32_IEEE 0 CtlDeratingManager_CM_single_V 5 -3.4E+38 3.4E+38 /end AXIS_PTS
/begin AXIS_PTS CTDM_VoltDCOverDerate_C "DC bus overvoltage axis breakpoints for derate scale" 0x0000 /* @ECU_Address@CTDM_VoltDCOverDerate_C@ */ NO_INPUT_QUANTITY Axis_FLOAT32_IEEE 0 CtlDeratingManager_CM_single_V 5 -3.4E+38 3.4E+38 /end AXIS_PTS
/begin AXIS_PTS CTDM_VoltDCUnderDerate_C "DC bus undervoltage axis breakpoints for derate scale (ascending storage)" 0x0000 /* @ECU_Address@CTDM_VoltDCUnderDerate_C@ */ NO_INPUT_QUANTITY Axis_FLOAT32_IEEE 0 CtlDeratingManager_CM_single_V 5 -3.4E+38 3.4E+38 /end AXIS_PTS
/begin COMPU_METHOD CtlDeratingManager_CM_logical "Q = V" RAT_FUNC "%1.0" "" COEFFS 0 1 0 0 0 1 /end COMPU_METHOD
/begin COMPU_METHOD CtlDeratingManager_CM_single "Q = V" RAT_FUNC "%8.6" "" COEFFS 0 1 0 0 0 1 /end COMPU_METHOD
/begin COMPU_METHOD CtlDeratingManager_CM_single_1_per_s "Q = V" RAT_FUNC "%8.6" "1/s" COEFFS 0 1 0 0 0 1 /end COMPU_METHOD
/begin COMPU_METHOD CtlDeratingManager_CM_single_Arms "Q = V" RAT_FUNC "%8.6" "Arms" COEFFS 0 1 0 0 0 1 /end COMPU_METHOD
/begin COMPU_METHOD CtlDeratingManager_CM_single_Nm "Q = V" RAT_FUNC "%8.6" "Nm" COEFFS 0 1 0 0 0 1 /end COMPU_METHOD
/begin COMPU_METHOD CtlDeratingManager_CM_single_Nm_per_s "Q = V" RAT_FUNC "%8.6" "Nm/s" COEFFS 0 1 0 0 0 1 /end COMPU_METHOD
/begin COMPU_METHOD CtlDeratingManager_CM_single_V "Q = V" RAT_FUNC "%8.6" "V" COEFFS 0 1 0 0 0 1 /end COMPU_METHOD
/begin COMPU_METHOD CtlDeratingManager_CM_single_dash_ "Q = V" RAT_FUNC "%8.6" "-" COEFFS 0 1 0 0 0 1 /end COMPU_METHOD
/begin COMPU_METHOD CtlDeratingManager_CM_single_degC "Q = V" RAT_FUNC "%8.6" "degC" COEFFS 0 1 0 0 0 1 /end COMPU_METHOD
/begin COMPU_METHOD CtlDeratingManager_CM_single_rpm "Q = V" RAT_FUNC "%8.6" "rpm" COEFFS 0 1 0 0 0 1 /end COMPU_METHOD
/begin COMPU_METHOD CtlDeratingManager_CM_uint16_dash_ "Q = V" RAT_FUNC "%5.0" "-" COEFFS 0 1 0 0 0 1 /end COMPU_METHOD
/begin COMPU_METHOD CtlDeratingManager_CM_uint8 "Q = V" RAT_FUNC "%3.0" "" COEFFS 0 1 0 0 0 1 /end COMPU_METHOD
/begin COMPU_METHOD CtlDeratingManager_CM_uint8_dash_ "Q = V" RAT_FUNC "%3.0" "-" COEFFS 0 1 0 0 0 1 /end COMPU_METHOD
/begin RECORD_LAYOUT Record_BOOLEAN FNC_VALUES 1 UBYTE COLUMN_DIR DIRECT /end RECORD_LAYOUT
/begin RECORD_LAYOUT Record_FLOAT32_IEEE FNC_VALUES 1 FLOAT32_IEEE COLUMN_DIR DIRECT /end RECORD_LAYOUT
/begin RECORD_LAYOUT Record_UBYTE FNC_VALUES 1 UBYTE COLUMN_DIR DIRECT /end RECORD_LAYOUT
/begin RECORD_LAYOUT Record_UWORD FNC_VALUES 1 UWORD COLUMN_DIR DIRECT /end RECORD_LAYOUT
/* Record Layouts for Lookup Tables in Standard Axis format */
/begin RECORD_LAYOUT Axis_FLOAT32_IEEE AXIS_PTS_X 1 FLOAT32_IEEE INDEX_INCR DIRECT /end RECORD_LAYOUT
/begin GROUP CtlDeratingManager "CtlDeratingManager" /* Root */ ROOT /begin SUB_GROUP CtlDeratingManager_CTDM_Derating_1ms_sys /end SUB_GROUP
 /begin REF_MEASUREMENT CTLC_IdSpLimited CTLC_IqSpLimited CTSO_OperationMode SGPP_DcLinkVoltMeas SGPP_MechSpeed SGPP_MechSpeedAbsolute SGPP_MotorTemp1 SGPP_SampleTime2 SGPP_SwitchTempMax SGSA_TorqueCommand /end REF_MEASUREMENT
/end GROUP
/begin GROUP CtlDeratingManager_CTDM_Derating_1ms_sys "CtlDeratingManager/CTDM_Derating_1ms_sys"
 /begin SUB_GROUP CtlDeratingManager_CTDM_Derating_1ms_sys_DeratingArbitration CtlDeratingManager_CTDM_Derating_1ms_sys_SpeedDerating CtlDeratingManager_CTDM_Derating_1ms_sys_StallDerating CtlDeratingManager_CTDM_Derating_1ms_sys_ThermalDerating CtlDeratingManager_CTDM_Derating_1ms_sys_TorqueCapabilityMap CtlDeratingManager_CTDM_Derating_1ms_sys_TorqueCommandLimiter CtlDeratingManager_CTDM_Derating_1ms_sys_UdcDerating /end SUB_GROUP
/end GROUP
/begin GROUP CtlDeratingManager_CTDM_Derating_1ms_sys_DeratingArbitration "CtlDeratingManager/CTDM_Derating_1ms_sys/DeratingArbitration"
 /begin SUB_GROUP CtlDeratingManager_CTDM_Derating_1ms_sys_DeratingArbitration_Local_Variable_Storage1 CtlDeratingManager_CTDM_Derating_1ms_sys_DeratingArbitration_Local_Variable_Storage3 CtlDeratingManager_CTDM_Derating_1ms_sys_DeratingArbitration_Subsystem /end SUB_GROUP
/end GROUP
/begin GROUP CtlDeratingManager_CTDM_Derating_1ms_sys_DeratingArbitration_Local_Variable_Storage1 "CtlDeratingManager/CTDM_Derating_1ms_sys/DeratingArbitration/Local Variable Storage1" /begin REF_MEASUREMENT CTDM_ScaleDerateArb /end REF_MEASUREMENT /end GROUP
/begin GROUP CtlDeratingManager_CTDM_Derating_1ms_sys_DeratingArbitration_Local_Variable_Storage3 "CtlDeratingManager/CTDM_Derating_1ms_sys/DeratingArbitration/Local Variable Storage3" /begin REF_MEASUREMENT CTDM_ScaleDerateFinal /end REF_MEASUREMENT /end GROUP
/begin GROUP CtlDeratingManager_CTDM_Derating_1ms_sys_DeratingArbitration_Subsystem "CtlDeratingManager/CTDM_Derating_1ms_sys/DeratingArbitration/Subsystem"
 /begin SUB_GROUP CtlDeratingManager_CTDM_Derating_1ms_sys_DeratingArbitration_Subsystem_Parameter1 CtlDeratingManager_CTDM_Derating_1ms_sys_DeratingArbitration_Subsystem_Parameter2 CtlDeratingManager_CTDM_Derating_1ms_sys_DeratingArbitration_Subsystem_RateLimiter /end SUB_GROUP
/end GROUP
/begin GROUP CtlDeratingManager_CTDM_Derating_1ms_sys_DeratingArbitration_Subsystem_Parameter1 "CtlDeratingManager/CTDM_Derating_1ms_sys/DeratingArbitration/Subsystem/Parameter1" /begin REF_CHARACTERISTIC CTDM_ScaleRateUp_C /end REF_CHARACTERISTIC /end GROUP
/begin GROUP CtlDeratingManager_CTDM_Derating_1ms_sys_DeratingArbitration_Subsystem_Parameter2 "CtlDeratingManager/CTDM_Derating_1ms_sys/DeratingArbitration/Subsystem/Parameter2" /begin REF_CHARACTERISTIC CTDM_ScaleRateDown_C /end REF_CHARACTERISTIC /end GROUP
/begin GROUP CtlDeratingManager_CTDM_Derating_1ms_sys_DeratingArbitration_Subsystem_RateLimiter "CtlDeratingManager/CTDM_Derating_1ms_sys/DeratingArbitration/Subsystem/RateLimiter" /begin REF_MEASUREMENT CtlDeratingManager_DW.UnitDelay_DSTATE SGPP_SampleTime2 /end REF_MEASUREMENT /end GROUP
/begin GROUP CtlDeratingManager_CTDM_Derating_1ms_sys_SpeedDerating "CtlDeratingManager/CTDM_Derating_1ms_sys/SpeedDerating"
 /begin SUB_GROUP CtlDeratingManager_CTDM_Derating_1ms_sys_SpeedDerating_Parameter3 CtlDeratingManager_CTDM_Derating_1ms_sys_SpeedDerating_SpeedOVDeratLUT /end SUB_GROUP
/end GROUP
/begin GROUP CtlDeratingManager_CTDM_Derating_1ms_sys_SpeedDerating_Parameter3 "CtlDeratingManager/CTDM_Derating_1ms_sys/SpeedDerating/Parameter3" /begin REF_CHARACTERISTIC CTDM_EnSpeedOverDerate_C /end REF_CHARACTERISTIC /end GROUP
/begin GROUP CtlDeratingManager_CTDM_Derating_1ms_sys_SpeedDerating_SpeedOVDeratLUT "CtlDeratingManager/CTDM_Derating_1ms_sys/SpeedDerating/SpeedOVDeratLUT" /begin REF_CHARACTERISTIC CTDM_ScaleSpeedOverDerate_C CTDM_SpeedOverDerate_C /end REF_CHARACTERISTIC /begin REF_MEASUREMENT SGPP_MechSpeed /end REF_MEASUREMENT /end GROUP
/begin GROUP CtlDeratingManager_CTDM_Derating_1ms_sys_StallDerating "CtlDeratingManager/CTDM_Derating_1ms_sys/StallDerating"
 /begin SUB_GROUP CtlDeratingManager_CTDM_Derating_1ms_sys_StallDerating_Debounce CtlDeratingManager_CTDM_Derating_1ms_sys_StallDerating_IAmpCal CtlDeratingManager_CTDM_Derating_1ms_sys_StallDerating_Local_Variable_Storage3 CtlDeratingManager_CTDM_Derating_1ms_sys_StallDerating_Parameter1 CtlDeratingManager_CTDM_Derating_1ms_sys_StallDerating_Parameter2 CtlDeratingManager_CTDM_Derating_1ms_sys_StallDerating_Parameter3 CtlDeratingManager_CTDM_Derating_1ms_sys_StallDerating_Parameter4 /end SUB_GROUP
 /begin REF_MEASUREMENT CtlDeratingManager_DW.UnitDelay_DSTATE_p SGPP_MechSpeedAbsolute /end REF_MEASUREMENT
/end GROUP
/begin GROUP CtlDeratingManager_CTDM_Derating_1ms_sys_StallDerating_Debounce "CtlDeratingManager/CTDM_Derating_1ms_sys/StallDerating/Debounce"
 /begin SUB_GROUP CtlDeratingManager_CTDM_Derating_1ms_sys_StallDerating_Debounce_Subsystem CtlDeratingManager_CTDM_Derating_1ms_sys_StallDerating_Debounce_UnitDelay /end SUB_GROUP
/end GROUP
/begin GROUP CtlDeratingManager_CTDM_Derating_1ms_sys_StallDerating_Debounce_Subsystem "CtlDeratingManager/CTDM_Derating_1ms_sys/StallDerating/Debounce/Subsystem" /begin REF_MEASUREMENT CtlDeratingManager_DW.Memory_PreviousInput /end REF_MEASUREMENT /end GROUP
/begin GROUP CtlDeratingManager_CTDM_Derating_1ms_sys_StallDerating_Debounce_UnitDelay "CtlDeratingManager/CTDM_Derating_1ms_sys/StallDerating/Debounce/UnitDelay" /begin REF_MEASUREMENT CtlDeratingManager_DW.BareUnitDelay_DSTATE /end REF_MEASUREMENT /end GROUP
/begin GROUP CtlDeratingManager_CTDM_Derating_1ms_sys_StallDerating_IAmpCal "CtlDeratingManager/CTDM_Derating_1ms_sys/StallDerating/IAmpCal"
 /begin SUB_GROUP CtlDeratingManager_CTDM_Derating_1ms_sys_StallDerating_IAmpCal_Local_Variable_Storage3 /end SUB_GROUP
 /begin REF_MEASUREMENT CTLC_IdSpLimited CTLC_IqSpLimited /end REF_MEASUREMENT
/end GROUP
/begin GROUP CtlDeratingManager_CTDM_Derating_1ms_sys_StallDerating_IAmpCal_Local_Variable_Storage3 "CtlDeratingManager/CTDM_Derating_1ms_sys/StallDerating/IAmpCal/Local Variable Storage3" /begin REF_MEASUREMENT CTDM_StatorCurrentAmp /end REF_MEASUREMENT /end GROUP
/begin GROUP CtlDeratingManager_CTDM_Derating_1ms_sys_StallDerating_Local_Variable_Storage3 "CtlDeratingManager/CTDM_Derating_1ms_sys/StallDerating/Local Variable Storage3" /begin REF_MEASUREMENT CTDM_StallConditionActive /end REF_MEASUREMENT /end GROUP
/begin GROUP CtlDeratingManager_CTDM_Derating_1ms_sys_StallDerating_Parameter1 "CtlDeratingManager/CTDM_Derating_1ms_sys/StallDerating/Parameter1" /begin REF_CHARACTERISTIC CTDM_StallSpeedThreshold_C /end REF_CHARACTERISTIC /end GROUP
/begin GROUP CtlDeratingManager_CTDM_Derating_1ms_sys_StallDerating_Parameter2 "CtlDeratingManager/CTDM_Derating_1ms_sys/StallDerating/Parameter2" /begin REF_CHARACTERISTIC CTDM_StallCurrentThreshold_C /end REF_CHARACTERISTIC /end GROUP
/begin GROUP CtlDeratingManager_CTDM_Derating_1ms_sys_StallDerating_Parameter3 "CtlDeratingManager/CTDM_Derating_1ms_sys/StallDerating/Parameter3" /begin REF_CHARACTERISTIC CTDM_StallConfirmTime_C /end REF_CHARACTERISTIC /end GROUP
/begin GROUP CtlDeratingManager_CTDM_Derating_1ms_sys_StallDerating_Parameter4 "CtlDeratingManager/CTDM_Derating_1ms_sys/StallDerating/Parameter4" /begin REF_CHARACTERISTIC CTDM_StallExitTime_C /end REF_CHARACTERISTIC /end GROUP
/begin GROUP CtlDeratingManager_CTDM_Derating_1ms_sys_ThermalDerating "CtlDeratingManager/CTDM_Derating_1ms_sys/ThermalDerating"
 /begin SUB_GROUP CtlDeratingManager_CTDM_Derating_1ms_sys_ThermalDerating_MotorTempDeratLUT CtlDeratingManager_CTDM_Derating_1ms_sys_ThermalDerating_Parameter1 CtlDeratingManager_CTDM_Derating_1ms_sys_ThermalDerating_Parameter3 CtlDeratingManager_CTDM_Derating_1ms_sys_ThermalDerating_SwitchTempDeratLUT /end SUB_GROUP
/end GROUP
/begin GROUP CtlDeratingManager_CTDM_Derating_1ms_sys_ThermalDerating_MotorTempDeratLUT "CtlDeratingManager/CTDM_Derating_1ms_sys/ThermalDerating/MotorTempDeratLUT" /begin REF_CHARACTERISTIC CTDM_AxisMotorTempDerate_C CTDM_ScaleMotorTempDerate_C /end REF_CHARACTERISTIC /begin REF_MEASUREMENT SGPP_MotorTemp1 /end REF_MEASUREMENT /end GROUP
/begin GROUP CtlDeratingManager_CTDM_Derating_1ms_sys_ThermalDerating_Parameter1 "CtlDeratingManager/CTDM_Derating_1ms_sys/ThermalDerating/Parameter1" /begin REF_CHARACTERISTIC CTDM_EnMotorTempDerate_C /end REF_CHARACTERISTIC /end GROUP
/begin GROUP CtlDeratingManager_CTDM_Derating_1ms_sys_ThermalDerating_Parameter3 "CtlDeratingManager/CTDM_Derating_1ms_sys/ThermalDerating/Parameter3" /begin REF_CHARACTERISTIC CTDM_EnJunctionTempDerate_C /end REF_CHARACTERISTIC /end GROUP
/begin GROUP CtlDeratingManager_CTDM_Derating_1ms_sys_ThermalDerating_SwitchTempDeratLUT "CtlDeratingManager/CTDM_Derating_1ms_sys/ThermalDerating/SwitchTempDeratLUT"
 /begin REF_CHARACTERISTIC CTDM_AxisJunctionTempDerate_C CTDM_ScaleJunctionTempDerate_C /end REF_CHARACTERISTIC
 /begin REF_MEASUREMENT SGPP_SwitchTempMax /end REF_MEASUREMENT
/end GROUP
/begin GROUP CtlDeratingManager_CTDM_Derating_1ms_sys_TorqueCapabilityMap "CtlDeratingManager/CTDM_Derating_1ms_sys/TorqueCapabilityMap"
 /begin SUB_GROUP CtlDeratingManager_CTDM_Derating_1ms_sys_TorqueCapabilityMap_Local_Variable_Storage1 CtlDeratingManager_CTDM_Derating_1ms_sys_TorqueCapabilityMap_Local_Variable_Storage3 CtlDeratingManager_CTDM_Derating_1ms_sys_TorqueCapabilityMap_Parameter1 CtlDeratingManager_CTDM_Derating_1ms_sys_TorqueCapabilityMap_Parameter10 CtlDeratingManager_CTDM_Derating_1ms_sys_TorqueCapabilityMap_Parameter2 CtlDeratingManager_CTDM_Derating_1ms_sys_TorqueCapabilityMap_TorqueCapLUT /end SUB_GROUP
/end GROUP
/begin GROUP CtlDeratingManager_CTDM_Derating_1ms_sys_TorqueCapabilityMap_Local_Variable_Storage1 "CtlDeratingManager/CTDM_Derating_1ms_sys/TorqueCapabilityMap/Local Variable Storage1" /begin REF_MEASUREMENT CTDM_TqVoltDerateMin /end REF_MEASUREMENT /end GROUP
/begin GROUP CtlDeratingManager_CTDM_Derating_1ms_sys_TorqueCapabilityMap_Local_Variable_Storage3 "CtlDeratingManager/CTDM_Derating_1ms_sys/TorqueCapabilityMap/Local Variable Storage3" /begin REF_MEASUREMENT CTDM_TqVoltDerateMax /end REF_MEASUREMENT /end GROUP
/begin GROUP CtlDeratingManager_CTDM_Derating_1ms_sys_TorqueCapabilityMap_Parameter1 "CtlDeratingManager/CTDM_Derating_1ms_sys/TorqueCapabilityMap/Parameter1" /begin REF_CHARACTERISTIC CTDM_StallDerateFactor_C /end REF_CHARACTERISTIC /end GROUP
/begin GROUP CtlDeratingManager_CTDM_Derating_1ms_sys_TorqueCapabilityMap_Parameter10 "CtlDeratingManager/CTDM_Derating_1ms_sys/TorqueCapabilityMap/Parameter10" /begin REF_CHARACTERISTIC CTDM_TqCapabilityMinLimit_C /end REF_CHARACTERISTIC /end GROUP
/begin GROUP CtlDeratingManager_CTDM_Derating_1ms_sys_TorqueCapabilityMap_Parameter2 "CtlDeratingManager/CTDM_Derating_1ms_sys/TorqueCapabilityMap/Parameter2" /begin REF_CHARACTERISTIC CTDM_TqCapabilityMaxLimit_C /end REF_CHARACTERISTIC /end GROUP
/begin GROUP CtlDeratingManager_CTDM_Derating_1ms_sys_TorqueCapabilityMap_TorqueCapLUT "CtlDeratingManager/CTDM_Derating_1ms_sys/TorqueCapabilityMap/TorqueCapLUT"
 /begin SUB_GROUP CtlDeratingManager_CTDM_Derating_1ms_sys_TorqueCapabilityMap_TorqueCapLUT_Local_Variable_Storage3 /end SUB_GROUP
 /begin REF_CHARACTERISTIC CTDM_TqVoltDerateMotoring_C CTDM_TqVoltDerateSpeed_C CTDM_TqVoltDerateVolt_C /end REF_CHARACTERISTIC
 /begin REF_MEASUREMENT SGPP_DcLinkVoltMeas SGPP_MechSpeedAbsolute /end REF_MEASUREMENT
/end GROUP
/begin GROUP CtlDeratingManager_CTDM_Derating_1ms_sys_TorqueCapabilityMap_TorqueCapLUT_Local_Variable_Storage3 "CtlDeratingManager/CTDM_Derating_1ms_sys/TorqueCapabilityMap/TorqueCapLUT/Local Variable Storage3" /begin REF_MEASUREMENT CTDM_TqVoltDerateMotorRaw /end REF_MEASUREMENT /end GROUP
/begin GROUP CtlDeratingManager_CTDM_Derating_1ms_sys_TorqueCommandLimiter "CtlDeratingManager/CTDM_Derating_1ms_sys/TorqueCommandLimiter"
 /begin SUB_GROUP CtlDeratingManager_CTDM_Derating_1ms_sys_TorqueCommandLimiter_Parameter1 CtlDeratingManager_CTDM_Derating_1ms_sys_TorqueCommandLimiter_RateLimiter CtlDeratingManager_CTDM_Derating_1ms_sys_TorqueCommandLimiter_Saturation_Dynamic /end SUB_GROUP
/end GROUP
/begin GROUP CtlDeratingManager_CTDM_Derating_1ms_sys_TorqueCommandLimiter_Parameter1 "CtlDeratingManager/CTDM_Derating_1ms_sys/TorqueCommandLimiter/Parameter1" /begin REF_CHARACTERISTIC CTDM_TorqueSpRateLimit_C /end REF_CHARACTERISTIC /end GROUP
/begin GROUP CtlDeratingManager_CTDM_Derating_1ms_sys_TorqueCommandLimiter_RateLimiter "CtlDeratingManager/CTDM_Derating_1ms_sys/TorqueCommandLimiter/RateLimiter" /begin REF_MEASUREMENT SGPP_SampleTime2 /end REF_MEASUREMENT /end GROUP
/begin GROUP CtlDeratingManager_CTDM_Derating_1ms_sys_TorqueCommandLimiter_Saturation_Dynamic "CtlDeratingManager/CTDM_Derating_1ms_sys/TorqueCommandLimiter/Saturation
Dynamic" /begin REF_MEASUREMENT SGSA_TorqueCommand /end REF_MEASUREMENT /end GROUP
/begin GROUP CtlDeratingManager_CTDM_Derating_1ms_sys_UdcDerating "CtlDeratingManager/CTDM_Derating_1ms_sys/UdcDerating"
 /begin SUB_GROUP CtlDeratingManager_CTDM_Derating_1ms_sys_UdcDerating_Parameter1 CtlDeratingManager_CTDM_Derating_1ms_sys_UdcDerating_Parameter3 CtlDeratingManager_CTDM_Derating_1ms_sys_UdcDerating_UdcOVDeratLUT CtlDeratingManager_CTDM_Derating_1ms_sys_UdcDerating_UdcUVDeratLUT /end SUB_GROUP
 /begin REF_MEASUREMENT CTSO_OperationMode /end REF_MEASUREMENT
/end GROUP
/begin GROUP CtlDeratingManager_CTDM_Derating_1ms_sys_UdcDerating_Parameter1 "CtlDeratingManager/CTDM_Derating_1ms_sys/UdcDerating/Parameter1" /begin REF_CHARACTERISTIC CTDM_EnVoltDCUnderDerate_C /end REF_CHARACTERISTIC /end GROUP
/begin GROUP CtlDeratingManager_CTDM_Derating_1ms_sys_UdcDerating_Parameter3 "CtlDeratingManager/CTDM_Derating_1ms_sys/UdcDerating/Parameter3" /begin REF_CHARACTERISTIC CTDM_EnVoltDCOverDerate_C /end REF_CHARACTERISTIC /end GROUP
/begin GROUP CtlDeratingManager_CTDM_Derating_1ms_sys_UdcDerating_UdcOVDeratLUT "CtlDeratingManager/CTDM_Derating_1ms_sys/UdcDerating/UdcOVDeratLUT" /begin REF_CHARACTERISTIC CTDM_ScaleVoltDCOverDerate_C CTDM_VoltDCOverDerate_C /end REF_CHARACTERISTIC /begin REF_MEASUREMENT SGPP_DcLinkVoltMeas /end REF_MEASUREMENT /end GROUP
/begin GROUP CtlDeratingManager_CTDM_Derating_1ms_sys_UdcDerating_UdcUVDeratLUT "CtlDeratingManager/CTDM_Derating_1ms_sys/UdcDerating/UdcUVDeratLUT" /begin REF_CHARACTERISTIC CTDM_ScaleVoltDCUnderDerate_C CTDM_VoltDCUnderDerate_C /end REF_CHARACTERISTIC /begin REF_MEASUREMENT SGPP_DcLinkVoltMeas /end REF_MEASUREMENT /end GROUP
/end MODULE
/end PROJECT
/* (add any file trailer comments here) */
/* EOF CtlDeratingManager.a2l*/
