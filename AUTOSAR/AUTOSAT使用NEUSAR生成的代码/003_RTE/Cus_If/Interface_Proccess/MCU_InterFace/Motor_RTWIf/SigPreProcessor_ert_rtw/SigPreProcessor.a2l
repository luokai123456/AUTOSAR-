/******************************************************************************
* ASAP2 file: SigPreProcessor.a2l
* Code generation for model "SigPreProcessor".
* Model version : 1.363
* Simulink Coder version : 10.6 R2022b
* C source code generated on : Fri Sep 18 14:20:37 2026
* Target selection: ert.tlc
* Embedded hardware selection: Infineon->TriCore
* Code generation objectives: Unspecified
* Validation result: Not run
* (add additional file header information here)
******************************************************************************/ ASAP2_VERSION 1 71
/* Version 1.71 */
/begin PROJECT ProjectName "Project Comment Goes Here"
/begin HEADER "Header Comments go here" /end HEADER
/begin MODULE ModuleName "Module Comment Goes Here"
/begin MOD_PAR "MOD PAR Comment Goes Here" /end MOD_PAR
/begin MOD_COMMON "Mod Common Comment Here" BYTE_ORDER MSB_LAST ALIGNMENT_BYTE 1 ALIGNMENT_WORD 2 ALIGNMENT_LONG 4 ALIGNMENT_FLOAT32_IEEE 4 ALIGNMENT_FLOAT64_IEEE 8 ALIGNMENT_INT64 8 /end MOD_COMMON
/begin CHARACTERISTIC SGPP_AngleSourceSelect_C "Angle source selection for control mode" VALUE 0x0000 /* @ECU_Address@SGPP_AngleSourceSelect_C@ */ Record_UBYTE 0 SigPreProcessor_CM_uint8_dash_ 0.000000 255.000000 /end CHARACTERISTIC
/begin CHARACTERISTIC SGPP_IgnitionStatusSource_C "Ignition status source: 0=communication, 1=parameter" VALUE 0x0000 /* @ECU_Address@SGPP_IgnitionStatusSource_C@ */ Record_UBYTE 0 SigPreProcessor_CM_uint8_dash_ 0.000000 1.000000 /end CHARACTERISTIC
/begin CHARACTERISTIC SGPP_IgnitionStatus_C "Ignition status parameter value" VALUE 0x0000 /* @ECU_Address@SGPP_IgnitionStatus_C@ */ Record_UBYTE 0 SigPreProcessor_CM_uint8_dash_ 0.000000 1.000000 /end CHARACTERISTIC
/begin CHARACTERISTIC SGPP_IgnitionVoltThrHigh_C "Ignition voltage high threshold for debouncing" VALUE 0x0000 /* @ECU_Address@SGPP_IgnitionVoltThrHigh_C@ */ Record_UBYTE 0 SigPreProcessor_CM_uint8_dash_ 0.000000 255.000000 /end CHARACTERISTIC
/begin CHARACTERISTIC SGPP_IgnitionVoltThreshold_C "Ignition signal debounce threshold" VALUE 0x0000 /* @ECU_Address@SGPP_IgnitionVoltThreshold_C@ */ Record_UBYTE 0 SigPreProcessor_CM_uint8_dash_ 0.000000 255.000000 /end CHARACTERISTIC
/begin CHARACTERISTIC SGPP_MechSpeedFilterFreq_C "Mechanical speed filter cutoff frequency" VALUE 0x0000 /* @ECU_Address@SGPP_MechSpeedFilterFreq_C@ */ Record_FLOAT32_IEEE 0 SigPreProcessor_CM_single_rad_per_s -3.4E+38 3.4E+38 /end CHARACTERISTIC
/begin CHARACTERISTIC SGPP_PhaseMappingConfig_C "Phase sequence remapping configuration (0-5)" VALUE 0x0000 /* @ECU_Address@SGPP_PhaseMappingConfig_C@ */ Record_UBYTE 0 SigPreProcessor_CM_uint8_dash_ 0.000000 5.000000 /end CHARACTERISTIC
/begin CHARACTERISTIC SGPP_PolePairs_C "Motor pole pair configuration value" VALUE 0x0000 /* @ECU_Address@SGPP_PolePairs_C@ */ Record_UBYTE 0 SigPreProcessor_CM_uint8_dash_ 0.000000 100.000000 /end CHARACTERISTIC
/begin CHARACTERISTIC SGPP_ResolverFaultClrEnable_C "Angle source selection for control mode" VALUE 0x0000 /* @ECU_Address@SGPP_ResolverFaultClrEnable_C@ */ Record_UBYTE 0 SigPreProcessor_CM_uint8_dash_ 0.000000 255.000000 /end CHARACTERISTIC
/begin CHARACTERISTIC SGPP_ResolverPolePairs_C "Resolver pole pair configuration value" VALUE 0x0000 /* @ECU_Address@SGPP_ResolverPolePairs_C@ */ Record_UBYTE 0 SigPreProcessor_CM_uint8_dash_ 0.000000 100.000000 /end CHARACTERISTIC
/begin CHARACTERISTIC SGPP_SetSpeed_C "" VALUE 0x0000 /* @ECU_Address@SGPP_SetSpeed_C@ */ Record_FLOAT32_IEEE 0 SigPreProcessor_CM_single_dash_ -20000.000000 20000.000000 /end CHARACTERISTIC
/begin CHARACTERISTIC SGSA_ResolverFaultClr_C "" VALUE 0x0000 /* @ECU_Address@SGSA_ResolverFaultClr_C@ */ Record_UBYTE 0 SigPreProcessor_CM_uint8_dash_ 0.000000 255.000000 /end CHARACTERISTIC
/begin MEASUREMENT CTSO_OperationMode "" UBYTE SigPreProcessor_CM_EnumCtlMode 0 0 0 14 ECU_ADDRESS 0x0000 /* @ECU_Address@CTSO_OperationMode@ */ /end MEASUREMENT
/begin MEASUREMENT CTSO_SpeedCalcReset "" UBYTE SigPreProcessor_CM_uint8 0 0 0 255 ECU_ADDRESS 0x0000 /* @ECU_Address@CTSO_SpeedCalcReset@ */ /end MEASUREMENT
/begin MEASUREMENT SGPP_BSW_f32_ChrgWakeup_State "" UBYTE SigPreProcessor_CM_uint8 0 0 0 255 ECU_ADDRESS 0x0000 /* @ECU_Address@SGPP_BSW_f32_ChrgWakeup_State@ */ /end MEASUREMENT
/begin MEASUREMENT SGPP_BSW_f32_DriveHBridg_Error "Ignition power supply status" UBYTE SigPreProcessor_CM_uint8_dash_ 0 0 0.000000 255.000000 MATRIX_DIM 1 1 ECU_ADDRESS 0x0000 /* @ECU_Address@SGPP_BSW_f32_DriveHBridg_Error@ */ /end MEASUREMENT
/begin MEASUREMENT SGPP_BSW_f32_DriveLBridg_Error "Ignition power supply status" UBYTE SigPreProcessor_CM_uint8_dash_ 0 0 0.000000 255.000000 MATRIX_DIM 1 1 ECU_ADDRESS 0x0000 /* @ECU_Address@SGPP_BSW_f32_DriveLBridg_Error@ */ /end MEASUREMENT
/begin MEASUREMENT SGPP_BSW_f32_Drive_Error "Ignition power supply status" UBYTE SigPreProcessor_CM_uint8_dash_ 0 0 0.000000 255.000000 MATRIX_DIM 1 1 ECU_ADDRESS 0x0000 /* @ECU_Address@SGPP_BSW_f32_Drive_Error@ */ /end MEASUREMENT
/begin MEASUREMENT SGPP_BSW_f32_KL15_State "Ignition power supply status" UBYTE SigPreProcessor_CM_uint8_dash_ 0 0 0.000000 255.000000 MATRIX_DIM 1 1 ECU_ADDRESS 0x0000 /* @ECU_Address@SGPP_BSW_f32_KL15_State@ */ /end MEASUREMENT
/begin MEASUREMENT SGPP_BSW_f32_RDC_CosEvlp "" FLOAT32_IEEE SigPreProcessor_CM_single 0 0 -3.4E+38 3.4E+38 MATRIX_DIM 1 1 ECU_ADDRESS 0x0000 /* @ECU_Address@SGPP_BSW_f32_RDC_CosEvlp@ */ /end MEASUREMENT
/begin MEASUREMENT SGPP_BSW_f32_RDC_CosN "" FLOAT32_IEEE SigPreProcessor_CM_single 0 0 -3.4E+38 3.4E+38 ECU_ADDRESS 0x0000 /* @ECU_Address@SGPP_BSW_f32_RDC_CosN@ */ /end MEASUREMENT
/begin MEASUREMENT SGPP_BSW_f32_RDC_CosP "" FLOAT32_IEEE SigPreProcessor_CM_single 0 0 -3.4E+38 3.4E+38 ECU_ADDRESS 0x0000 /* @ECU_Address@SGPP_BSW_f32_RDC_CosP@ */ /end MEASUREMENT
/begin MEASUREMENT SGPP_BSW_f32_RDC_ExctN "" FLOAT32_IEEE SigPreProcessor_CM_single 0 0 -3.4E+38 3.4E+38 ECU_ADDRESS 0x0000 /* @ECU_Address@SGPP_BSW_f32_RDC_ExctN@ */ /end MEASUREMENT
/begin MEASUREMENT SGPP_BSW_f32_RDC_ExctP "" FLOAT32_IEEE SigPreProcessor_CM_single 0 0 -3.4E+38 3.4E+38 ECU_ADDRESS 0x0000 /* @ECU_Address@SGPP_BSW_f32_RDC_ExctP@ */ /end MEASUREMENT
/begin MEASUREMENT SGPP_BSW_f32_RDC_GroupDelay "" FLOAT32_IEEE SigPreProcessor_CM_single 0 0 -3.4E+38 3.4E+38 ECU_ADDRESS 0x0000 /* @ECU_Address@SGPP_BSW_f32_RDC_GroupDelay@ */ /end MEASUREMENT
/begin MEASUREMENT SGPP_BSW_f32_RDC_SinEvlp "" FLOAT32_IEEE SigPreProcessor_CM_single 0 0 -3.4E+38 3.4E+38 MATRIX_DIM 1 1 ECU_ADDRESS 0x0000 /* @ECU_Address@SGPP_BSW_f32_RDC_SinEvlp@ */ /end MEASUREMENT
/begin MEASUREMENT SGPP_BSW_f32_RDC_SinN "" FLOAT32_IEEE SigPreProcessor_CM_single 0 0 -3.4E+38 3.4E+38 ECU_ADDRESS 0x0000 /* @ECU_Address@SGPP_BSW_f32_RDC_SinN@ */ /end MEASUREMENT
/begin MEASUREMENT SGPP_BSW_f32_RDC_SinP "" FLOAT32_IEEE SigPreProcessor_CM_single 0 0 -3.4E+38 3.4E+38 ECU_ADDRESS 0x0000 /* @ECU_Address@SGPP_BSW_f32_RDC_SinP@ */ /end MEASUREMENT
/begin MEASUREMENT SGPP_BSW_f32_RDC_TimeStamp "" FLOAT32_IEEE SigPreProcessor_CM_single 0 0 -3.4E+38 3.4E+38 ECU_ADDRESS 0x0000 /* @ECU_Address@SGPP_BSW_f32_RDC_TimeStamp@ */ /end MEASUREMENT
/begin MEASUREMENT SGPP_BSW_f32_eAngle_rad "Electrical angle for coordinate transformation" FLOAT32_IEEE SigPreProcessor_CM_single_rad 0 0 0.000000 6.283185 ECU_ADDRESS 0x0000 /* @ECU_Address@SGPP_BSW_f32_eAngle_rad@ */ /end MEASUREMENT
/begin MEASUREMENT SGPP_BSW_f32_iSmpPhaU_A "" FLOAT32_IEEE SigPreProcessor_CM_single_A 0 0 -3.4E+38 3.4E+38 MATRIX_DIM 1 1 ECU_ADDRESS 0x0000 /* @ECU_Address@SGPP_BSW_f32_iSmpPhaU_A@ */ /end MEASUREMENT
/begin MEASUREMENT SGPP_BSW_f32_iSmpPhaV_A "" FLOAT32_IEEE SigPreProcessor_CM_single 0 0 -3.4E+38 3.4E+38 ECU_ADDRESS 0x0000 /* @ECU_Address@SGPP_BSW_f32_iSmpPhaV_A@ */ /end MEASUREMENT
/begin MEASUREMENT SGPP_BSW_f32_iSmpPhaW_A "" FLOAT32_IEEE SigPreProcessor_CM_single_A 0 0 -3.4E+38 3.4E+38 MATRIX_DIM 1 1 ECU_ADDRESS 0x0000 /* @ECU_Address@SGPP_BSW_f32_iSmpPhaW_A@ */ /end MEASUREMENT
/begin MEASUREMENT SGPP_BSW_f32_nRotateSpd_rpm "Mechanical rotor speed" FLOAT32_IEEE SigPreProcessor_CM_single_rpm 0 0 -100000.000000 100000.000000 ECU_ADDRESS 0x0000 /* @ECU_Address@SGPP_BSW_f32_nRotateSpd_rpm@ */ /end MEASUREMENT
/begin MEASUREMENT SGPP_BSW_f32_tIGBTTempU_C "Phase A power switch temperature" FLOAT32_IEEE SigPreProcessor_CM_single 0 0 -50.000000 500.000000 ECU_ADDRESS 0x0000 /* @ECU_Address@SGPP_BSW_f32_tIGBTTempU_C@ */ /end MEASUREMENT
/begin MEASUREMENT SGPP_BSW_f32_tIGBTTempV_C "Phase B power switch temperature" FLOAT32_IEEE SigPreProcessor_CM_single 0 0 -50.000000 500.000000 ECU_ADDRESS 0x0000 /* @ECU_Address@SGPP_BSW_f32_tIGBTTempV_C@ */ /end MEASUREMENT
/begin MEASUREMENT SGPP_BSW_f32_tIGBTTempW_C "Phase C power switch temperature" FLOAT32_IEEE SigPreProcessor_CM_single 0 0 -50.000000 500.000000 ECU_ADDRESS 0x0000 /* @ECU_Address@SGPP_BSW_f32_tIGBTTempW_C@ */ /end MEASUREMENT
/begin MEASUREMENT SGPP_BSW_f32_tMotTemp_C "Motor temperature sensor 1 reading" FLOAT32_IEEE SigPreProcessor_CM_single 0 0 -50.000000 250.000000 ECU_ADDRESS 0x0000 /* @ECU_Address@SGPP_BSW_f32_tMotTemp_C@ */ /end MEASUREMENT
/begin MEASUREMENT SGPP_BSW_f32_u12V_V "" FLOAT32_IEEE SigPreProcessor_CM_single 0 0 -3.4E+38 3.4E+38 MATRIX_DIM 1 1 ECU_ADDRESS 0x0000 /* @ECU_Address@SGPP_BSW_f32_u12V_V@ */ /end MEASUREMENT
/begin MEASUREMENT SGPP_BSW_f32_u5V_V "" FLOAT32_IEEE SigPreProcessor_CM_single 0 0 -3.4E+38 3.4E+38 MATRIX_DIM 1 1 ECU_ADDRESS 0x0000 /* @ECU_Address@SGPP_BSW_f32_u5V_V@ */ /end MEASUREMENT
/begin MEASUREMENT SGPP_BSW_f32_uCurrSnsrRefSmp_V "" FLOAT32_IEEE SigPreProcessor_CM_single 0 0 -3.4E+38 3.4E+38 ECU_ADDRESS 0x0000 /* @ECU_Address@SGPP_BSW_f32_uCurrSnsrRefSmp_V@ */ /end MEASUREMENT
/begin MEASUREMENT SGPP_BSW_f32_uCurrSnsrUSmp_V "" FLOAT32_IEEE SigPreProcessor_CM_single 0 0 -3.4E+38 3.4E+38 MATRIX_DIM 1 1 ECU_ADDRESS 0x0000 /* @ECU_Address@SGPP_BSW_f32_uCurrSnsrUSmp_V@ */ /end MEASUREMENT
/begin MEASUREMENT SGPP_BSW_f32_uCurrSnsrVSmp_V "" FLOAT32_IEEE SigPreProcessor_CM_single 0 0 -3.4E+38 3.4E+38 ECU_ADDRESS 0x0000 /* @ECU_Address@SGPP_BSW_f32_uCurrSnsrVSmp_V@ */ /end MEASUREMENT
/begin MEASUREMENT SGPP_BSW_f32_uCurrSnsrWSmp_V "" FLOAT32_IEEE SigPreProcessor_CM_single 0 0 -3.4E+38 3.4E+38 MATRIX_DIM 1 1 ECU_ADDRESS 0x0000 /* @ECU_Address@SGPP_BSW_f32_uCurrSnsrWSmp_V@ */ /end MEASUREMENT
/begin MEASUREMENT SGPP_BSW_f32_uDCActSmp_V "" FLOAT32_IEEE SigPreProcessor_CM_single 0 0 -3.4E+38 3.4E+38 ECU_ADDRESS 0x0000 /* @ECU_Address@SGPP_BSW_f32_uDCActSmp_V@ */ /end MEASUREMENT
/begin MEASUREMENT SGPP_BSW_f32_uDcHVSmp_V "" FLOAT32_IEEE SigPreProcessor_CM_single 0 0 -3.4E+38 3.4E+38 ECU_ADDRESS 0x0000 /* @ECU_Address@SGPP_BSW_f32_uDcHVSmp_V@ */ /end MEASUREMENT
/begin MEASUREMENT SGPP_BSW_f32_uDcHV_V "DC-link voltage measurement" FLOAT32_IEEE SigPreProcessor_CM_single_V 0 0 0.000000 1000.000000 ECU_ADDRESS 0x0000 /* @ECU_Address@SGPP_BSW_f32_uDcHV_V@ */ /end MEASUREMENT
/begin MEASUREMENT SGPP_BSW_f32_uIGBTTempUSmp_V "" FLOAT32_IEEE SigPreProcessor_CM_single 0 0 -3.4E+38 3.4E+38 ECU_ADDRESS 0x0000 /* @ECU_Address@SGPP_BSW_f32_uIGBTTempUSmp_V@ */ /end MEASUREMENT
/begin MEASUREMENT SGPP_BSW_f32_uIGBTTempVSmp_V "" FLOAT32_IEEE SigPreProcessor_CM_single 0 0 -3.4E+38 3.4E+38 ECU_ADDRESS 0x0000 /* @ECU_Address@SGPP_BSW_f32_uIGBTTempVSmp_V@ */ /end MEASUREMENT
/begin MEASUREMENT SGPP_BSW_f32_uIGBTTempWSmp_V "" FLOAT32_IEEE SigPreProcessor_CM_single 0 0 -3.4E+38 3.4E+38 ECU_ADDRESS 0x0000 /* @ECU_Address@SGPP_BSW_f32_uIGBTTempWSmp_V@ */ /end MEASUREMENT
/begin MEASUREMENT SGPP_BSW_f32_uMotTempSmp_V "" FLOAT32_IEEE SigPreProcessor_CM_single 0 0 0.000000 4096.000000 MATRIX_DIM 1 1 ECU_ADDRESS 0x0000 /* @ECU_Address@SGPP_BSW_f32_uMotTempSmp_V@ */ /end MEASUREMENT
/begin MEASUREMENT SGPP_BSW_f32_uSmpRpl_V "" FLOAT32_IEEE SigPreProcessor_CM_single 0 0 -3.4E+38 3.4E+38 ECU_ADDRESS 0x0000 /* @ECU_Address@SGPP_BSW_f32_uSmpRpl_V@ */ /end MEASUREMENT
/begin MEASUREMENT SGPP_BSW_u8_ASC_Enable "" UBYTE SigPreProcessor_CM_uint8 0 0 0 255 MATRIX_DIM 1 1 ECU_ADDRESS 0x0000 /* @ECU_Address@SGPP_BSW_u8_ASC_Enable@ */ /end MEASUREMENT
/begin MEASUREMENT SGPP_BSW_u8_ClearFlt_Roty_En "" UBYTE SigPreProcessor_CM_uint8 0 0 0 255 MATRIX_DIM 1 1 ECU_ADDRESS 0x0000 /* @ECU_Address@SGPP_BSW_u8_ClearFlt_Roty_En@ */ /end MEASUREMENT
/begin MEASUREMENT SGPP_BSW_u8_ClearFlt_Volt_Curr_En "" UBYTE SigPreProcessor_CM_logical 0 0 0 1 MATRIX_DIM 1 1 ECU_ADDRESS 0x0000 /* @ECU_Address@SGPP_BSW_u8_ClearFlt_Volt_Curr_En@ */ /end MEASUREMENT
/begin MEASUREMENT SGPP_BSW_u8_CutOffDelayEn_flg "" UBYTE SigPreProcessor_CM_logical 0 0 0 1 MATRIX_DIM 1 1 ECU_ADDRESS 0x0000 /* @ECU_Address@SGPP_BSW_u8_CutOffDelayEn_flg@ */ /end MEASUREMENT
/begin MEASUREMENT SGPP_BSW_u8_DriFault_UH "" UBYTE SigPreProcessor_CM_uint8 0 0 0 255 ECU_ADDRESS 0x0000 /* @ECU_Address@SGPP_BSW_u8_DriFault_UH@ */ /end MEASUREMENT
/begin MEASUREMENT SGPP_BSW_u8_DriFault_UL "" UBYTE SigPreProcessor_CM_uint8 0 0 0 255 ECU_ADDRESS 0x0000 /* @ECU_Address@SGPP_BSW_u8_DriFault_UL@ */ /end MEASUREMENT
/begin MEASUREMENT SGPP_BSW_u8_DriFault_VH "" UBYTE SigPreProcessor_CM_uint8 0 0 0 255 ECU_ADDRESS 0x0000 /* @ECU_Address@SGPP_BSW_u8_DriFault_VH@ */ /end MEASUREMENT
/begin MEASUREMENT SGPP_BSW_u8_DriFault_VL "" UBYTE SigPreProcessor_CM_uint8 0 0 0 255 ECU_ADDRESS 0x0000 /* @ECU_Address@SGPP_BSW_u8_DriFault_VL@ */ /end MEASUREMENT
/begin MEASUREMENT SGPP_BSW_u8_DriFault_WH "" UBYTE SigPreProcessor_CM_uint8 0 0 0 255 ECU_ADDRESS 0x0000 /* @ECU_Address@SGPP_BSW_u8_DriFault_WH@ */ /end MEASUREMENT
/begin MEASUREMENT SGPP_BSW_u8_DriFault_WL "" UBYTE SigPreProcessor_CM_uint8 0 0 0 255 ECU_ADDRESS 0x0000 /* @ECU_Address@SGPP_BSW_u8_DriFault_WL@ */ /end MEASUREMENT
/begin MEASUREMENT SGPP_BSW_u8_HWOCFlt "" UBYTE SigPreProcessor_CM_uint8 0 0 0 255 MATRIX_DIM 1 1 ECU_ADDRESS 0x0000 /* @ECU_Address@SGPP_BSW_u8_HWOCFlt@ */ /end MEASUREMENT
/begin MEASUREMENT SGPP_BSW_u8_HWOVFlt "" UBYTE SigPreProcessor_CM_uint8 0 0 0 255 MATRIX_DIM 1 1 ECU_ADDRESS 0x0000 /* @ECU_Address@SGPP_BSW_u8_HWOVFlt@ */ /end MEASUREMENT
/begin MEASUREMENT SGPP_BSW_u8_PWM_Enable "" UBYTE SigPreProcessor_CM_uint8 0 0 0 255 MATRIX_DIM 1 1 ECU_ADDRESS 0x0000 /* @ECU_Address@SGPP_BSW_u8_PWM_Enable@ */ /end MEASUREMENT
/begin MEASUREMENT SGPP_BSW_u8_bERCNVFlt "" UBYTE SigPreProcessor_CM_uint8 0 0 0 255 MATRIX_DIM 1 1 ECU_ADDRESS 0x0000 /* @ECU_Address@SGPP_BSW_u8_bERCNVFlt@ */ /end MEASUREMENT
/begin MEASUREMENT SGPP_BSW_u8_bERDCNVFlt "" UBYTE SigPreProcessor_CM_uint8 0 0 0 255 MATRIX_DIM 1 1 ECU_ADDRESS 0x0000 /* @ECU_Address@SGPP_BSW_u8_bERDCNVFlt@ */ /end MEASUREMENT
/begin MEASUREMENT SGPP_BSW_u8_bERDEXCFlt "" UBYTE SigPreProcessor_CM_uint8 0 0 0 255 MATRIX_DIM 1 1 ECU_ADDRESS 0x0000 /* @ECU_Address@SGPP_BSW_u8_bERDEXCFlt@ */ /end MEASUREMENT
/begin MEASUREMENT SGPP_BSW_u8_bERDP2Flt "" UBYTE SigPreProcessor_CM_uint8 0 0 0 255 MATRIX_DIM 1 1 ECU_ADDRESS 0x0000 /* @ECU_Address@SGPP_BSW_u8_bERDP2Flt@ */ /end MEASUREMENT
/begin MEASUREMENT SGPP_BSW_u8_bERDSBCFlt "" UBYTE SigPreProcessor_CM_uint8 0 0 0 255 ECU_ADDRESS 0x0000 /* @ECU_Address@SGPP_BSW_u8_bERDSBCFlt@ */ /end MEASUREMENT
/begin MEASUREMENT SGPP_BSW_u8_bERDSBSFlt "" UBYTE SigPreProcessor_CM_uint8 0 0 0 255 ECU_ADDRESS 0x0000 /* @ECU_Address@SGPP_BSW_u8_bERDSBSFlt@ */ /end MEASUREMENT
/begin MEASUREMENT SGPP_BSW_u8_bERDSQFlt "" UBYTE SigPreProcessor_CM_uint8 0 0 0 255 ECU_ADDRESS 0x0000 /* @ECU_Address@SGPP_BSW_u8_bERDSQFlt@ */ /end MEASUREMENT
/begin MEASUREMENT SGPP_BSW_u8_bEREXCFlt "" UBYTE SigPreProcessor_CM_uint8 0 0 0 255 ECU_ADDRESS 0x0000 /* @ECU_Address@SGPP_BSW_u8_bEREXCFlt@ */ /end MEASUREMENT
/begin MEASUREMENT SGPP_BSW_u8_bERHDFlt "" UBYTE SigPreProcessor_CM_uint8 0 0 0 255 ECU_ADDRESS 0x0000 /* @ECU_Address@SGPP_BSW_u8_bERHDFlt@ */ /end MEASUREMENT
/begin MEASUREMENT SGPP_BSW_u8_bERP2Flt "" UBYTE SigPreProcessor_CM_uint8 0 0 0 255 ECU_ADDRESS 0x0000 /* @ECU_Address@SGPP_BSW_u8_bERP2Flt@ */ /end MEASUREMENT
/begin MEASUREMENT SGPP_BSW_u8_bERRFlt "" UBYTE SigPreProcessor_CM_uint8 0 0 0 255 ECU_ADDRESS 0x0000 /* @ECU_Address@SGPP_BSW_u8_bERRFlt@ */ /end MEASUREMENT
/begin MEASUREMENT SGPP_BSW_u8_bERSBCFlt "" UBYTE SigPreProcessor_CM_uint8 0 0 0 255 ECU_ADDRESS 0x0000 /* @ECU_Address@SGPP_BSW_u8_bERSBCFlt@ */ /end MEASUREMENT
/begin MEASUREMENT SGPP_BSW_u8_bERSBSFlt "" UBYTE SigPreProcessor_CM_uint8 0 0 0 255 ECU_ADDRESS 0x0000 /* @ECU_Address@SGPP_BSW_u8_bERSBSFlt@ */ /end MEASUREMENT
/begin MEASUREMENT SGPP_BSW_u8_bERSQFlt "" UBYTE SigPreProcessor_CM_uint8 0 0 0 255 ECU_ADDRESS 0x0000 /* @ECU_Address@SGPP_BSW_u8_bERSQFlt@ */ /end MEASUREMENT
/begin MEASUREMENT SGPP_BSW_u8_bMcuStorgUnitFlt "" UBYTE SigPreProcessor_CM_uint8 0 0 0 255 ECU_ADDRESS 0x0000 /* @ECU_Address@SGPP_BSW_u8_bMcuStorgUnitFlt@ */ /end MEASUREMENT
/begin MEASUREMENT SGPP_BSW_u8_bRotyTrfrDosFlt "" UBYTE SigPreProcessor_CM_uint8 0 0 0 255 ECU_ADDRESS 0x0000 /* @ECU_Address@SGPP_BSW_u8_bRotyTrfrDosFlt@ */ /end MEASUREMENT
/begin MEASUREMENT SGPP_BSW_u8_bRotyTrfrFlt "" UBYTE SigPreProcessor_CM_uint8 0 0 0 255 MATRIX_DIM 1 1 ECU_ADDRESS 0x0000 /* @ECU_Address@SGPP_BSW_u8_bRotyTrfrFlt@ */ /end MEASUREMENT
/begin MEASUREMENT SGPP_BSW_u8_bRotyTrfrLosFlt "" UBYTE SigPreProcessor_CM_uint8 0 0 0 255 ECU_ADDRESS 0x0000 /* @ECU_Address@SGPP_BSW_u8_bRotyTrfrLosFlt@ */ /end MEASUREMENT
/begin MEASUREMENT SGPP_BSW_u8_bRotyTrfrLotFlt "" UBYTE SigPreProcessor_CM_uint8 0 0 0 255 ECU_ADDRESS 0x0000 /* @ECU_Address@SGPP_BSW_u8_bRotyTrfrLotFlt@ */ /end MEASUREMENT
/begin MEASUREMENT SGPP_BSW_u8_stPWM "" UBYTE SigPreProcessor_CM_uint8 0 0 0 255 MATRIX_DIM 1 1 ECU_ADDRESS 0x0000 /* @ECU_Address@SGPP_BSW_u8_stPWM@ */ /end MEASUREMENT
/begin MEASUREMENT SGPP_ClrHWFault "" UBYTE SigPreProcessor_CM_boolean 0 0 0 1 MATRIX_DIM 1 1 ECU_ADDRESS 0x0000 /* @ECU_Address@SGPP_ClrHWFault@ */ /end MEASUREMENT
/begin MEASUREMENT SGPP_ClrResolverFault "" UBYTE SigPreProcessor_CM_uint8 0 0 0 255 MATRIX_DIM 1 1 ECU_ADDRESS 0x0000 /* @ECU_Address@SGPP_ClrResolverFault@ */ /end MEASUREMENT
/begin MEASUREMENT SGPP_DcLinkVoltMeas "DC-link voltage measurement" FLOAT32_IEEE SigPreProcessor_CM_single_V 0 0 0.000000 1000.000000 ECU_ADDRESS 0x0000 /* @ECU_Address@SGPP_DcLinkVoltMeas@ */ /end MEASUREMENT
/begin MEASUREMENT SGPP_DcLinkVoltReciprocal "Reciprocal of DC-link voltage" FLOAT32_IEEE SigPreProcessor_CM_single_dash_ 0 0 0.000000 1.000000 MATRIX_DIM 1 1 ECU_ADDRESS 0x0000 /* @ECU_Address@SGPP_DcLinkVoltReciprocal@ */ /end MEASUREMENT
/begin MEASUREMENT SGPP_ElecAngle "Electrical angle for coordinate transformation" FLOAT32_IEEE SigPreProcessor_CM_single_rad 0 0 0.000000 6.283185 ECU_ADDRESS 0x0000 /* @ECU_Address@SGPP_ElecAngle@ */ /end MEASUREMENT
/begin MEASUREMENT SGPP_ElecSpeed "Electrical rotor speed" FLOAT32_IEEE SigPreProcessor_CM_single_rad_per_s 0 0 -100000.000000 100000.000000 MATRIX_DIM 1 1 ECU_ADDRESS 0x0000 /* @ECU_Address@SGPP_ElecSpeed@ */ /end MEASUREMENT
/begin MEASUREMENT SGPP_ElecSpeedAfterFilter "Filtered electrical speed output" FLOAT32_IEEE SigPreProcessor_CM_single_rad_per_s 0 0 -3.4E+38 3.4E+38 ECU_ADDRESS 0x0000 /* @ECU_Address@SGPP_ElecSpeedAfterFilter@ */ /end MEASUREMENT
/begin MEASUREMENT SGPP_ElecSpeedBeforeFilter "Raw electrical speed before filtering" FLOAT32_IEEE SigPreProcessor_CM_single_rad_per_s 0 0 -3.4E+38 3.4E+38 ECU_ADDRESS 0x0000 /* @ECU_Address@SGPP_ElecSpeedBeforeFilter@ */ /end MEASUREMENT
/begin MEASUREMENT SGPP_FOC_f32_Uduty_Null "" FLOAT32_IEEE SigPreProcessor_CM_single 0 0 -3.4E+38 3.4E+38 ECU_ADDRESS 0x0000 /* @ECU_Address@SGPP_FOC_f32_Uduty_Null@ */ /end MEASUREMENT
/begin MEASUREMENT SGPP_FOC_f32_Vduty_Null "" FLOAT32_IEEE SigPreProcessor_CM_single 0 0 -3.4E+38 3.4E+38 ECU_ADDRESS 0x0000 /* @ECU_Address@SGPP_FOC_f32_Vduty_Null@ */ /end MEASUREMENT
/begin MEASUREMENT SGPP_FOC_f32_Wduty_Null "" FLOAT32_IEEE SigPreProcessor_CM_single 0 0 -3.4E+38 3.4E+38 ECU_ADDRESS 0x0000 /* @ECU_Address@SGPP_FOC_f32_Wduty_Null@ */ /end MEASUREMENT
/begin MEASUREMENT SGPP_IgnitionStatus "Ignition power supply status" UBYTE SigPreProcessor_CM_uint8_dash_ 0 0 0.000000 255.000000 MATRIX_DIM 1 1 ECU_ADDRESS 0x0000 /* @ECU_Address@SGPP_IgnitionStatus@ */ /end MEASUREMENT
/begin MEASUREMENT SGPP_MechSpeed "Speed setpoint from communication" FLOAT32_IEEE SigPreProcessor_CM_single_rpm 0 0 -100000.000000 100000.000000 ECU_ADDRESS 0x0000 /* @ECU_Address@SGPP_MechSpeed@ */ /end MEASUREMENT
/begin MEASUREMENT SGPP_MotorTemp1 "Motor temperature sensor 1 reading" FLOAT32_IEEE SigPreProcessor_CM_single 0 0 -50.000000 250.000000 ECU_ADDRESS 0x0000 /* @ECU_Address@SGPP_MotorTemp1@ */ /end MEASUREMENT
/begin MEASUREMENT SGPP_PhaseACurrent "Phase A measured current for control" FLOAT32_IEEE SigPreProcessor_CM_single_A 0 0 -2000.000000 2000.000000 MATRIX_DIM 1 1 ECU_ADDRESS 0x0000 /* @ECU_Address@SGPP_PhaseACurrent@ */ /end MEASUREMENT
/begin MEASUREMENT SGPP_PhaseADuty "Phase A PWM duty cycle" FLOAT32_IEEE SigPreProcessor_CM_single_percent_ 0 0 0.000000 100.000000 ECU_ADDRESS 0x0000 /* @ECU_Address@SGPP_PhaseADuty@ */ /end MEASUREMENT
/begin MEASUREMENT SGPP_PhaseASwitchTemp "Maximum power switch temperature" FLOAT32_IEEE SigPreProcessor_CM_single 0 0 -50.000000 500.000000 ECU_ADDRESS 0x0000 /* @ECU_Address@SGPP_PhaseASwitchTemp@ */ /end MEASUREMENT
/begin MEASUREMENT SGPP_PhaseBCurrent "Phase B calculated current for control" FLOAT32_IEEE SigPreProcessor_CM_single_A 0 0 -2000.000000 2000.000000 MATRIX_DIM 1 1 ECU_ADDRESS 0x0000 /* @ECU_Address@SGPP_PhaseBCurrent@ */ /end MEASUREMENT
/begin MEASUREMENT SGPP_PhaseBDuty "Phase B PWM duty cycle" FLOAT32_IEEE SigPreProcessor_CM_single_percent_ 0 0 0.000000 100.000000 ECU_ADDRESS 0x0000 /* @ECU_Address@SGPP_PhaseBDuty@ */ /end MEASUREMENT
/begin MEASUREMENT SGPP_PhaseBSwitchTemp "Maximum power switch temperature" FLOAT32_IEEE SigPreProcessor_CM_single 0 0 -50.000000 500.000000 ECU_ADDRESS 0x0000 /* @ECU_Address@SGPP_PhaseBSwitchTemp@ */ /end MEASUREMENT
/begin MEASUREMENT SGPP_PhaseCCurrent "Phase C measured current for control" FLOAT32_IEEE SigPreProcessor_CM_single_A 0 0 -2000.000000 2000.000000 MATRIX_DIM 1 1 ECU_ADDRESS 0x0000 /* @ECU_Address@SGPP_PhaseCCurrent@ */ /end MEASUREMENT
/begin MEASUREMENT SGPP_PhaseCDuty "Phase C PWM duty cycle" FLOAT32_IEEE SigPreProcessor_CM_single_percent_ 0 0 0.000000 100.000000 ECU_ADDRESS 0x0000 /* @ECU_Address@SGPP_PhaseCDuty@ */ /end MEASUREMENT
/begin MEASUREMENT SGPP_PhaseCSwitchTemp "Maximum power switch temperature" FLOAT32_IEEE SigPreProcessor_CM_single 0 0 -50.000000 500.000000 ECU_ADDRESS 0x0000 /* @ECU_Address@SGPP_PhaseCSwitchTemp@ */ /end MEASUREMENT
/begin MEASUREMENT SGPP_PolePairRatio "Motor to resolver pole pair ratio" FLOAT32_IEEE SigPreProcessor_CM_single_dash_ 0 0 0.000000 100.000000 ECU_ADDRESS 0x0000 /* @ECU_Address@SGPP_PolePairRatio@ */ /end MEASUREMENT
/begin MEASUREMENT SGPP_PolePairs "Motor pole pair count" UBYTE SigPreProcessor_CM_uint8_dash_ 0 0 0.000000 100.000000 ECU_ADDRESS 0x0000 /* @ECU_Address@SGPP_PolePairs@ */ /end MEASUREMENT
/begin MEASUREMENT SGPP_PolePairsReciprocal "Reciprocal of motor pole pair number" FLOAT32_IEEE SigPreProcessor_CM_single_dash_ 0 0 0.000000 100.000000 ECU_ADDRESS 0x0000 /* @ECU_Address@SGPP_PolePairsReciprocal@ */ /end MEASUREMENT
/begin MEASUREMENT SGPP_PolePairsReciprocal_IRV "Pole pair reciprocal for internal routing" FLOAT32_IEEE SigPreProcessor_CM_single_dash_ 0 0 -3.4E+38 3.4E+38 ECU_ADDRESS 0x0000 /* @ECU_Address@SGPP_PolePairsReciprocal_IRV@ */ /end MEASUREMENT
/begin MEASUREMENT SGPP_PolePairs_IRV "Motor pole pairs for internal routing" UBYTE SigPreProcessor_CM_uint8_dash_ 0 0 0 255 ECU_ADDRESS 0x0000 /* @ECU_Address@SGPP_PolePairs_IRV@ */ /end MEASUREMENT
/begin MEASUREMENT SGPP_ResolverPolePairs "Resolver pole pair count" UBYTE SigPreProcessor_CM_uint8_dash_ 0 0 0.000000 255.000000 ECU_ADDRESS 0x0000 /* @ECU_Address@SGPP_ResolverPolePairs@ */ /end MEASUREMENT
/begin MEASUREMENT SGPP_SampleTime1 "Primary control loop sampling time" FLOAT32_IEEE SigPreProcessor_CM_single_s 0 0 0.000000 10.000000 ECU_ADDRESS 0x0000 /* @ECU_Address@SGPP_SampleTime1@ */ /end MEASUREMENT
/begin MEASUREMENT SGPP_SampleTime1Reciprocal "Reciprocal of primary sampling time" FLOAT32_IEEE SigPreProcessor_CM_single_1_per_s 0 0 0.000000 100000.000000 ECU_ADDRESS 0x0000 /* @ECU_Address@SGPP_SampleTime1Reciprocal@ */ /end MEASUREMENT
/begin MEASUREMENT SGPP_SampleTime2 "Secondary control loop sampling time" FLOAT32_IEEE SigPreProcessor_CM_single_s 0 0 0.000000 100000.000000 ECU_ADDRESS 0x0000 /* @ECU_Address@SGPP_SampleTime2@ */ /end MEASUREMENT
/begin MEASUREMENT SGPP_SampleTime2_IRV "Secondary sampling time for internal routing" FLOAT32_IEEE SigPreProcessor_CM_single_s 0 0 -3.4E+38 3.4E+38 ECU_ADDRESS 0x0000 /* @ECU_Address@SGPP_SampleTime2_IRV@ */ /end MEASUREMENT
/begin MEASUREMENT SGPP_SampleTime4 "Quaternary control loop sampling time" FLOAT32_IEEE SigPreProcessor_CM_single_s 0 0 0.000000 100000.000000 ECU_ADDRESS 0x0000 /* @ECU_Address@SGPP_SampleTime4@ */ /end MEASUREMENT
/begin MEASUREMENT SGPP_SampleTime4_IRV "Quaternary sampling time for internal routing" FLOAT32_IEEE SigPreProcessor_CM_single_s 0 0 -3.4E+38 3.4E+38 ECU_ADDRESS 0x0000 /* @ECU_Address@SGPP_SampleTime4_IRV@ */ /end MEASUREMENT
/begin MEASUREMENT SGPP_SetDriverSts "" UBYTE SigPreProcessor_CM_uint8 0 0 0 255 MATRIX_DIM 1 1 ECU_ADDRESS 0x0000 /* @ECU_Address@SGPP_SetDriverSts@ */ /end MEASUREMENT
/begin MEASUREMENT SGPP_SetFreq "" FLOAT32_IEEE SigPreProcessor_CM_single 0 0 0.000000 30000.000000 MATRIX_DIM 1 1 ECU_ADDRESS 0x0000 /* @ECU_Address@SGPP_SetFreq@ */ /end MEASUREMENT
/begin MEASUREMENT SGPP_SetHighASCFlg "" UBYTE SigPreProcessor_CM_uint8 0 0 0 255 MATRIX_DIM 1 1 ECU_ADDRESS 0x0000 /* @ECU_Address@SGPP_SetHighASCFlg@ */ /end MEASUREMENT
/begin MEASUREMENT SGPP_SetPwrOffDlyFlg "" UBYTE SigPreProcessor_CM_boolean 0 0 0 1 MATRIX_DIM 1 1 ECU_ADDRESS 0x0000 /* @ECU_Address@SGPP_SetPwrOffDlyFlg@ */ /end MEASUREMENT
/begin MEASUREMENT SGPP_SimElecAngle "Electrical angle for coordinate transformation" FLOAT32_IEEE SigPreProcessor_CM_single_rad 0 0 0.000000 6.283185 MATRIX_DIM 1 1 ECU_ADDRESS 0x0000 /* @ECU_Address@SGPP_SimElecAngle@ */ /end MEASUREMENT
/begin MEASUREMENT SGPP_SpeedSp "Speed setpoint from communication" FLOAT32_IEEE SigPreProcessor_CM_single_rpm 0 0 -100000.000000 100000.000000 MATRIX_DIM 1 1 ECU_ADDRESS 0x0000 /* @ECU_Address@SGPP_SpeedSp@ */ /end MEASUREMENT
/begin MEASUREMENT SGPP_SwitchTempMax "Maximum power switch temperature" FLOAT32_IEEE SigPreProcessor_CM_single 0 0 -50.000000 500.000000 MATRIX_DIM 1 1 ECU_ADDRESS 0x0000 /* @ECU_Address@SGPP_SwitchTempMax@ */ /end MEASUREMENT
/begin MEASUREMENT SGPP_kFOC_f32_PWMFreq_Hz "" FLOAT32_IEEE SigPreProcessor_CM_single 0 0 -3.4E+38 3.4E+38 MATRIX_DIM 1 1 ECU_ADDRESS 0x0000 /* @ECU_Address@SGPP_kFOC_f32_PWMFreq_Hz@ */ /end MEASUREMENT
/begin MEASUREMENT SGRD_CosEnvelope "" FLOAT32_IEEE SigPreProcessor_CM_single 0 0 -3.4E+38 3.4E+38 MATRIX_DIM 1 1 ECU_ADDRESS 0x0000 /* @ECU_Address@SGRD_CosEnvelope@ */ /end MEASUREMENT
/begin MEASUREMENT SGRD_EstTheta "" FLOAT32_IEEE SigPreProcessor_CM_single_rad 0 0 -3.4E+38 3.4E+38 ECU_ADDRESS 0x0000 /* @ECU_Address@SGRD_EstTheta@ */ /end MEASUREMENT
/begin MEASUREMENT SGRD_PwmFreq "" FLOAT32_IEEE SigPreProcessor_CM_single_1_per_s 0 0 -3.4E+38 3.4E+38 ECU_ADDRESS 0x0000 /* @ECU_Address@SGRD_PwmFreq@ */ /end MEASUREMENT
/begin MEASUREMENT SGRD_PwmTs "" FLOAT32_IEEE SigPreProcessor_CM_single_s 0 0 -3.4E+38 3.4E+38 ECU_ADDRESS 0x0000 /* @ECU_Address@SGRD_PwmTs@ */ /end MEASUREMENT
/begin MEASUREMENT SGRD_SinEnvelope "" FLOAT32_IEEE SigPreProcessor_CM_single 0 0 -3.4E+38 3.4E+38 MATRIX_DIM 1 1 ECU_ADDRESS 0x0000 /* @ECU_Address@SGRD_SinEnvelope@ */ /end MEASUREMENT
/begin MEASUREMENT SGSA_BatteryVolt "" FLOAT32_IEEE SigPreProcessor_CM_single 0 0 -3.4E+38 3.4E+38 MATRIX_DIM 1 1 ECU_ADDRESS 0x0000 /* @ECU_Address@SGSA_BatteryVolt@ */ /end MEASUREMENT
/begin MEASUREMENT SGSA_DcLinkVoltMeas "" FLOAT32_IEEE SigPreProcessor_CM_single_V 0 0 -3.4E+38 3.4E+38 ECU_ADDRESS 0x0000 /* @ECU_Address@SGSA_DcLinkVoltMeas@ */ /end MEASUREMENT
/begin MEASUREMENT SGSA_DcLinkVoltMeasAD "" FLOAT32_IEEE SigPreProcessor_CM_single 0 0 -3.4E+38 3.4E+38 ECU_ADDRESS 0x0000 /* @ECU_Address@SGSA_DcLinkVoltMeasAD@ */ /end MEASUREMENT
/begin MEASUREMENT SGSA_DriveErr "" UBYTE SigPreProcessor_CM_uint8_dash_ 0 0 0 255 MATRIX_DIM 1 1 ECU_ADDRESS 0x0000 /* @ECU_Address@SGSA_DriveErr@ */ /end MEASUREMENT
/begin MEASUREMENT SGSA_ElecAngle "" FLOAT32_IEEE SigPreProcessor_CM_single_rad 0 0 -3.4E+38 3.4E+38 ECU_ADDRESS 0x0000 /* @ECU_Address@SGSA_ElecAngle@ */ /end MEASUREMENT
/begin MEASUREMENT SGSA_HDriFault "" UBYTE SigPreProcessor_CM_uint8_dash_ 0 0 0 255 MATRIX_DIM 1 1 ECU_ADDRESS 0x0000 /* @ECU_Address@SGSA_HDriFault@ */ /end MEASUREMENT
/begin MEASUREMENT SGSA_HwOvercurSt "" UBYTE SigPreProcessor_CM_uint8 0 0 0 255 MATRIX_DIM 1 1 ECU_ADDRESS 0x0000 /* @ECU_Address@SGSA_HwOvercurSt@ */ /end MEASUREMENT
/begin MEASUREMENT SGSA_HwOvervoltSt "" UBYTE SigPreProcessor_CM_uint8 0 0 0 255 MATRIX_DIM 1 1 ECU_ADDRESS 0x0000 /* @ECU_Address@SGSA_HwOvervoltSt@ */ /end MEASUREMENT
/begin MEASUREMENT SGSA_IgnitionVolt "" FLOAT32_IEEE SigPreProcessor_CM_single 0 0 -3.4E+38 3.4E+38 ECU_ADDRESS 0x0000 /* @ECU_Address@SGSA_IgnitionVolt@ */ /end MEASUREMENT
/begin MEASUREMENT SGSA_LDriFault "" UBYTE SigPreProcessor_CM_uint8_dash_ 0 0 0 255 MATRIX_DIM 1 1 ECU_ADDRESS 0x0000 /* @ECU_Address@SGSA_LDriFault@ */ /end MEASUREMENT
/begin MEASUREMENT SGSA_MotorTemp1 "" FLOAT32_IEEE SigPreProcessor_CM_single 0 0 -3.4E+38 3.4E+38 ECU_ADDRESS 0x0000 /* @ECU_Address@SGSA_MotorTemp1@ */ /end MEASUREMENT
/begin MEASUREMENT SGSA_MotorTemp1AD "" FLOAT32_IEEE SigPreProcessor_CM_single 0 0 -3.4E+38 3.4E+38 MATRIX_DIM 1 1 ECU_ADDRESS 0x0000 /* @ECU_Address@SGSA_MotorTemp1AD@ */ /end MEASUREMENT
/begin MEASUREMENT SGSA_PWMSts "" UBYTE SigPreProcessor_CM_uint8 0 0 0 255 MATRIX_DIM 1 1 ECU_ADDRESS 0x0000 /* @ECU_Address@SGSA_PWMSts@ */ /end MEASUREMENT
/begin MEASUREMENT SGSA_PhaseACurrent "" FLOAT32_IEEE SigPreProcessor_CM_single 0 0 -3.4E+38 3.4E+38 ECU_ADDRESS 0x0000 /* @ECU_Address@SGSA_PhaseACurrent@ */ /end MEASUREMENT
/begin MEASUREMENT SGSA_PhaseACurrentAD "" FLOAT32_IEEE SigPreProcessor_CM_single 0 0 -3.4E+38 3.4E+38 MATRIX_DIM 1 1 ECU_ADDRESS 0x0000 /* @ECU_Address@SGSA_PhaseACurrentAD@ */ /end MEASUREMENT
/begin MEASUREMENT SGSA_PhaseASwitchTemp "" FLOAT32_IEEE SigPreProcessor_CM_single 0 0 -3.4E+38 3.4E+38 ECU_ADDRESS 0x0000 /* @ECU_Address@SGSA_PhaseASwitchTemp@ */ /end MEASUREMENT
/begin MEASUREMENT SGSA_PhaseASwitchTempAD "" FLOAT32_IEEE SigPreProcessor_CM_single 0 0 -3.4E+38 3.4E+38 ECU_ADDRESS 0x0000 /* @ECU_Address@SGSA_PhaseASwitchTempAD@ */ /end MEASUREMENT
/begin MEASUREMENT SGSA_PhaseBSwitchTemp "" FLOAT32_IEEE SigPreProcessor_CM_single 0 0 -3.4E+38 3.4E+38 ECU_ADDRESS 0x0000 /* @ECU_Address@SGSA_PhaseBSwitchTemp@ */ /end MEASUREMENT
/begin MEASUREMENT SGSA_PhaseBSwitchTempAD "" FLOAT32_IEEE SigPreProcessor_CM_single 0 0 -3.4E+38 3.4E+38 ECU_ADDRESS 0x0000 /* @ECU_Address@SGSA_PhaseBSwitchTempAD@ */ /end MEASUREMENT
/begin MEASUREMENT SGSA_PhaseCCurrent "" FLOAT32_IEEE SigPreProcessor_CM_single 0 0 -3.4E+38 3.4E+38 ECU_ADDRESS 0x0000 /* @ECU_Address@SGSA_PhaseCCurrent@ */ /end MEASUREMENT
/begin MEASUREMENT SGSA_PhaseCCurrentAD "" FLOAT32_IEEE SigPreProcessor_CM_single 0 0 -3.4E+38 3.4E+38 MATRIX_DIM 1 1 ECU_ADDRESS 0x0000 /* @ECU_Address@SGSA_PhaseCCurrentAD@ */ /end MEASUREMENT
/begin MEASUREMENT SGSA_PhaseCSwitchTemp "" FLOAT32_IEEE SigPreProcessor_CM_single 0 0 -3.4E+38 3.4E+38 ECU_ADDRESS 0x0000 /* @ECU_Address@SGSA_PhaseCSwitchTemp@ */ /end MEASUREMENT
/begin MEASUREMENT SGSA_PhaseCSwitchTempAD "" FLOAT32_IEEE SigPreProcessor_CM_single 0 0 -3.4E+38 3.4E+38 ECU_ADDRESS 0x0000 /* @ECU_Address@SGSA_PhaseCSwitchTempAD@ */ /end MEASUREMENT
/begin MEASUREMENT SGSA_PwrChipVolt "" FLOAT32_IEEE SigPreProcessor_CM_single 0 0 -3.4E+38 3.4E+38 MATRIX_DIM 1 1 ECU_ADDRESS 0x0000 /* @ECU_Address@SGSA_PwrChipVolt@ */ /end MEASUREMENT
/begin MEASUREMENT SGSA_ResolverError "" UBYTE SigPreProcessor_CM_uint8 0 0 0 255 MATRIX_DIM 1 1 ECU_ADDRESS 0x0000 /* @ECU_Address@SGSA_ResolverError@ */ /end MEASUREMENT
/begin MEASUREMENT SGSA_SpeedCommand "" FLOAT32_IEEE SigPreProcessor_CM_single 0 0 -3.4E+38 3.4E+38 ECU_ADDRESS 0x0000 /* @ECU_Address@SGSA_SpeedCommand@ */ /end MEASUREMENT
/begin MEASUREMENT SigPreProcessor_DW.BareUnitDelay_DSTATE "" UBYTE SigPreProcessor_CM_uint8 0 0 0 255 ECU_ADDRESS 0x0000 /* @ECU_Address@SigPreProcessor_DW.BareUnitDelay_DSTATE@ */ /end MEASUREMENT
/begin MEASUREMENT SigPreProcessor_DW.Delay_DSTATE "" FLOAT32_IEEE SigPreProcessor_CM_single 0 0 -3.4E+38 3.4E+38 ECU_ADDRESS 0x0000 /* @ECU_Address@SigPreProcessor_DW.Delay_DSTATE@ */ /end MEASUREMENT
/begin MEASUREMENT SigPreProcessor_DW.Memory_PreviousInput "" UBYTE SigPreProcessor_CM_logical 0 0 0 1 ECU_ADDRESS 0x0000 /* @ECU_Address@SigPreProcessor_DW.Memory_PreviousInput@ */ /end MEASUREMENT
/begin MEASUREMENT SigPreProcessor_DW.UnitDelay_DSTATE "" FLOAT32_IEEE SigPreProcessor_CM_single 0 0 -3.4E+38 3.4E+38 ECU_ADDRESS 0x0000 /* @ECU_Address@SigPreProcessor_DW.UnitDelay_DSTATE@ */ /end MEASUREMENT
/begin MEASUREMENT SigPreProcessor_DW.UnitDelay_DSTATE_b "" FLOAT32_IEEE SigPreProcessor_CM_single 0 0 -3.4E+38 3.4E+38 ECU_ADDRESS 0x0000 /* @ECU_Address@SigPreProcessor_DW.UnitDelay_DSTATE_b@ */ /end MEASUREMENT
/begin MEASUREMENT SigPreProcessor_DW.UnitDelay_DSTATE_i "" UBYTE SigPreProcessor_CM_uint8 0 0 0 255 ECU_ADDRESS 0x0000 /* @ECU_Address@SigPreProcessor_DW.UnitDelay_DSTATE_i@ */ /end MEASUREMENT
/begin COMPU_METHOD SigPreProcessor_CM_EnumCtlMode "Enumerated data type: EnumCtlMode" TAB_VERB "%0.6" "" /* Conversion Table */ COMPU_TAB_REF VTAB_FOR_SigPreProcessor_CM_EnumCtlMode /end COMPU_METHOD
/begin COMPU_VTAB /* Name of Table */ VTAB_FOR_SigPreProcessor_CM_EnumCtlMode "Enumerated data type: EnumCtlMode" TAB_VERB /* Number of Elements */ 15 0 "Init" 1 "LowVoltReady" 2 "HighVoltStandby" 3 "Ready" 4 "HighVoltDischarge" 5 "LowVoltDischarge" 6 "Discharge" 7 "PowerDown" 8 "Fault" 9 "OpenLoopCtrl" 10 "VoltDirectCtrl" 11 "CurrCtrl" 12 "TorqueCtrl" 13 "SpeedCtrl" 14 "ZeroPointCal" /end COMPU_VTAB
/begin COMPU_METHOD SigPreProcessor_CM_boolean "Q = V" IDENTICAL "%1.0" "" /end COMPU_METHOD
/begin COMPU_METHOD SigPreProcessor_CM_logical "Q = V" IDENTICAL "%1.0" "" /end COMPU_METHOD
/begin COMPU_METHOD SigPreProcessor_CM_single "Q = V" IDENTICAL "%8.6" "" /end COMPU_METHOD
/begin COMPU_METHOD SigPreProcessor_CM_single_1_per_s "Q = V" IDENTICAL "%8.6" "1/s" /end COMPU_METHOD
/begin COMPU_METHOD SigPreProcessor_CM_single_A "Q = V" IDENTICAL "%8.6" "A" /end COMPU_METHOD
/begin COMPU_METHOD SigPreProcessor_CM_single_V "Q = V" IDENTICAL "%8.6" "V" /end COMPU_METHOD
/begin COMPU_METHOD SigPreProcessor_CM_single_dash_ "Q = V" IDENTICAL "%8.6" "-" /end COMPU_METHOD
/begin COMPU_METHOD SigPreProcessor_CM_single_percent_ "Q = V" IDENTICAL "%8.6" "%" /end COMPU_METHOD
/begin COMPU_METHOD SigPreProcessor_CM_single_rad "Q = V" IDENTICAL "%8.6" "rad" /end COMPU_METHOD
/begin COMPU_METHOD SigPreProcessor_CM_single_rad_per_s "Q = V" IDENTICAL "%8.6" "rad/s" /end COMPU_METHOD
/begin COMPU_METHOD SigPreProcessor_CM_single_rpm "Q = V" IDENTICAL "%8.6" "rpm" /end COMPU_METHOD
/begin COMPU_METHOD SigPreProcessor_CM_single_s "Q = V" IDENTICAL "%8.6" "s" /end COMPU_METHOD
/begin COMPU_METHOD SigPreProcessor_CM_uint8 "Q = V" IDENTICAL "%3.0" "" /end COMPU_METHOD
/begin COMPU_METHOD SigPreProcessor_CM_uint8_dash_ "Q = V" IDENTICAL "%3.0" "-" /end COMPU_METHOD
/begin RECORD_LAYOUT Record_BOOLEAN FNC_VALUES 1 UBYTE COLUMN_DIR DIRECT /end RECORD_LAYOUT
/begin RECORD_LAYOUT Record_FLOAT32_IEEE FNC_VALUES 1 FLOAT32_IEEE COLUMN_DIR DIRECT /end RECORD_LAYOUT
/begin RECORD_LAYOUT Record_UBYTE FNC_VALUES 1 UBYTE COLUMN_DIR DIRECT /end RECORD_LAYOUT
/begin GROUP SigPreProcessor "SigPreProcessor" /* Root */ ROOT
 /begin SUB_GROUP SigPreProcessor_SGPP_InitSystemParam_Init_sys SigPreProcessor_SGPP_ReadCmd_100us_sys SigPreProcessor_SGPP_ReadTempVolt_1ms_sys SigPreProcessor_SGPP_Read_100us_sys SigPreProcessor_SGPP_SpeedClc_96us_sys /end SUB_GROUP
 /begin REF_MEASUREMENT CTSO_OperationMode CTSO_SpeedCalcReset SGPP_BSW_u8_ASC_Enable SGPP_BSW_u8_ClearFlt_Roty_En SGPP_BSW_u8_ClearFlt_Volt_Curr_En SGPP_BSW_u8_CutOffDelayEn_flg SGPP_BSW_u8_PWM_Enable SGPP_FOC_f32_Uduty_Null SGPP_FOC_f32_Vduty_Null SGPP_FOC_f32_Wduty_Null SGPP_kFOC_f32_PWMFreq_Hz SGRD_CosEnvelope SGRD_EstTheta SGRD_PwmFreq SGRD_PwmTs SGRD_SinEnvelope SGSA_BatteryVolt SGSA_DcLinkVoltMeas SGSA_DcLinkVoltMeasAD SGSA_DriveErr SGSA_ElecAngle SGSA_HDriFault SGSA_HwOvercurSt SGSA_HwOvervoltSt SGSA_IgnitionVolt SGSA_LDriFault SGSA_MotorTemp1 SGSA_MotorTemp1AD SGSA_PWMSts SGSA_PhaseACurrent SGSA_PhaseACurrentAD SGSA_PhaseASwitchTemp SGSA_PhaseASwitchTempAD SGSA_PhaseBSwitchTemp SGSA_PhaseBSwitchTempAD SGSA_PhaseCCurrent SGSA_PhaseCCurrentAD SGSA_PhaseCSwitchTemp SGSA_PhaseCSwitchTempAD SGSA_PwrChipVolt SGSA_ResolverError SGSA_SpeedCommand /end REF_MEASUREMENT
/end GROUP
/begin GROUP SigPreProcessor_SGPP_InitSystemParam_Init_sys "SigPreProcessor/SGPP_InitSystemParam_Init_sys"
 /begin SUB_GROUP SigPreProcessor_SGPP_InitSystemParam_Init_sys_Parameter1 SigPreProcessor_SGPP_InitSystemParam_Init_sys_Parameter4 /end SUB_GROUP
 /begin REF_MEASUREMENT SigPreProcessor_ConstB.Constant1 SigPreProcessor_ConstB.Constant10 SigPreProcessor_ConstB.Constant11 SigPreProcessor_ConstB.Constant12 SigPreProcessor_ConstB.Constant13 SigPreProcessor_ConstB.Constant14 SigPreProcessor_ConstB.Constant15 SigPreProcessor_ConstB.Constant16 SigPreProcessor_ConstB.Constant19 SigPreProcessor_ConstB.Constant2 SigPreProcessor_ConstB.Constant20 SigPreProcessor_ConstB.Constant22 SigPreProcessor_ConstB.Constant23 SigPreProcessor_ConstB.Constant24 SigPreProcessor_ConstB.Constant25 SigPreProcessor_ConstB.Constant26 SigPreProcessor_ConstB.Constant27 SigPreProcessor_ConstB.Constant28 SigPreProcessor_ConstB.Constant29 SigPreProcessor_ConstB.Constant3 SigPreProcessor_ConstB.Constant30 SigPreProcessor_ConstB.Constant31 SigPreProcessor_ConstB.Constant32 SigPreProcessor_ConstB.Constant33 SigPreProcessor_ConstB.Constant34 SigPreProcessor_ConstB.Constant35 SigPreProcessor_ConstB.Constant36 SigPreProcessor_ConstB.Constant37 SigPreProcessor_ConstB.Constant38 SigPreProcessor_ConstB.Constant39 SigPreProcessor_ConstB.Constant4 SigPreProcessor_ConstB.Constant5 SigPreProcessor_ConstB.Constant6 SigPreProcessor_ConstB.Constant7 SigPreProcessor_ConstB.Constant8 SigPreProcessor_ConstB.Constant9 /end REF_MEASUREMENT
/end GROUP
/begin GROUP SigPreProcessor_SGPP_InitSystemParam_Init_sys_Parameter1 "SigPreProcessor/SGPP_InitSystemParam_Init_sys/Parameter1" /begin REF_CHARACTERISTIC SGPP_ResolverPolePairs_C /end REF_CHARACTERISTIC /end GROUP
/begin GROUP SigPreProcessor_SGPP_InitSystemParam_Init_sys_Parameter4 "SigPreProcessor/SGPP_InitSystemParam_Init_sys/Parameter4" /begin REF_CHARACTERISTIC SGPP_PolePairs_C /end REF_CHARACTERISTIC /end GROUP
/begin GROUP SigPreProcessor_SGPP_ReadCmd_100us_sys "SigPreProcessor/SGPP_ReadCmd_100us_sys"
 /begin SUB_GROUP SigPreProcessor_SGPP_ReadCmd_100us_sys_Parameter2 SigPreProcessor_SGPP_ReadCmd_100us_sys_Parameter3 SigPreProcessor_SGPP_ReadCmd_100us_sys_Parameter4 /end SUB_GROUP
 /begin REF_MEASUREMENT SGPP_BSW_u8_ClearFlt_Roty_En SGPP_FOC_f32_Uduty_Null SGPP_FOC_f32_Vduty_Null SGPP_FOC_f32_Wduty_Null /end REF_MEASUREMENT
/end GROUP
/begin GROUP SigPreProcessor_SGPP_ReadCmd_100us_sys_Parameter2 "SigPreProcessor/SGPP_ReadCmd_100us_sys/Parameter2" /begin REF_CHARACTERISTIC SGSA_ResolverFaultClr_C /end REF_CHARACTERISTIC /end GROUP
/begin GROUP SigPreProcessor_SGPP_ReadCmd_100us_sys_Parameter3 "SigPreProcessor/SGPP_ReadCmd_100us_sys/Parameter3" /begin REF_CHARACTERISTIC SGPP_ResolverFaultClrEnable_C /end REF_CHARACTERISTIC /end GROUP
/begin GROUP SigPreProcessor_SGPP_ReadCmd_100us_sys_Parameter4 "SigPreProcessor/SGPP_ReadCmd_100us_sys/Parameter4" /begin REF_CHARACTERISTIC SGPP_PhaseMappingConfig_C /end REF_CHARACTERISTIC /end GROUP
/begin GROUP SigPreProcessor_SGPP_ReadTempVolt_1ms_sys "SigPreProcessor/SGPP_ReadTempVolt_1ms_sys" /begin SUB_GROUP SigPreProcessor_SGPP_ReadTempVolt_1ms_sys_KL15StatusPrc /end SUB_GROUP
 /begin REF_MEASUREMENT SGSA_PhaseASwitchTemp SGSA_PhaseBSwitchTemp SGSA_PhaseCSwitchTemp /end REF_MEASUREMENT
/end GROUP
/begin GROUP SigPreProcessor_SGPP_ReadTempVolt_1ms_sys_KL15StatusPrc "SigPreProcessor/SGPP_ReadTempVolt_1ms_sys/KL15StatusPrc"
 /begin SUB_GROUP SigPreProcessor_SGPP_ReadTempVolt_1ms_sys_KL15StatusPrc_Debounce SigPreProcessor_SGPP_ReadTempVolt_1ms_sys_KL15StatusPrc_Parameter1 SigPreProcessor_SGPP_ReadTempVolt_1ms_sys_KL15StatusPrc_Parameter4 SigPreProcessor_SGPP_ReadTempVolt_1ms_sys_KL15StatusPrc_Parameter9 /end SUB_GROUP
 /begin REF_MEASUREMENT SGSA_IgnitionVolt /end REF_MEASUREMENT
/end GROUP
/begin GROUP SigPreProcessor_SGPP_ReadTempVolt_1ms_sys_KL15StatusPrc_Debounce "SigPreProcessor/SGPP_ReadTempVolt_1ms_sys/KL15StatusPrc/Debounce"
 /begin SUB_GROUP SigPreProcessor_SGPP_ReadTempVolt_1ms_sys_KL15StatusPrc_Debounce_Debounce SigPreProcessor_SGPP_ReadTempVolt_1ms_sys_KL15StatusPrc_Debounce_InitRest SigPreProcessor_SGPP_ReadTempVolt_1ms_sys_KL15StatusPrc_Debounce_Parameter6 /end SUB_GROUP
/end GROUP
/begin GROUP SigPreProcessor_SGPP_ReadTempVolt_1ms_sys_KL15StatusPrc_Debounce_Debounce "SigPreProcessor/SGPP_ReadTempVolt_1ms_sys/KL15StatusPrc/Debounce/Debounce"
 /begin SUB_GROUP SigPreProcessor_SGPP_ReadTempVolt_1ms_sys_KL15StatusPrc_Debounce_Debounce_Subsystem SigPreProcessor_SGPP_ReadTempVolt_1ms_sys_KL15StatusPrc_Debounce_Debounce_UnitDelay /end SUB_GROUP
/end GROUP
/begin GROUP SigPreProcessor_SGPP_ReadTempVolt_1ms_sys_KL15StatusPrc_Debounce_Debounce_Subsystem "SigPreProcessor/SGPP_ReadTempVolt_1ms_sys/KL15StatusPrc/Debounce/Debounce/Subsystem" /begin REF_MEASUREMENT SigPreProcessor_DW.Memory_PreviousInput /end REF_MEASUREMENT /end GROUP
/begin GROUP SigPreProcessor_SGPP_ReadTempVolt_1ms_sys_KL15StatusPrc_Debounce_Debounce_UnitDelay "SigPreProcessor/SGPP_ReadTempVolt_1ms_sys/KL15StatusPrc/Debounce/Debounce/UnitDelay" /begin REF_MEASUREMENT SigPreProcessor_DW.BareUnitDelay_DSTATE /end REF_MEASUREMENT /end GROUP
/begin GROUP SigPreProcessor_SGPP_ReadTempVolt_1ms_sys_KL15StatusPrc_Debounce_InitRest "SigPreProcessor/SGPP_ReadTempVolt_1ms_sys/KL15StatusPrc/Debounce/InitRest" /begin REF_MEASUREMENT SigPreProcessor_DW.UnitDelay_DSTATE_i /end REF_MEASUREMENT /end GROUP
/begin GROUP SigPreProcessor_SGPP_ReadTempVolt_1ms_sys_KL15StatusPrc_Debounce_Parameter6 "SigPreProcessor/SGPP_ReadTempVolt_1ms_sys/KL15StatusPrc/Debounce/Parameter6" /begin REF_CHARACTERISTIC SGPP_IgnitionVoltThrHigh_C /end REF_CHARACTERISTIC /end GROUP
/begin GROUP SigPreProcessor_SGPP_ReadTempVolt_1ms_sys_KL15StatusPrc_Parameter1 "SigPreProcessor/SGPP_ReadTempVolt_1ms_sys/KL15StatusPrc/Parameter1" /begin REF_CHARACTERISTIC SGPP_IgnitionStatus_C /end REF_CHARACTERISTIC /end GROUP
/begin GROUP SigPreProcessor_SGPP_ReadTempVolt_1ms_sys_KL15StatusPrc_Parameter4 "SigPreProcessor/SGPP_ReadTempVolt_1ms_sys/KL15StatusPrc/Parameter4" /begin REF_CHARACTERISTIC SGPP_IgnitionStatusSource_C /end REF_CHARACTERISTIC /end GROUP
/begin GROUP SigPreProcessor_SGPP_ReadTempVolt_1ms_sys_KL15StatusPrc_Parameter9 "SigPreProcessor/SGPP_ReadTempVolt_1ms_sys/KL15StatusPrc/Parameter9" /begin REF_CHARACTERISTIC SGPP_IgnitionVoltThreshold_C /end REF_CHARACTERISTIC /end GROUP
/begin GROUP SigPreProcessor_SGPP_Read_100us_sys "SigPreProcessor/SGPP_Read_100us_sys"
 /begin SUB_GROUP SigPreProcessor_SGPP_Read_100us_sys_AngleClc SigPreProcessor_SGPP_Read_100us_sys_CurrentMapAndFilter SigPreProcessor_SGPP_Read_100us_sys_ResolverFault SigPreProcessor_SGPP_Read_100us_sys_TsSignals /end SUB_GROUP
/end GROUP
/begin GROUP SigPreProcessor_SGPP_Read_100us_sys_AngleClc "SigPreProcessor/SGPP_Read_100us_sys/AngleClc" /begin SUB_GROUP SigPreProcessor_SGPP_Read_100us_sys_AngleClc_Parameter4 /end SUB_GROUP /end GROUP
/begin GROUP SigPreProcessor_SGPP_Read_100us_sys_AngleClc_Parameter4 "SigPreProcessor/SGPP_Read_100us_sys/AngleClc/Parameter4" /begin REF_CHARACTERISTIC SGPP_AngleSourceSelect_C /end REF_CHARACTERISTIC /end GROUP
/begin GROUP SigPreProcessor_SGPP_Read_100us_sys_CurrentMapAndFilter "SigPreProcessor/SGPP_Read_100us_sys/CurrentMapAndFilter"
 /begin SUB_GROUP SigPreProcessor_SGPP_Read_100us_sys_CurrentMapAndFilter_Parameter4 /end SUB_GROUP
 /begin REF_MEASUREMENT SGSA_PhaseACurrent SGSA_PhaseCCurrent /end REF_MEASUREMENT
/end GROUP
/begin GROUP SigPreProcessor_SGPP_Read_100us_sys_CurrentMapAndFilter_Parameter4 "SigPreProcessor/SGPP_Read_100us_sys/CurrentMapAndFilter/Parameter4" /begin REF_CHARACTERISTIC SGPP_PhaseMappingConfig_C /end REF_CHARACTERISTIC /end GROUP
/begin GROUP SigPreProcessor_SGPP_Read_100us_sys_ResolverFault "SigPreProcessor/SGPP_Read_100us_sys/ResolverFault" /begin REF_MEASUREMENT SGSA_ResolverError /end REF_MEASUREMENT /end GROUP
/begin GROUP SigPreProcessor_SGPP_Read_100us_sys_TsSignals "SigPreProcessor/SGPP_Read_100us_sys/TsSignals" /begin REF_MEASUREMENT SGRD_PwmFreq SGRD_PwmTs /end REF_MEASUREMENT /end GROUP
/begin GROUP SigPreProcessor_SGPP_SpeedClc_96us_sys "SigPreProcessor/SGPP_SpeedClc_96us_sys"
 /begin SUB_GROUP SigPreProcessor_SGPP_SpeedClc_96us_sys_SpeedEstimationAndCmdFilter /end SUB_GROUP
/end GROUP
/begin GROUP SigPreProcessor_SGPP_SpeedClc_96us_sys_SpeedEstimationAndCmdFilter "SigPreProcessor/SGPP_SpeedClc_96us_sys/SpeedEstimationAndCmdFilter"
 /begin SUB_GROUP SigPreProcessor_SGPP_SpeedClc_96us_sys_SpeedEstimationAndCmdFilter_Variant_Subsystem /end SUB_GROUP
/end GROUP
/begin GROUP SigPreProcessor_SGPP_SpeedClc_96us_sys_SpeedEstimationAndCmdFilter_Variant_Subsystem "SigPreProcessor/SGPP_SpeedClc_96us_sys/SpeedEstimationAndCmdFilter/Variant Subsystem"
 /begin SUB_GROUP SigPreProcessor_SGPP_SpeedClc_96us_sys_SpeedEstimationAndCmdFilter_Variant_Subsystem_XCU_Code /end SUB_GROUP
/end GROUP
/begin GROUP SigPreProcessor_SGPP_SpeedClc_96us_sys_SpeedEstimationAndCmdFilter_Variant_Subsystem_XCU_Code "SigPreProcessor/SGPP_SpeedClc_96us_sys/SpeedEstimationAndCmdFilter/Variant Subsystem/XCU_Code"
 /begin SUB_GROUP SigPreProcessor_SGPP_SpeedClc_96us_sys_SpeedEstimationAndCmdFilter_Variant_Subsystem_XCU_Code_Local_Variable_Storage SigPreProcessor_SGPP_SpeedClc_96us_sys_SpeedEstimationAndCmdFilter_Variant_Subsystem_XCU_Code_Local_Variable_Storage1 SigPreProcessor_SGPP_SpeedClc_96us_sys_SpeedEstimationAndCmdFilter_Variant_Subsystem_XCU_Code_LowPassFilter SigPreProcessor_SGPP_SpeedClc_96us_sys_SpeedEstimationAndCmdFilter_Variant_Subsystem_XCU_Code_Parameter1 SigPreProcessor_SGPP_SpeedClc_96us_sys_SpeedEstimationAndCmdFilter_Variant_Subsystem_XCU_Code_Parameter2 SigPreProcessor_SGPP_SpeedClc_96us_sys_SpeedEstimationAndCmdFilter_Variant_Subsystem_XCU_Code_Parameter4 SigPreProcessor_SGPP_SpeedClc_96us_sys_SpeedEstimationAndCmdFilter_Variant_Subsystem_XCU_Code_ResolverSignalEmulation SigPreProcessor_SGPP_SpeedClc_96us_sys_SpeedEstimationAndCmdFilter_Variant_Subsystem_XCU_Code_ThetaSensor /end SUB_GROUP
 /begin REF_MEASUREMENT SGPP_PolePairsReciprocal_IRV /end REF_MEASUREMENT
/end GROUP
/begin GROUP SigPreProcessor_SGPP_SpeedClc_96us_sys_SpeedEstimationAndCmdFilter_Variant_Subsystem_XCU_Code_Local_Variable_Storage "SigPreProcessor/SGPP_SpeedClc_96us_sys/SpeedEstimationAndCmdFilter/Variant Subsystem/XCU_Code/Local Variable Storage" /begin REF_MEASUREMENT SGPP_ElecSpeedBeforeFilter /end REF_MEASUREMENT /end GROUP
/begin GROUP SigPreProcessor_SGPP_SpeedClc_96us_sys_SpeedEstimationAndCmdFilter_Variant_Subsystem_XCU_Code_Local_Variable_Storage1 "SigPreProcessor/SGPP_SpeedClc_96us_sys/SpeedEstimationAndCmdFilter/Variant Subsystem/XCU_Code/Local Variable Storage1" /begin REF_MEASUREMENT SGPP_ElecSpeedAfterFilter /end REF_MEASUREMENT /end GROUP
/begin GROUP SigPreProcessor_SGPP_SpeedClc_96us_sys_SpeedEstimationAndCmdFilter_Variant_Subsystem_XCU_Code_LowPassFilter "SigPreProcessor/SGPP_SpeedClc_96us_sys/SpeedEstimationAndCmdFilter/Variant Subsystem/XCU_Code/LowPassFilter" /begin REF_MEASUREMENT SigPreProcessor_DW.Delay_DSTATE /end REF_MEASUREMENT /end GROUP
/begin GROUP SigPreProcessor_SGPP_SpeedClc_96us_sys_SpeedEstimationAndCmdFilter_Variant_Subsystem_XCU_Code_Parameter1 "SigPreProcessor/SGPP_SpeedClc_96us_sys/SpeedEstimationAndCmdFilter/Variant Subsystem/XCU_Code/Parameter1" /begin REF_CHARACTERISTIC SGPP_MechSpeedFilterFreq_C /end REF_CHARACTERISTIC /end GROUP
/begin GROUP SigPreProcessor_SGPP_SpeedClc_96us_sys_SpeedEstimationAndCmdFilter_Variant_Subsystem_XCU_Code_Parameter2 "SigPreProcessor/SGPP_SpeedClc_96us_sys/SpeedEstimationAndCmdFilter/Variant Subsystem/XCU_Code/Parameter2" /begin REF_CHARACTERISTIC SGPP_SetSpeed_C /end REF_CHARACTERISTIC /end GROUP
/begin GROUP SigPreProcessor_SGPP_SpeedClc_96us_sys_SpeedEstimationAndCmdFilter_Variant_Subsystem_XCU_Code_Parameter4 "SigPreProcessor/SGPP_SpeedClc_96us_sys/SpeedEstimationAndCmdFilter/Variant Subsystem/XCU_Code/Parameter4" /begin REF_CHARACTERISTIC SGPP_AngleSourceSelect_C /end REF_CHARACTERISTIC /end GROUP
/begin GROUP SigPreProcessor_SGPP_SpeedClc_96us_sys_SpeedEstimationAndCmdFilter_Variant_Subsystem_XCU_Code_ResolverSignalEmulation "SigPreProcessor/SGPP_SpeedClc_96us_sys/SpeedEstimationAndCmdFilter/Variant Subsystem/XCU_Code/ResolverSignalEmulation" /begin REF_MEASUREMENT SGPP_PolePairs_IRV SigPreProcessor_DW.UnitDelay_DSTATE /end REF_MEASUREMENT /end GROUP
/begin GROUP SigPreProcessor_SGPP_SpeedClc_96us_sys_SpeedEstimationAndCmdFilter_Variant_Subsystem_XCU_Code_ThetaSensor "SigPreProcessor/SGPP_SpeedClc_96us_sys/SpeedEstimationAndCmdFilter/Variant Subsystem/XCU_Code/ThetaSensor" /begin REF_MEASUREMENT SigPreProcessor_DW.UnitDelay_DSTATE_b /end REF_MEASUREMENT /end GROUP
/end MODULE
/end PROJECT
/* (add any file trailer comments here) */
/* EOF SigPreProcessor.a2l*/
