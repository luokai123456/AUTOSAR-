/******************************************************************************
* ASAP2 file: TrfPWMModulator.a2l
* Code generation for model "TrfPWMModulator".
* Model version : 1.17
* Simulink Coder version : 10.6 R2022b
* C source code generated on : Thu May 28 16:27:24 2026
* Target selection: ert.tlc
* Embedded hardware selection: Infineon->TriCore
* Code generation objectives: Unspecified
* Validation result: Not run
* (add additional file header information here)
******************************************************************************/ ASAP2_VERSION 1 31
/* Version 1.31 */
/begin PROJECT ProjectName "Project Comment Goes Here"
/begin HEADER "Header Comments go here" /end HEADER
/begin MODULE ModuleName "Module Comment Goes Here"
/begin MOD_PAR "MOD PAR Comment Goes Here" /end MOD_PAR
/begin MOD_COMMON "Mod Common Comment Here" BYTE_ORDER MSB_LAST ALIGNMENT_BYTE 1 ALIGNMENT_WORD 2 ALIGNMENT_LONG 4 ALIGNMENT_FLOAT32_IEEE 4 ALIGNMENT_FLOAT64_IEEE 4 /end MOD_COMMON
/begin CHARACTERISTIC TFPM_DutyLowerLimit_C "Lower limit for duty cycle saturation" VALUE 0x0000 /* @ECU_Address@TFPM_DutyLowerLimit_C@ */ Record_FLOAT32_IEEE 0 TrfPWMModulator_CM_single_dash_ -100.000000 100.000000 /end CHARACTERISTIC
/begin CHARACTERISTIC TFPM_DutyUpperLimit_C "Upper limit for duty cycle saturation" VALUE 0x0000 /* @ECU_Address@TFPM_DutyUpperLimit_C@ */ Record_FLOAT32_IEEE 0 TrfPWMModulator_CM_single_dash_ -100.000000 100.000000 /end CHARACTERISTIC
/begin CHARACTERISTIC TFPM_HighSideSwitchSel_C "Switch side selection: 1=high-side, 0=low-side" VALUE 0x0000 /* @ECU_Address@TFPM_HighSideSwitchSel_C@ */ Record_UBYTE 0 TrfPWMModulator_CM_uint8_dash_ 0.000000 255.000000 /end CHARACTERISTIC
/begin CHARACTERISTIC TFPM_MinSwitchTime_C "Minimum switching time constraint" VALUE 0x0000 /* @ECU_Address@TFPM_MinSwitchTime_C@ */ Record_FLOAT32_IEEE 0 TrfPWMModulator_CM_single_ns 0.000000 50000.000000 /end CHARACTERISTIC
/begin MEASUREMENT CTSO_OperationMode "" UBYTE TrfPWMModulator_CM_EnumCtlMode 0 0 0 14 ECU_ADDRESS 0x0000 /* @ECU_Address@CTSO_OperationMode@ */ /end MEASUREMENT
/begin MEASUREMENT SGPP_DcLinkVoltReciprocal "" FLOAT32_IEEE TrfPWMModulator_CM_single 0 0 -3.4E+38 3.4E+38 ECU_ADDRESS 0x0000 /* @ECU_Address@SGPP_DcLinkVoltReciprocal@ */ /end MEASUREMENT
/begin MEASUREMENT SGPP_SampleTime1Reciprocal "" FLOAT32_IEEE TrfPWMModulator_CM_single 0 0 -3.4E+38 3.4E+38 ECU_ADDRESS 0x0000 /* @ECU_Address@SGPP_SampleTime1Reciprocal@ */ /end MEASUREMENT
/begin MEASUREMENT SVOL_OpenLoopAlphaVolt "" FLOAT32_IEEE TrfPWMModulator_CM_single_V 0 0 -3.4E+38 3.4E+38 ECU_ADDRESS 0x0000 /* @ECU_Address@SVOL_OpenLoopAlphaVolt@ */ /end MEASUREMENT
/begin MEASUREMENT SVOL_OpenLoopBetaVolt "" FLOAT32_IEEE TrfPWMModulator_CM_single_V 0 0 -3.4E+38 3.4E+38 ECU_ADDRESS 0x0000 /* @ECU_Address@SVOL_OpenLoopBetaVolt@ */ /end MEASUREMENT
/begin MEASUREMENT TFDA_AlphaVoltSp "" FLOAT32_IEEE TrfPWMModulator_CM_single_V 0 0 -3.4E+38 3.4E+38 ECU_ADDRESS 0x0000 /* @ECU_Address@TFDA_AlphaVoltSp@ */ /end MEASUREMENT
/begin MEASUREMENT TFDA_BetaVoltSp "" FLOAT32_IEEE TrfPWMModulator_CM_single_V 0 0 -3.4E+38 3.4E+38 ECU_ADDRESS 0x0000 /* @ECU_Address@TFDA_BetaVoltSp@ */ /end MEASUREMENT
/begin MEASUREMENT TFEC_PhaseACompVolt "" FLOAT32_IEEE TrfPWMModulator_CM_single 0 0 -3.4E+38 3.4E+38 ECU_ADDRESS 0x0000 /* @ECU_Address@TFEC_PhaseACompVolt@ */ /end MEASUREMENT
/begin MEASUREMENT TFEC_PhaseBCompVolt "" FLOAT32_IEEE TrfPWMModulator_CM_single 0 0 -3.4E+38 3.4E+38 ECU_ADDRESS 0x0000 /* @ECU_Address@TFEC_PhaseBCompVolt@ */ /end MEASUREMENT
/begin MEASUREMENT TFEC_PhaseCCompVolt "" FLOAT32_IEEE TrfPWMModulator_CM_single 0 0 -3.4E+38 3.4E+38 ECU_ADDRESS 0x0000 /* @ECU_Address@TFEC_PhaseCCompVolt@ */ /end MEASUREMENT
/begin MEASUREMENT TFPM_AlphaVoltNorm "Normalized alpha-axis voltage relative to DC-link" FLOAT32_IEEE TrfPWMModulator_CM_single_dash_ 0 0 -2.000000 2.000000 ECU_ADDRESS 0x0000 /* @ECU_Address@TFPM_AlphaVoltNorm@ */ /end MEASUREMENT
/begin MEASUREMENT TFPM_AlphaVoltSp "Alpha-axis voltage setpoint" FLOAT32_IEEE TrfPWMModulator_CM_single_V 0 0 -5000.000000 5000.000000 ECU_ADDRESS 0x0000 /* @ECU_Address@TFPM_AlphaVoltSp@ */ /end MEASUREMENT
/begin MEASUREMENT TFPM_BetaVoltNorm "Normalized beta-axis voltage relative to DC-link" FLOAT32_IEEE TrfPWMModulator_CM_single_dash_ 0 0 -2.000000 2.000000 ECU_ADDRESS 0x0000 /* @ECU_Address@TFPM_BetaVoltNorm@ */ /end MEASUREMENT
/begin MEASUREMENT TFPM_BetaVoltSp "Beta-axis voltage setpoint" FLOAT32_IEEE TrfPWMModulator_CM_single_V 0 0 -5000.000000 5000.000000 ECU_ADDRESS 0x0000 /* @ECU_Address@TFPM_BetaVoltSp@ */ /end MEASUREMENT
/begin MEASUREMENT TFPM_MinSwitchTimeRel "Relative minimum switching time value" FLOAT32_IEEE TrfPWMModulator_CM_single_dash_ 0 0 -3.4E+38 3.4E+38 ECU_ADDRESS 0x0000 /* @ECU_Address@TFPM_MinSwitchTimeRel@ */ /end MEASUREMENT
/begin MEASUREMENT TFPM_PhaseACompDutyLim "Phase A compensated duty cycle with limiting" FLOAT32_IEEE TrfPWMModulator_CM_single_dash_ 0 0 -3.4E+38 3.4E+38 ECU_ADDRESS 0x0000 /* @ECU_Address@TFPM_PhaseACompDutyLim@ */ /end MEASUREMENT
/begin MEASUREMENT TFPM_PhaseADuty "Phase A PWM duty cycle output" FLOAT32_IEEE TrfPWMModulator_CM_single_percent_ 0 0 0.000000 100.000000 ECU_ADDRESS 0x0000 /* @ECU_Address@TFPM_PhaseADuty@ */ /end MEASUREMENT
/begin MEASUREMENT TFPM_PhaseADutyRel "Phase A relative duty cycle value" FLOAT32_IEEE TrfPWMModulator_CM_single_dash_ 0 0 -3.4E+38 3.4E+38 ECU_ADDRESS 0x0000 /* @ECU_Address@TFPM_PhaseADutyRel@ */ /end MEASUREMENT
/begin MEASUREMENT TFPM_PhaseASvmDuty "Phase A space vector modulation duty cycle" FLOAT32_IEEE TrfPWMModulator_CM_single_dash_ 0 0 -3.4E+38 3.4E+38 ECU_ADDRESS 0x0000 /* @ECU_Address@TFPM_PhaseASvmDuty@ */ /end MEASUREMENT
/begin MEASUREMENT TFPM_PhaseAVoltNorm "Phase A normalized voltage after modulation" FLOAT32_IEEE TrfPWMModulator_CM_single_dash_ 0 0 -2.000000 2.000000 ECU_ADDRESS 0x0000 /* @ECU_Address@TFPM_PhaseAVoltNorm@ */ /end MEASUREMENT
/begin MEASUREMENT TFPM_PhaseBCompDutyLim "Phase B compensated duty cycle with limiting" FLOAT32_IEEE TrfPWMModulator_CM_single_dash_ 0 0 -3.4E+38 3.4E+38 ECU_ADDRESS 0x0000 /* @ECU_Address@TFPM_PhaseBCompDutyLim@ */ /end MEASUREMENT
/begin MEASUREMENT TFPM_PhaseBDuty "Phase B PWM duty cycle output" FLOAT32_IEEE TrfPWMModulator_CM_single_percent_ 0 0 0.000000 100.000000 ECU_ADDRESS 0x0000 /* @ECU_Address@TFPM_PhaseBDuty@ */ /end MEASUREMENT
/begin MEASUREMENT TFPM_PhaseBDutyRel "Phase B relative duty cycle value" FLOAT32_IEEE TrfPWMModulator_CM_single_dash_ 0 0 -3.4E+38 3.4E+38 ECU_ADDRESS 0x0000 /* @ECU_Address@TFPM_PhaseBDutyRel@ */ /end MEASUREMENT
/begin MEASUREMENT TFPM_PhaseBSvmDuty "Phase B space vector modulation duty cycle" FLOAT32_IEEE TrfPWMModulator_CM_single_dash_ 0 0 -3.4E+38 3.4E+38 ECU_ADDRESS 0x0000 /* @ECU_Address@TFPM_PhaseBSvmDuty@ */ /end MEASUREMENT
/begin MEASUREMENT TFPM_PhaseBVoltNorm "Phase B normalized voltage after modulation" FLOAT32_IEEE TrfPWMModulator_CM_single_dash_ 0 0 -2.000000 2.000000 ECU_ADDRESS 0x0000 /* @ECU_Address@TFPM_PhaseBVoltNorm@ */ /end MEASUREMENT
/begin MEASUREMENT TFPM_PhaseCCompDutyLim "Phase C compensated duty cycle with limiting" FLOAT32_IEEE TrfPWMModulator_CM_single_dash_ 0 0 -3.4E+38 3.4E+38 ECU_ADDRESS 0x0000 /* @ECU_Address@TFPM_PhaseCCompDutyLim@ */ /end MEASUREMENT
/begin MEASUREMENT TFPM_PhaseCDuty "Phase C PWM duty cycle output" FLOAT32_IEEE TrfPWMModulator_CM_single_percent_ 0 0 0.000000 100.000000 ECU_ADDRESS 0x0000 /* @ECU_Address@TFPM_PhaseCDuty@ */ /end MEASUREMENT
/begin MEASUREMENT TFPM_PhaseCDutyRel "Phase C relative duty cycle value" FLOAT32_IEEE TrfPWMModulator_CM_single_dash_ 0 0 -3.4E+38 3.4E+38 ECU_ADDRESS 0x0000 /* @ECU_Address@TFPM_PhaseCDutyRel@ */ /end MEASUREMENT
/begin MEASUREMENT TFPM_PhaseCLvmDuty "Phase C space vector modulation duty cycle" FLOAT32_IEEE TrfPWMModulator_CM_single_dash_ 0 0 -3.4E+38 3.4E+38 ECU_ADDRESS 0x0000 /* @ECU_Address@TFPM_PhaseCLvmDuty@ */ /end MEASUREMENT
/begin MEASUREMENT TFPM_PhaseCVoltNorm "Phase C normalized voltage after modulation" FLOAT32_IEEE TrfPWMModulator_CM_single_dash_ 0 0 -2.000000 2.000000 ECU_ADDRESS 0x0000 /* @ECU_Address@TFPM_PhaseCVoltNorm@ */ /end MEASUREMENT
/begin MEASUREMENT TFPM_ThreePhaseVoltMid "Mid-point normalized voltage among three phases" FLOAT32_IEEE TrfPWMModulator_CM_single_dash_ 0 0 -20.000000 20.000000 ECU_ADDRESS 0x0000 /* @ECU_Address@TFPM_ThreePhaseVoltMid@ */ /end MEASUREMENT
/begin COMPU_METHOD TrfPWMModulator_CM_EnumCtlMode "Enumerated data type: EnumCtlMode" TAB_VERB "%0.6" "" /* Conversion Table */ COMPU_TAB_REF VTAB_FOR_TrfPWMModulator_CM_EnumCtlMode /end COMPU_METHOD
/begin COMPU_VTAB /* Name of Table */ VTAB_FOR_TrfPWMModulator_CM_EnumCtlMode "Enumerated data type: EnumCtlMode" TAB_VERB /* Number of Elements */ 15 0 "Init" 1 "LowVoltReady" 2 "HighVoltStandby" 3 "Ready" 4 "HighVoltDischarge" 5 "LowVoltDischarge" 6 "Discharge" 7 "PowerDown" 8 "Fault" 9 "OpenLoopCtrl" 10 "VoltDirectCtrl" 11 "CurrCtrl" 12 "TorqueCtrl" 13 "SpeedCtrl" 14 "ZeroPointCal" /end COMPU_VTAB
/begin COMPU_METHOD TrfPWMModulator_CM_single "Q = V" RAT_FUNC "%8.6" "" COEFFS 0 1 0 0 0 1 /end COMPU_METHOD
/begin COMPU_METHOD TrfPWMModulator_CM_single_V "Q = V" RAT_FUNC "%8.6" "V" COEFFS 0 1 0 0 0 1 /end COMPU_METHOD
/begin COMPU_METHOD TrfPWMModulator_CM_single_dash_ "Q = V" RAT_FUNC "%8.6" "-" COEFFS 0 1 0 0 0 1 /end COMPU_METHOD
/begin COMPU_METHOD TrfPWMModulator_CM_single_ns "Q = V" RAT_FUNC "%8.6" "ns" COEFFS 0 1 0 0 0 1 /end COMPU_METHOD
/begin COMPU_METHOD TrfPWMModulator_CM_single_percent_ "Q = V" RAT_FUNC "%8.6" "%" COEFFS 0 1 0 0 0 1 /end COMPU_METHOD
/begin COMPU_METHOD TrfPWMModulator_CM_uint8_dash_ "Q = V" RAT_FUNC "%3.0" "-" COEFFS 0 1 0 0 0 1 /end COMPU_METHOD
/begin RECORD_LAYOUT Record_FLOAT32_IEEE FNC_VALUES 1 FLOAT32_IEEE COLUMN_DIR DIRECT /end RECORD_LAYOUT
/begin RECORD_LAYOUT Record_UBYTE FNC_VALUES 1 UBYTE COLUMN_DIR DIRECT /end RECORD_LAYOUT
/begin GROUP TrfPWMModulator "TrfPWMModulator" /* Root */ ROOT /begin SUB_GROUP TrfPWMModulator_TFPM_ModulatePwm_100us_sys /end SUB_GROUP
 /begin REF_MEASUREMENT CTSO_OperationMode SGPP_DcLinkVoltReciprocal SGPP_SampleTime1Reciprocal SVOL_OpenLoopAlphaVolt SVOL_OpenLoopBetaVolt TFDA_AlphaVoltSp TFDA_BetaVoltSp TFEC_PhaseACompVolt TFEC_PhaseBCompVolt TFEC_PhaseCCompVolt /end REF_MEASUREMENT
/end GROUP
/begin GROUP TrfPWMModulator_TFPM_ModulatePwm_100us_sys "TrfPWMModulator/TFPM_ModulatePwm_100us_sys"
 /begin SUB_GROUP TrfPWMModulator_TFPM_ModulatePwm_100us_sys_AlphaBetaToPhaseRefAndNormalize TrfPWMModulator_TFPM_ModulatePwm_100us_sys_DutySynthesis /end SUB_GROUP
/end GROUP
/begin GROUP TrfPWMModulator_TFPM_ModulatePwm_100us_sys_AlphaBetaToPhaseRefAndNormalize "TrfPWMModulator/TFPM_ModulatePwm_100us_sys/AlphaBetaToPhaseRefAndNormalize"
 /begin SUB_GROUP TrfPWMModulator_TFPM_ModulatePwm_100us_sys_AlphaBetaToPhaseRefAndNormalize_AlphaBetaModeSelect TrfPWMModulator_TFPM_ModulatePwm_100us_sys_AlphaBetaToPhaseRefAndNormalize_AlphaBetaToPhaseRef TrfPWMModulator_TFPM_ModulatePwm_100us_sys_AlphaBetaToPhaseRefAndNormalize_Normalize /end SUB_GROUP
/end GROUP
/begin GROUP TrfPWMModulator_TFPM_ModulatePwm_100us_sys_AlphaBetaToPhaseRefAndNormalize_AlphaBetaModeSelect "TrfPWMModulator/TFPM_ModulatePwm_100us_sys/AlphaBetaToPhaseRefAndNormalize/AlphaBetaModeSelect"
 /begin SUB_GROUP TrfPWMModulator_TFPM_ModulatePwm_100us_sys_AlphaBetaToPhaseRefAndNormalize_AlphaBetaModeSelect_Local_Variable_Storage TrfPWMModulator_TFPM_ModulatePwm_100us_sys_AlphaBetaToPhaseRefAndNormalize_AlphaBetaModeSelect_Local_Variable_Storage1 /end SUB_GROUP
 /begin REF_MEASUREMENT CTSO_OperationMode /end REF_MEASUREMENT
/end GROUP
/begin GROUP TrfPWMModulator_TFPM_ModulatePwm_100us_sys_AlphaBetaToPhaseRefAndNormalize_AlphaBetaModeSelect_Local_Variable_Storage "TrfPWMModulator/TFPM_ModulatePwm_100us_sys/AlphaBetaToPhaseRefAndNormalize/AlphaBetaModeSelect/Local Variable Storage" /begin REF_MEASUREMENT TFPM_AlphaVoltSp /end REF_MEASUREMENT /end GROUP
/begin GROUP TrfPWMModulator_TFPM_ModulatePwm_100us_sys_AlphaBetaToPhaseRefAndNormalize_AlphaBetaModeSelect_Local_Variable_Storage1 "TrfPWMModulator/TFPM_ModulatePwm_100us_sys/AlphaBetaToPhaseRefAndNormalize/AlphaBetaModeSelect/Local Variable Storage1" /begin REF_MEASUREMENT TFPM_BetaVoltSp /end REF_MEASUREMENT /end GROUP
/begin GROUP TrfPWMModulator_TFPM_ModulatePwm_100us_sys_AlphaBetaToPhaseRefAndNormalize_AlphaBetaToPhaseRef "TrfPWMModulator/TFPM_ModulatePwm_100us_sys/AlphaBetaToPhaseRefAndNormalize/AlphaBetaToPhaseRef"
 /begin SUB_GROUP TrfPWMModulator_TFPM_ModulatePwm_100us_sys_AlphaBetaToPhaseRefAndNormalize_AlphaBetaToPhaseRef_Local_Variable_Storage TrfPWMModulator_TFPM_ModulatePwm_100us_sys_AlphaBetaToPhaseRefAndNormalize_AlphaBetaToPhaseRef_Local_Variable_Storage1 TrfPWMModulator_TFPM_ModulatePwm_100us_sys_AlphaBetaToPhaseRefAndNormalize_AlphaBetaToPhaseRef_Local_Variable_Storage2 /end SUB_GROUP
/end GROUP
/begin GROUP TrfPWMModulator_TFPM_ModulatePwm_100us_sys_AlphaBetaToPhaseRefAndNormalize_AlphaBetaToPhaseRef_Local_Variable_Storage "TrfPWMModulator/TFPM_ModulatePwm_100us_sys/AlphaBetaToPhaseRefAndNormalize/AlphaBetaToPhaseRef/Local Variable Storage" /begin REF_MEASUREMENT TFPM_PhaseCVoltNorm /end REF_MEASUREMENT /end GROUP
/begin GROUP TrfPWMModulator_TFPM_ModulatePwm_100us_sys_AlphaBetaToPhaseRefAndNormalize_AlphaBetaToPhaseRef_Local_Variable_Storage1 "TrfPWMModulator/TFPM_ModulatePwm_100us_sys/AlphaBetaToPhaseRefAndNormalize/AlphaBetaToPhaseRef/Local Variable Storage1" /begin REF_MEASUREMENT TFPM_PhaseBVoltNorm /end REF_MEASUREMENT /end GROUP
/begin GROUP TrfPWMModulator_TFPM_ModulatePwm_100us_sys_AlphaBetaToPhaseRefAndNormalize_AlphaBetaToPhaseRef_Local_Variable_Storage2 "TrfPWMModulator/TFPM_ModulatePwm_100us_sys/AlphaBetaToPhaseRefAndNormalize/AlphaBetaToPhaseRef/Local Variable Storage2" /begin REF_MEASUREMENT TFPM_PhaseAVoltNorm /end REF_MEASUREMENT /end GROUP
/begin GROUP TrfPWMModulator_TFPM_ModulatePwm_100us_sys_AlphaBetaToPhaseRefAndNormalize_Normalize "TrfPWMModulator/TFPM_ModulatePwm_100us_sys/AlphaBetaToPhaseRefAndNormalize/Normalize"
 /begin SUB_GROUP TrfPWMModulator_TFPM_ModulatePwm_100us_sys_AlphaBetaToPhaseRefAndNormalize_Normalize_Local_Variable_Storage TrfPWMModulator_TFPM_ModulatePwm_100us_sys_AlphaBetaToPhaseRefAndNormalize_Normalize_Local_Variable_Storage1 TrfPWMModulator_TFPM_ModulatePwm_100us_sys_AlphaBetaToPhaseRefAndNormalize_Normalize_Local_Variable_Storage2 TrfPWMModulator_TFPM_ModulatePwm_100us_sys_AlphaBetaToPhaseRefAndNormalize_Normalize_Local_Variable_Storage3 TrfPWMModulator_TFPM_ModulatePwm_100us_sys_AlphaBetaToPhaseRefAndNormalize_Normalize_Local_Variable_Storage4 /end SUB_GROUP
 /begin REF_MEASUREMENT SGPP_DcLinkVoltReciprocal TFEC_PhaseACompVolt TFEC_PhaseBCompVolt TFEC_PhaseCCompVolt /end REF_MEASUREMENT
/end GROUP
/begin GROUP TrfPWMModulator_TFPM_ModulatePwm_100us_sys_AlphaBetaToPhaseRefAndNormalize_Normalize_Local_Variable_Storage "TrfPWMModulator/TFPM_ModulatePwm_100us_sys/AlphaBetaToPhaseRefAndNormalize/Normalize/Local Variable Storage" /begin REF_MEASUREMENT TFPM_AlphaVoltNorm /end REF_MEASUREMENT /end GROUP
/begin GROUP TrfPWMModulator_TFPM_ModulatePwm_100us_sys_AlphaBetaToPhaseRefAndNormalize_Normalize_Local_Variable_Storage1 "TrfPWMModulator/TFPM_ModulatePwm_100us_sys/AlphaBetaToPhaseRefAndNormalize/Normalize/Local Variable Storage1" /begin REF_MEASUREMENT TFPM_BetaVoltNorm /end REF_MEASUREMENT /end GROUP
/begin GROUP TrfPWMModulator_TFPM_ModulatePwm_100us_sys_AlphaBetaToPhaseRefAndNormalize_Normalize_Local_Variable_Storage2 "TrfPWMModulator/TFPM_ModulatePwm_100us_sys/AlphaBetaToPhaseRefAndNormalize/Normalize/Local Variable Storage2" /begin REF_MEASUREMENT TFPM_PhaseACompDutyLim /end REF_MEASUREMENT /end GROUP
/begin GROUP TrfPWMModulator_TFPM_ModulatePwm_100us_sys_AlphaBetaToPhaseRefAndNormalize_Normalize_Local_Variable_Storage3 "TrfPWMModulator/TFPM_ModulatePwm_100us_sys/AlphaBetaToPhaseRefAndNormalize/Normalize/Local Variable Storage3" /begin REF_MEASUREMENT TFPM_PhaseBCompDutyLim /end REF_MEASUREMENT /end GROUP
/begin GROUP TrfPWMModulator_TFPM_ModulatePwm_100us_sys_AlphaBetaToPhaseRefAndNormalize_Normalize_Local_Variable_Storage4 "TrfPWMModulator/TFPM_ModulatePwm_100us_sys/AlphaBetaToPhaseRefAndNormalize/Normalize/Local Variable Storage4" /begin REF_MEASUREMENT TFPM_PhaseCCompDutyLim /end REF_MEASUREMENT /end GROUP
/begin GROUP TrfPWMModulator_TFPM_ModulatePwm_100us_sys_DutySynthesis "TrfPWMModulator/TFPM_ModulatePwm_100us_sys/DutySynthesis"
 /begin SUB_GROUP TrfPWMModulator_TFPM_ModulatePwm_100us_sys_DutySynthesis_DutyLimiter TrfPWMModulator_TFPM_ModulatePwm_100us_sys_DutySynthesis_MinPulseCalc TrfPWMModulator_TFPM_ModulatePwm_100us_sys_DutySynthesis_NarrowPulseSuppress TrfPWMModulator_TFPM_ModulatePwm_100us_sys_DutySynthesis_ZeroSeqInjection /end SUB_GROUP
/end GROUP
/begin GROUP TrfPWMModulator_TFPM_ModulatePwm_100us_sys_DutySynthesis_DutyLimiter "TrfPWMModulator/TFPM_ModulatePwm_100us_sys/DutySynthesis/DutyLimiter"
 /begin SUB_GROUP TrfPWMModulator_TFPM_ModulatePwm_100us_sys_DutySynthesis_DutyLimiter_Parameter TrfPWMModulator_TFPM_ModulatePwm_100us_sys_DutySynthesis_DutyLimiter_Parameter1 TrfPWMModulator_TFPM_ModulatePwm_100us_sys_DutySynthesis_DutyLimiter_Parameter2 /end SUB_GROUP
/end GROUP
/begin GROUP TrfPWMModulator_TFPM_ModulatePwm_100us_sys_DutySynthesis_DutyLimiter_Parameter "TrfPWMModulator/TFPM_ModulatePwm_100us_sys/DutySynthesis/DutyLimiter/Parameter" /begin REF_CHARACTERISTIC TFPM_HighSideSwitchSel_C /end REF_CHARACTERISTIC /end GROUP
/begin GROUP TrfPWMModulator_TFPM_ModulatePwm_100us_sys_DutySynthesis_DutyLimiter_Parameter1 "TrfPWMModulator/TFPM_ModulatePwm_100us_sys/DutySynthesis/DutyLimiter/Parameter1" /begin REF_CHARACTERISTIC TFPM_DutyUpperLimit_C /end REF_CHARACTERISTIC /end GROUP
/begin GROUP TrfPWMModulator_TFPM_ModulatePwm_100us_sys_DutySynthesis_DutyLimiter_Parameter2 "TrfPWMModulator/TFPM_ModulatePwm_100us_sys/DutySynthesis/DutyLimiter/Parameter2" /begin REF_CHARACTERISTIC TFPM_DutyLowerLimit_C /end REF_CHARACTERISTIC /end GROUP
/begin GROUP TrfPWMModulator_TFPM_ModulatePwm_100us_sys_DutySynthesis_MinPulseCalc "TrfPWMModulator/TFPM_ModulatePwm_100us_sys/DutySynthesis/MinPulseCalc"
 /begin SUB_GROUP TrfPWMModulator_TFPM_ModulatePwm_100us_sys_DutySynthesis_MinPulseCalc_Local_Variable_Storage TrfPWMModulator_TFPM_ModulatePwm_100us_sys_DutySynthesis_MinPulseCalc_Parameter /end SUB_GROUP
 /begin REF_MEASUREMENT SGPP_SampleTime1Reciprocal /end REF_MEASUREMENT
/end GROUP
/begin GROUP TrfPWMModulator_TFPM_ModulatePwm_100us_sys_DutySynthesis_MinPulseCalc_Local_Variable_Storage "TrfPWMModulator/TFPM_ModulatePwm_100us_sys/DutySynthesis/MinPulseCalc/Local Variable Storage" /begin REF_MEASUREMENT TFPM_MinSwitchTimeRel /end REF_MEASUREMENT /end GROUP
/begin GROUP TrfPWMModulator_TFPM_ModulatePwm_100us_sys_DutySynthesis_MinPulseCalc_Parameter "TrfPWMModulator/TFPM_ModulatePwm_100us_sys/DutySynthesis/MinPulseCalc/Parameter" /begin REF_CHARACTERISTIC TFPM_MinSwitchTime_C /end REF_CHARACTERISTIC /end GROUP
/begin GROUP TrfPWMModulator_TFPM_ModulatePwm_100us_sys_DutySynthesis_NarrowPulseSuppress "TrfPWMModulator/TFPM_ModulatePwm_100us_sys/DutySynthesis/NarrowPulseSuppress"
 /begin SUB_GROUP TrfPWMModulator_TFPM_ModulatePwm_100us_sys_DutySynthesis_NarrowPulseSuppress_Local_Variable_Storage TrfPWMModulator_TFPM_ModulatePwm_100us_sys_DutySynthesis_NarrowPulseSuppress_Local_Variable_Storage1 TrfPWMModulator_TFPM_ModulatePwm_100us_sys_DutySynthesis_NarrowPulseSuppress_Local_Variable_Storage2 /end SUB_GROUP
/end GROUP
/begin GROUP TrfPWMModulator_TFPM_ModulatePwm_100us_sys_DutySynthesis_NarrowPulseSuppress_Local_Variable_Storage "TrfPWMModulator/TFPM_ModulatePwm_100us_sys/DutySynthesis/NarrowPulseSuppress/Local Variable Storage" /begin REF_MEASUREMENT TFPM_PhaseADutyRel /end REF_MEASUREMENT /end GROUP
/begin GROUP TrfPWMModulator_TFPM_ModulatePwm_100us_sys_DutySynthesis_NarrowPulseSuppress_Local_Variable_Storage1 "TrfPWMModulator/TFPM_ModulatePwm_100us_sys/DutySynthesis/NarrowPulseSuppress/Local Variable Storage1" /begin REF_MEASUREMENT TFPM_PhaseBDutyRel /end REF_MEASUREMENT /end GROUP
/begin GROUP TrfPWMModulator_TFPM_ModulatePwm_100us_sys_DutySynthesis_NarrowPulseSuppress_Local_Variable_Storage2 "TrfPWMModulator/TFPM_ModulatePwm_100us_sys/DutySynthesis/NarrowPulseSuppress/Local Variable Storage2" /begin REF_MEASUREMENT TFPM_PhaseCDutyRel /end REF_MEASUREMENT /end GROUP
/begin GROUP TrfPWMModulator_TFPM_ModulatePwm_100us_sys_DutySynthesis_ZeroSeqInjection "TrfPWMModulator/TFPM_ModulatePwm_100us_sys/DutySynthesis/ZeroSeqInjection"
 /begin SUB_GROUP TrfPWMModulator_TFPM_ModulatePwm_100us_sys_DutySynthesis_ZeroSeqInjection_Local_Variable_Storage1 TrfPWMModulator_TFPM_ModulatePwm_100us_sys_DutySynthesis_ZeroSeqInjection_Local_Variable_Storage2 TrfPWMModulator_TFPM_ModulatePwm_100us_sys_DutySynthesis_ZeroSeqInjection_Local_Variable_Storage3 TrfPWMModulator_TFPM_ModulatePwm_100us_sys_DutySynthesis_ZeroSeqInjection_Local_Variable_Storage4 /end SUB_GROUP
/end GROUP
/begin GROUP TrfPWMModulator_TFPM_ModulatePwm_100us_sys_DutySynthesis_ZeroSeqInjection_Local_Variable_Storage1 "TrfPWMModulator/TFPM_ModulatePwm_100us_sys/DutySynthesis/ZeroSeqInjection/Local Variable Storage1" /begin REF_MEASUREMENT TFPM_PhaseASvmDuty /end REF_MEASUREMENT /end GROUP
/begin GROUP TrfPWMModulator_TFPM_ModulatePwm_100us_sys_DutySynthesis_ZeroSeqInjection_Local_Variable_Storage2 "TrfPWMModulator/TFPM_ModulatePwm_100us_sys/DutySynthesis/ZeroSeqInjection/Local Variable Storage2" /begin REF_MEASUREMENT TFPM_ThreePhaseVoltMid /end REF_MEASUREMENT /end GROUP
/begin GROUP TrfPWMModulator_TFPM_ModulatePwm_100us_sys_DutySynthesis_ZeroSeqInjection_Local_Variable_Storage3 "TrfPWMModulator/TFPM_ModulatePwm_100us_sys/DutySynthesis/ZeroSeqInjection/Local Variable Storage3" /begin REF_MEASUREMENT TFPM_PhaseBSvmDuty /end REF_MEASUREMENT /end GROUP
/begin GROUP TrfPWMModulator_TFPM_ModulatePwm_100us_sys_DutySynthesis_ZeroSeqInjection_Local_Variable_Storage4 "TrfPWMModulator/TFPM_ModulatePwm_100us_sys/DutySynthesis/ZeroSeqInjection/Local Variable Storage4" /begin REF_MEASUREMENT TFPM_PhaseCLvmDuty /end REF_MEASUREMENT /end GROUP
/end MODULE
/end PROJECT
/* (add any file trailer comments here) */
/* EOF TrfPWMModulator.a2l*/
