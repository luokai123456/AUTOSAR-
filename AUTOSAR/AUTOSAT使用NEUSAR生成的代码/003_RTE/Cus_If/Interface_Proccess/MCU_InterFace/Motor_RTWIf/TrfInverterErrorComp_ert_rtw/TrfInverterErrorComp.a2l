/******************************************************************************
* ASAP2 file: TrfInverterErrorComp.a2l
* Code generation for model "TrfInverterErrorComp".
* Model version : 1.21
* Simulink Coder version : 10.6 R2022b
* C source code generated on : Thu May 28 16:29:38 2026
* Target selection: ert.tlc
* Embedded hardware selection: Infineon->TriCore
* Code generation objectives: Unspecified
* Validation result: Not run
* (add additional file header information here)
******************************************************************************/ ASAP2_VERSION 1 31
/* Version 1.31 */
/begin PROJECT ProjectName "Project Comment Goes Here"
/begin HEADER "Header Comments go here" /end HEADER
/begin MODULE ModuleName "Module Comment Goes Here"
/begin MOD_PAR "MOD PAR Comment Goes Here" /end MOD_PAR
/begin MOD_COMMON "Mod Common Comment Here" BYTE_ORDER MSB_LAST ALIGNMENT_BYTE 1 ALIGNMENT_WORD 2 ALIGNMENT_LONG 4 ALIGNMENT_FLOAT32_IEEE 4 ALIGNMENT_FLOAT64_IEEE 4 /end MOD_COMMON
/begin CHARACTERISTIC TFEC_AngleFactor_C "Correction factor for electrical angle compensation" VALUE 0x0000 /* @ECU_Address@TFEC_AngleFactor_C@ */ Record_FLOAT32_IEEE 0 TrfInverterErrorComp_CM_single_dash_ -3.000000 3.000000 /end CHARACTERISTIC
/begin CHARACTERISTIC TFEC_CompMasterEna_C "Master enable for compensation independent of conditions" VALUE 0x0000 /* @ECU_Address@TFEC_CompMasterEna_C@ */ Record_UBYTE 0 TrfInverterErrorComp_CM_uint8_dash_ 0.000000 1.000000 /end CHARACTERISTIC
/begin CHARACTERISTIC TFEC_CurrentRampStart_C "Current threshold for sign function ramp initiation" VALUE 0x0000 /* @ECU_Address@TFEC_CurrentRampStart_C@ */ Record_FLOAT32_IEEE 0 TrfInverterErrorComp_CM_single_A 0.000000 1000.000000 /end CHARACTERISTIC
/begin CHARACTERISTIC TFEC_CurrentReadMode_C "Current source selection: 0=measured dq, 1=dq setpoints" VALUE 0x0000 /* @ECU_Address@TFEC_CurrentReadMode_C@ */ Record_UBYTE 0 TrfInverterErrorComp_CM_uint8_dash_ 0.000000 10.000000 /end CHARACTERISTIC
/begin CHARACTERISTIC TFEC_CurrentSignMax_C "Current threshold for full sign saturation" VALUE 0x0000 /* @ECU_Address@TFEC_CurrentSignMax_C@ */ Record_FLOAT32_IEEE 0 TrfInverterErrorComp_CM_single_A 0.000000 1000.000000 /end CHARACTERISTIC
/begin CHARACTERISTIC TFEC_CurrentThrActivate_C "Current threshold to activate compensation" VALUE 0x0000 /* @ECU_Address@TFEC_CurrentThrActivate_C@ */ Record_FLOAT32_IEEE 0 TrfInverterErrorComp_CM_single_A 0.000000 25000.000000 /end CHARACTERISTIC
/begin CHARACTERISTIC TFEC_CurrentThrDeactivate_C "Current threshold to deactivate compensation" VALUE 0x0000 /* @ECU_Address@TFEC_CurrentThrDeactivate_C@ */ Record_FLOAT32_IEEE 0 TrfInverterErrorComp_CM_single_A 0.000000 25000.000000 /end CHARACTERISTIC
/begin CHARACTERISTIC TFEC_DeadTimeCompEna_C "Enable flag for dead-time compensation" VALUE 0x0000 /* @ECU_Address@TFEC_DeadTimeCompEna_C@ */ Record_UBYTE 0 TrfInverterErrorComp_CM_uint8_dash_ 0.000000 1.000000 /end CHARACTERISTIC
/begin CHARACTERISTIC TFEC_DeadTimeDuration_C "Dead-time duration for inverter switching" VALUE 0x0000 /* @ECU_Address@TFEC_DeadTimeDuration_C@ */ Record_FLOAT32_IEEE 0 TrfInverterErrorComp_CM_single_s 0.000000 1.000000 /end CHARACTERISTIC
/begin CHARACTERISTIC TFEC_DeviceVoltDrop_C "Voltage drop per semiconductor device" VALUE 0x0000 /* @ECU_Address@TFEC_DeviceVoltDrop_C@ */ Record_FLOAT32_IEEE 0 TrfInverterErrorComp_CM_single_V 0.000000 1000.000000 /end CHARACTERISTIC
/begin CHARACTERISTIC TFEC_RampSlopeFactor_C "Slope factor for current sign ramp function" VALUE 0x0000 /* @ECU_Address@TFEC_RampSlopeFactor_C@ */ Record_FLOAT32_IEEE 0 TrfInverterErrorComp_CM_single_dash_ 0.000000 1000.000000 /end CHARACTERISTIC
/begin CHARACTERISTIC TFEC_SpeedThrActivate_C "Speed threshold to activate compensation" VALUE 0x0000 /* @ECU_Address@TFEC_SpeedThrActivate_C@ */ Record_FLOAT32_IEEE 0 TrfInverterErrorComp_CM_single_rpm 0.000000 25000.000000 /end CHARACTERISTIC
/begin CHARACTERISTIC TFEC_SpeedThrDeactivate_C "Speed threshold to deactivate compensation" VALUE 0x0000 /* @ECU_Address@TFEC_SpeedThrDeactivate_C@ */ Record_FLOAT32_IEEE 0 TrfInverterErrorComp_CM_single_rpm 0.000000 25000.000000 /end CHARACTERISTIC
/begin CHARACTERISTIC TFEC_VoltDropCompEna_C "Enable flag for voltage drop compensation" VALUE 0x0000 /* @ECU_Address@TFEC_VoltDropCompEna_C@ */ Record_UBYTE 0 TrfInverterErrorComp_CM_uint8_dash_ 0.000000 1.000000 /end CHARACTERISTIC
/begin MEASUREMENT CTLC_IdSpLimited "" FLOAT32_IEEE TrfInverterErrorComp_CM_single 0 0 -3.4E+38 3.4E+38 ECU_ADDRESS 0x0000 /* @ECU_Address@CTLC_IdSpLimited@ */ /end MEASUREMENT
/begin MEASUREMENT CTLC_IqSpLimited "" FLOAT32_IEEE TrfInverterErrorComp_CM_single 0 0 -3.4E+38 3.4E+38 ECU_ADDRESS 0x0000 /* @ECU_Address@CTLC_IqSpLimited@ */ /end MEASUREMENT
/begin MEASUREMENT CTSO_OperationMode "" UBYTE TrfInverterErrorComp_CM_EnumCtlMode 0 0 0 14 ECU_ADDRESS 0x0000 /* @ECU_Address@CTSO_OperationMode@ */ /end MEASUREMENT
/begin MEASUREMENT SGPP_DcLinkVoltMeas "" FLOAT32_IEEE TrfInverterErrorComp_CM_single 0 0 -3.4E+38 3.4E+38 ECU_ADDRESS 0x0000 /* @ECU_Address@SGPP_DcLinkVoltMeas@ */ /end MEASUREMENT
/begin MEASUREMENT SGPP_ElecAngle "" FLOAT32_IEEE TrfInverterErrorComp_CM_single 0 0 -3.4E+38 3.4E+38 ECU_ADDRESS 0x0000 /* @ECU_Address@SGPP_ElecAngle@ */ /end MEASUREMENT
/begin MEASUREMENT SGPP_ElecSpeed "" FLOAT32_IEEE TrfInverterErrorComp_CM_single 0 0 -3.4E+38 3.4E+38 ECU_ADDRESS 0x0000 /* @ECU_Address@SGPP_ElecSpeed@ */ /end MEASUREMENT
/begin MEASUREMENT SGPP_MechSpeedAbsolute "" FLOAT32_IEEE TrfInverterErrorComp_CM_single 0 0 -3.4E+38 3.4E+38 ECU_ADDRESS 0x0000 /* @ECU_Address@SGPP_MechSpeedAbsolute@ */ /end MEASUREMENT
/begin MEASUREMENT SGPP_SampleTime1 "" FLOAT32_IEEE TrfInverterErrorComp_CM_single 0 0 -3.4E+38 3.4E+38 ECU_ADDRESS 0x0000 /* @ECU_Address@SGPP_SampleTime1@ */ /end MEASUREMENT
/begin MEASUREMENT SGPP_SampleTime1Reciprocal "" FLOAT32_IEEE TrfInverterErrorComp_CM_single 0 0 -3.4E+38 3.4E+38 ECU_ADDRESS 0x0000 /* @ECU_Address@SGPP_SampleTime1Reciprocal@ */ /end MEASUREMENT
/begin MEASUREMENT TFEC_CompConditionEna "Conditional enable flag based on operating conditions" UBYTE TrfInverterErrorComp_CM_uint8_dash_ 0 0 0.000000 1.000000 ECU_ADDRESS 0x0000 /* @ECU_Address@TFEC_CompConditionEna@ */ /end MEASUREMENT
/begin MEASUREMENT TFEC_CurrentMagCalc "Calculated current magnitude for compensation" FLOAT32_IEEE TrfInverterErrorComp_CM_single_A 0 0 -6000.000000 6000.000000 ECU_ADDRESS 0x0000 /* @ECU_Address@TFEC_CurrentMagCalc@ */ /end MEASUREMENT
/begin MEASUREMENT TFEC_IdRead "D-axis current value for compensation calculation" FLOAT32_IEEE TrfInverterErrorComp_CM_single_A 0 0 -2000.000000 2000.000000 ECU_ADDRESS 0x0000 /* @ECU_Address@TFEC_IdRead@ */ /end MEASUREMENT
/begin MEASUREMENT TFEC_IqRead "Q-axis current value for compensation calculation" FLOAT32_IEEE TrfInverterErrorComp_CM_single_A 0 0 -2000.000000 2000.000000 ECU_ADDRESS 0x0000 /* @ECU_Address@TFEC_IqRead@ */ /end MEASUREMENT
/begin MEASUREMENT TFEC_PhaseACompVolt "Phase A total compensation voltage" FLOAT32_IEEE TrfInverterErrorComp_CM_single_V 0 0 -1000.000000 1000.000000 ARRAY_SIZE 1 ECU_ADDRESS 0x0000 /* @ECU_Address@TFEC_PhaseACompVolt@ */ /end MEASUREMENT
/begin MEASUREMENT TFEC_PhaseACurrentCalc "Calculated phase A current for compensation" FLOAT32_IEEE TrfInverterErrorComp_CM_single_A 0 0 -2000.000000 2000.000000 ECU_ADDRESS 0x0000 /* @ECU_Address@TFEC_PhaseACurrentCalc@ */ /end MEASUREMENT
/begin MEASUREMENT TFEC_PhaseACurrentSign "Phase A current direction indicator" FLOAT32_IEEE TrfInverterErrorComp_CM_single_dash_ 0 0 -1.000000 1.000000 ECU_ADDRESS 0x0000 /* @ECU_Address@TFEC_PhaseACurrentSign@ */ /end MEASUREMENT
/begin MEASUREMENT TFEC_PhaseADeadTimeComp "Phase A dead-time compensation voltage" FLOAT32_IEEE TrfInverterErrorComp_CM_single_V 0 0 -1000.000000 1000.000000 ECU_ADDRESS 0x0000 /* @ECU_Address@TFEC_PhaseADeadTimeComp@ */ /end MEASUREMENT
/begin MEASUREMENT TFEC_PhaseAVoltDrop "Phase A voltage drop compensation" FLOAT32_IEEE TrfInverterErrorComp_CM_single_V 0 0 -1000.000000 1000.000000 ECU_ADDRESS 0x0000 /* @ECU_Address@TFEC_PhaseAVoltDrop@ */ /end MEASUREMENT
/begin MEASUREMENT TFEC_PhaseBCompVolt "Phase B total compensation voltage" FLOAT32_IEEE TrfInverterErrorComp_CM_single_V 0 0 -1000.000000 1000.000000 ARRAY_SIZE 1 ECU_ADDRESS 0x0000 /* @ECU_Address@TFEC_PhaseBCompVolt@ */ /end MEASUREMENT
/begin MEASUREMENT TFEC_PhaseBCurrentCalc "Calculated phase B current for compensation" FLOAT32_IEEE TrfInverterErrorComp_CM_single_A 0 0 -2000.000000 2000.000000 ECU_ADDRESS 0x0000 /* @ECU_Address@TFEC_PhaseBCurrentCalc@ */ /end MEASUREMENT
/begin MEASUREMENT TFEC_PhaseBCurrentSign "Phase B current direction indicator" FLOAT32_IEEE TrfInverterErrorComp_CM_single_dash_ 0 0 -1.000000 1.000000 ECU_ADDRESS 0x0000 /* @ECU_Address@TFEC_PhaseBCurrentSign@ */ /end MEASUREMENT
/begin MEASUREMENT TFEC_PhaseBDeadTimeComp "Phase B dead-time compensation voltage" FLOAT32_IEEE TrfInverterErrorComp_CM_single_V 0 0 -1000.000000 1000.000000 ECU_ADDRESS 0x0000 /* @ECU_Address@TFEC_PhaseBDeadTimeComp@ */ /end MEASUREMENT
/begin MEASUREMENT TFEC_PhaseBVoltDrop "Phase B voltage drop compensation" FLOAT32_IEEE TrfInverterErrorComp_CM_single_V 0 0 -1000.000000 1000.000000 ECU_ADDRESS 0x0000 /* @ECU_Address@TFEC_PhaseBVoltDrop@ */ /end MEASUREMENT
/begin MEASUREMENT TFEC_PhaseCCompVolt "Phase C total compensation voltage" FLOAT32_IEEE TrfInverterErrorComp_CM_single_V 0 0 -1000.000000 1000.000000 ARRAY_SIZE 1 ECU_ADDRESS 0x0000 /* @ECU_Address@TFEC_PhaseCCompVolt@ */ /end MEASUREMENT
/begin MEASUREMENT TFEC_PhaseCCurrentCalc "Calculated phase C current for compensation" FLOAT32_IEEE TrfInverterErrorComp_CM_single_A 0 0 -2000.000000 2000.000000 ECU_ADDRESS 0x0000 /* @ECU_Address@TFEC_PhaseCCurrentCalc@ */ /end MEASUREMENT
/begin MEASUREMENT TFEC_PhaseCCurrentSign "Phase C current direction indicator" FLOAT32_IEEE TrfInverterErrorComp_CM_single_dash_ 0 0 -1.000000 1.000000 ECU_ADDRESS 0x0000 /* @ECU_Address@TFEC_PhaseCCurrentSign@ */ /end MEASUREMENT
/begin MEASUREMENT TFEC_PhaseCDeadTimeComp "Phase C dead-time compensation voltage" FLOAT32_IEEE TrfInverterErrorComp_CM_single_V 0 0 -1000.000000 1000.000000 ECU_ADDRESS 0x0000 /* @ECU_Address@TFEC_PhaseCDeadTimeComp@ */ /end MEASUREMENT
/begin MEASUREMENT TFEC_PhaseCVoltDrop "Phase C voltage drop compensation" FLOAT32_IEEE TrfInverterErrorComp_CM_single_V 0 0 -1000.000000 1000.000000 ECU_ADDRESS 0x0000 /* @ECU_Address@TFEC_PhaseCVoltDrop@ */ /end MEASUREMENT
/begin MEASUREMENT TFEC_StatorCurrentIs "Stator Current" FLOAT32_IEEE TrfInverterErrorComp_CM_single_A 0 0 -2000.000000 2000.000000 ECU_ADDRESS 0x0000 /* @ECU_Address@TFEC_StatorCurrentIs@ */ /end MEASUREMENT
/begin MEASUREMENT TFPD_IdMeasured "" FLOAT32_IEEE TrfInverterErrorComp_CM_single 0 0 -3.4E+38 3.4E+38 ECU_ADDRESS 0x0000 /* @ECU_Address@TFPD_IdMeasured@ */ /end MEASUREMENT
/begin MEASUREMENT TFPD_IqMeasured "" FLOAT32_IEEE TrfInverterErrorComp_CM_single 0 0 -3.4E+38 3.4E+38 ECU_ADDRESS 0x0000 /* @ECU_Address@TFPD_IqMeasured@ */ /end MEASUREMENT
/begin MEASUREMENT TrfInverterErrorComp_DW.Delay_DSTATE "" UBYTE TrfInverterErrorComp_CM_uint8 0 0 0 255 ECU_ADDRESS 0x0000 /* @ECU_Address@TrfInverterErrorComp_DW.Delay_DSTATE@ */ /end MEASUREMENT
/begin MEASUREMENT TrfInverterErrorComp_DW.Delay_DSTATE_k "" UBYTE TrfInverterErrorComp_CM_logical 0 0 0 1 ECU_ADDRESS 0x0000 /* @ECU_Address@TrfInverterErrorComp_DW.Delay_DSTATE_k@ */ /end MEASUREMENT
/begin COMPU_METHOD TrfInverterErrorComp_CM_EnumCtlMode "Enumerated data type: EnumCtlMode" TAB_VERB "%0.6" "" /* Conversion Table */ COMPU_TAB_REF VTAB_FOR_TrfInverterErrorComp_CM_EnumCtlMode /end COMPU_METHOD
/begin COMPU_VTAB /* Name of Table */ VTAB_FOR_TrfInverterErrorComp_CM_EnumCtlMode "Enumerated data type: EnumCtlMode" TAB_VERB /* Number of Elements */ 15 0 "Init" 1 "LowVoltReady" 2 "HighVoltStandby" 3 "Ready" 4 "HighVoltDischarge" 5 "LowVoltDischarge" 6 "Discharge" 7 "PowerDown" 8 "Fault" 9 "OpenLoopCtrl" 10 "VoltDirectCtrl" 11 "CurrCtrl" 12 "TorqueCtrl" 13 "SpeedCtrl" 14 "ZeroPointCal" /end COMPU_VTAB
/begin COMPU_METHOD TrfInverterErrorComp_CM_logical "Q = V" RAT_FUNC "%1.0" "" COEFFS 0 1 0 0 0 1 /end COMPU_METHOD
/begin COMPU_METHOD TrfInverterErrorComp_CM_single "Q = V" RAT_FUNC "%8.6" "" COEFFS 0 1 0 0 0 1 /end COMPU_METHOD
/begin COMPU_METHOD TrfInverterErrorComp_CM_single_A "Q = V" RAT_FUNC "%8.6" "A" COEFFS 0 1 0 0 0 1 /end COMPU_METHOD
/begin COMPU_METHOD TrfInverterErrorComp_CM_single_V "Q = V" RAT_FUNC "%8.6" "V" COEFFS 0 1 0 0 0 1 /end COMPU_METHOD
/begin COMPU_METHOD TrfInverterErrorComp_CM_single_dash_ "Q = V" RAT_FUNC "%8.6" "-" COEFFS 0 1 0 0 0 1 /end COMPU_METHOD
/begin COMPU_METHOD TrfInverterErrorComp_CM_single_rpm "Q = V" RAT_FUNC "%8.6" "rpm" COEFFS 0 1 0 0 0 1 /end COMPU_METHOD
/begin COMPU_METHOD TrfInverterErrorComp_CM_single_s "Q = V" RAT_FUNC "%8.6" "s" COEFFS 0 1 0 0 0 1 /end COMPU_METHOD
/begin COMPU_METHOD TrfInverterErrorComp_CM_uint8 "Q = V" RAT_FUNC "%3.0" "" COEFFS 0 1 0 0 0 1 /end COMPU_METHOD
/begin COMPU_METHOD TrfInverterErrorComp_CM_uint8_dash_ "Q = V" RAT_FUNC "%3.0" "-" COEFFS 0 1 0 0 0 1 /end COMPU_METHOD
/begin RECORD_LAYOUT Record_BOOLEAN FNC_VALUES 1 UBYTE COLUMN_DIR DIRECT /end RECORD_LAYOUT
/begin RECORD_LAYOUT Record_FLOAT32_IEEE FNC_VALUES 1 FLOAT32_IEEE COLUMN_DIR DIRECT /end RECORD_LAYOUT
/begin RECORD_LAYOUT Record_UBYTE FNC_VALUES 1 UBYTE COLUMN_DIR DIRECT /end RECORD_LAYOUT
/begin GROUP TrfInverterErrorComp "TrfInverterErrorComp" /* Root */ ROOT /begin SUB_GROUP TrfInverterErrorComp_TFEC_CompInverterError_100us_sys /end SUB_GROUP
 /begin REF_MEASUREMENT CTLC_IdSpLimited CTLC_IqSpLimited CTSO_OperationMode SGPP_DcLinkVoltMeas SGPP_ElecAngle SGPP_ElecSpeed SGPP_MechSpeedAbsolute SGPP_SampleTime1 SGPP_SampleTime1Reciprocal TFPD_IdMeasured TFPD_IqMeasured /end REF_MEASUREMENT
/end GROUP
/begin GROUP TrfInverterErrorComp_TFEC_CompInverterError_100us_sys "TrfInverterErrorComp/TFEC_CompInverterError_100us_sys"
 /begin SUB_GROUP TrfInverterErrorComp_TFEC_CompInverterError_100us_sys_CompVoltageSynthesis TrfInverterErrorComp_TFEC_CompInverterError_100us_sys_EnaCompLogic TrfInverterErrorComp_TFEC_CompInverterError_100us_sys_ISgnCalc TrfInverterErrorComp_TFEC_CompInverterError_100us_sys_IdIqSelect TrfInverterErrorComp_TFEC_CompInverterError_100us_sys_InvParkClakeTransform /end SUB_GROUP
/end GROUP
/begin GROUP TrfInverterErrorComp_TFEC_CompInverterError_100us_sys_CompVoltageSynthesis "TrfInverterErrorComp/TFEC_CompInverterError_100us_sys/CompVoltageSynthesis"
 /begin SUB_GROUP TrfInverterErrorComp_TFEC_CompInverterError_100us_sys_CompVoltageSynthesis_Local_Variable_Storage1 TrfInverterErrorComp_TFEC_CompInverterError_100us_sys_CompVoltageSynthesis_Local_Variable_Storage2 TrfInverterErrorComp_TFEC_CompInverterError_100us_sys_CompVoltageSynthesis_Local_Variable_Storage3 TrfInverterErrorComp_TFEC_CompInverterError_100us_sys_CompVoltageSynthesis_Local_Variable_Storage4 TrfInverterErrorComp_TFEC_CompInverterError_100us_sys_CompVoltageSynthesis_Local_Variable_Storage5 TrfInverterErrorComp_TFEC_CompInverterError_100us_sys_CompVoltageSynthesis_Local_Variable_Storage6 TrfInverterErrorComp_TFEC_CompInverterError_100us_sys_CompVoltageSynthesis_UDdtVal TrfInverterErrorComp_TFEC_CompInverterError_100us_sys_CompVoltageSynthesis_UdropVal /end SUB_GROUP
/end GROUP
/begin GROUP TrfInverterErrorComp_TFEC_CompInverterError_100us_sys_CompVoltageSynthesis_Local_Variable_Storage1 "TrfInverterErrorComp/TFEC_CompInverterError_100us_sys/CompVoltageSynthesis/Local Variable Storage1" /begin REF_MEASUREMENT TFEC_PhaseBVoltDrop /end REF_MEASUREMENT /end GROUP
/begin GROUP TrfInverterErrorComp_TFEC_CompInverterError_100us_sys_CompVoltageSynthesis_Local_Variable_Storage2 "TrfInverterErrorComp/TFEC_CompInverterError_100us_sys/CompVoltageSynthesis/Local Variable Storage2" /begin REF_MEASUREMENT TFEC_PhaseAVoltDrop /end REF_MEASUREMENT /end GROUP
/begin GROUP TrfInverterErrorComp_TFEC_CompInverterError_100us_sys_CompVoltageSynthesis_Local_Variable_Storage3 "TrfInverterErrorComp/TFEC_CompInverterError_100us_sys/CompVoltageSynthesis/Local Variable Storage3" /begin REF_MEASUREMENT TFEC_PhaseCVoltDrop /end REF_MEASUREMENT /end GROUP
/begin GROUP TrfInverterErrorComp_TFEC_CompInverterError_100us_sys_CompVoltageSynthesis_Local_Variable_Storage4 "TrfInverterErrorComp/TFEC_CompInverterError_100us_sys/CompVoltageSynthesis/Local Variable Storage4" /begin REF_MEASUREMENT TFEC_PhaseADeadTimeComp /end REF_MEASUREMENT /end GROUP
/begin GROUP TrfInverterErrorComp_TFEC_CompInverterError_100us_sys_CompVoltageSynthesis_Local_Variable_Storage5 "TrfInverterErrorComp/TFEC_CompInverterError_100us_sys/CompVoltageSynthesis/Local Variable Storage5" /begin REF_MEASUREMENT TFEC_PhaseBDeadTimeComp /end REF_MEASUREMENT /end GROUP
/begin GROUP TrfInverterErrorComp_TFEC_CompInverterError_100us_sys_CompVoltageSynthesis_Local_Variable_Storage6 "TrfInverterErrorComp/TFEC_CompInverterError_100us_sys/CompVoltageSynthesis/Local Variable Storage6" /begin REF_MEASUREMENT TFEC_PhaseCDeadTimeComp /end REF_MEASUREMENT /end GROUP
/begin GROUP TrfInverterErrorComp_TFEC_CompInverterError_100us_sys_CompVoltageSynthesis_UDdtVal "TrfInverterErrorComp/TFEC_CompInverterError_100us_sys/CompVoltageSynthesis/UDdtVal"
 /begin SUB_GROUP TrfInverterErrorComp_TFEC_CompInverterError_100us_sys_CompVoltageSynthesis_UDdtVal_Parameter3 TrfInverterErrorComp_TFEC_CompInverterError_100us_sys_CompVoltageSynthesis_UDdtVal_Parameter4 /end SUB_GROUP
 /begin REF_MEASUREMENT SGPP_DcLinkVoltMeas SGPP_SampleTime1Reciprocal /end REF_MEASUREMENT
/end GROUP
/begin GROUP TrfInverterErrorComp_TFEC_CompInverterError_100us_sys_CompVoltageSynthesis_UDdtVal_Parameter3 "TrfInverterErrorComp/TFEC_CompInverterError_100us_sys/CompVoltageSynthesis/UDdtVal/Parameter3" /begin REF_CHARACTERISTIC TFEC_DeadTimeDuration_C /end REF_CHARACTERISTIC /end GROUP
/begin GROUP TrfInverterErrorComp_TFEC_CompInverterError_100us_sys_CompVoltageSynthesis_UDdtVal_Parameter4 "TrfInverterErrorComp/TFEC_CompInverterError_100us_sys/CompVoltageSynthesis/UDdtVal/Parameter4" /begin REF_CHARACTERISTIC TFEC_DeadTimeCompEna_C /end REF_CHARACTERISTIC /end GROUP
/begin GROUP TrfInverterErrorComp_TFEC_CompInverterError_100us_sys_CompVoltageSynthesis_UdropVal "TrfInverterErrorComp/TFEC_CompInverterError_100us_sys/CompVoltageSynthesis/UdropVal"
 /begin SUB_GROUP TrfInverterErrorComp_TFEC_CompInverterError_100us_sys_CompVoltageSynthesis_UdropVal_Parameter1 TrfInverterErrorComp_TFEC_CompInverterError_100us_sys_CompVoltageSynthesis_UdropVal_Parameter2 /end SUB_GROUP
/end GROUP
/begin GROUP TrfInverterErrorComp_TFEC_CompInverterError_100us_sys_CompVoltageSynthesis_UdropVal_Parameter1 "TrfInverterErrorComp/TFEC_CompInverterError_100us_sys/CompVoltageSynthesis/UdropVal/Parameter1" /begin REF_CHARACTERISTIC TFEC_DeviceVoltDrop_C /end REF_CHARACTERISTIC /end GROUP
/begin GROUP TrfInverterErrorComp_TFEC_CompInverterError_100us_sys_CompVoltageSynthesis_UdropVal_Parameter2 "TrfInverterErrorComp/TFEC_CompInverterError_100us_sys/CompVoltageSynthesis/UdropVal/Parameter2" /begin REF_CHARACTERISTIC TFEC_VoltDropCompEna_C /end REF_CHARACTERISTIC /end GROUP
/begin GROUP TrfInverterErrorComp_TFEC_CompInverterError_100us_sys_EnaCompLogic "TrfInverterErrorComp/TFEC_CompInverterError_100us_sys/EnaCompLogic"
 /begin SUB_GROUP TrfInverterErrorComp_TFEC_CompInverterError_100us_sys_EnaCompLogic_CurrentCondition TrfInverterErrorComp_TFEC_CompInverterError_100us_sys_EnaCompLogic_Local_Variable_Storage3 TrfInverterErrorComp_TFEC_CompInverterError_100us_sys_EnaCompLogic_ModeCondition TrfInverterErrorComp_TFEC_CompInverterError_100us_sys_EnaCompLogic_Parameter4 TrfInverterErrorComp_TFEC_CompInverterError_100us_sys_EnaCompLogic_SpeedConditon /end SUB_GROUP
/end GROUP
/begin GROUP TrfInverterErrorComp_TFEC_CompInverterError_100us_sys_EnaCompLogic_CurrentCondition "TrfInverterErrorComp/TFEC_CompInverterError_100us_sys/EnaCompLogic/CurrentCondition"
 /begin SUB_GROUP TrfInverterErrorComp_TFEC_CompInverterError_100us_sys_EnaCompLogic_CurrentCondition_HysteresisCtrl TrfInverterErrorComp_TFEC_CompInverterError_100us_sys_EnaCompLogic_CurrentCondition_Parameter1 TrfInverterErrorComp_TFEC_CompInverterError_100us_sys_EnaCompLogic_CurrentCondition_Parameter4 /end SUB_GROUP
/end GROUP
/begin GROUP TrfInverterErrorComp_TFEC_CompInverterError_100us_sys_EnaCompLogic_CurrentCondition_HysteresisCtrl "TrfInverterErrorComp/TFEC_CompInverterError_100us_sys/EnaCompLogic/CurrentCondition/HysteresisCtrl" /begin REF_MEASUREMENT TrfInverterErrorComp_DW.Delay_DSTATE_k /end REF_MEASUREMENT /end GROUP
/begin GROUP TrfInverterErrorComp_TFEC_CompInverterError_100us_sys_EnaCompLogic_CurrentCondition_Parameter1 "TrfInverterErrorComp/TFEC_CompInverterError_100us_sys/EnaCompLogic/CurrentCondition/Parameter1" /begin REF_CHARACTERISTIC TFEC_CurrentThrDeactivate_C /end REF_CHARACTERISTIC /end GROUP
/begin GROUP TrfInverterErrorComp_TFEC_CompInverterError_100us_sys_EnaCompLogic_CurrentCondition_Parameter4 "TrfInverterErrorComp/TFEC_CompInverterError_100us_sys/EnaCompLogic/CurrentCondition/Parameter4" /begin REF_CHARACTERISTIC TFEC_CurrentThrActivate_C /end REF_CHARACTERISTIC /end GROUP
/begin GROUP TrfInverterErrorComp_TFEC_CompInverterError_100us_sys_EnaCompLogic_Local_Variable_Storage3 "TrfInverterErrorComp/TFEC_CompInverterError_100us_sys/EnaCompLogic/Local Variable Storage3" /begin REF_MEASUREMENT TFEC_CompConditionEna /end REF_MEASUREMENT /end GROUP
/begin GROUP TrfInverterErrorComp_TFEC_CompInverterError_100us_sys_EnaCompLogic_ModeCondition "TrfInverterErrorComp/TFEC_CompInverterError_100us_sys/EnaCompLogic/ModeCondition" /begin REF_MEASUREMENT CTSO_OperationMode /end REF_MEASUREMENT /end GROUP
/begin GROUP TrfInverterErrorComp_TFEC_CompInverterError_100us_sys_EnaCompLogic_Parameter4 "TrfInverterErrorComp/TFEC_CompInverterError_100us_sys/EnaCompLogic/Parameter4" /begin REF_CHARACTERISTIC TFEC_CompMasterEna_C /end REF_CHARACTERISTIC /end GROUP
/begin GROUP TrfInverterErrorComp_TFEC_CompInverterError_100us_sys_EnaCompLogic_SpeedConditon "TrfInverterErrorComp/TFEC_CompInverterError_100us_sys/EnaCompLogic/SpeedConditon"
 /begin SUB_GROUP TrfInverterErrorComp_TFEC_CompInverterError_100us_sys_EnaCompLogic_SpeedConditon_HysteresisCtrl TrfInverterErrorComp_TFEC_CompInverterError_100us_sys_EnaCompLogic_SpeedConditon_Parameter1 TrfInverterErrorComp_TFEC_CompInverterError_100us_sys_EnaCompLogic_SpeedConditon_Parameter4 /end SUB_GROUP
/end GROUP
/begin GROUP TrfInverterErrorComp_TFEC_CompInverterError_100us_sys_EnaCompLogic_SpeedConditon_HysteresisCtrl "TrfInverterErrorComp/TFEC_CompInverterError_100us_sys/EnaCompLogic/SpeedConditon/HysteresisCtrl"
 /begin REF_MEASUREMENT SGPP_MechSpeedAbsolute TrfInverterErrorComp_DW.Delay_DSTATE /end REF_MEASUREMENT
/end GROUP
/begin GROUP TrfInverterErrorComp_TFEC_CompInverterError_100us_sys_EnaCompLogic_SpeedConditon_Parameter1 "TrfInverterErrorComp/TFEC_CompInverterError_100us_sys/EnaCompLogic/SpeedConditon/Parameter1" /begin REF_CHARACTERISTIC TFEC_SpeedThrDeactivate_C /end REF_CHARACTERISTIC /end GROUP
/begin GROUP TrfInverterErrorComp_TFEC_CompInverterError_100us_sys_EnaCompLogic_SpeedConditon_Parameter4 "TrfInverterErrorComp/TFEC_CompInverterError_100us_sys/EnaCompLogic/SpeedConditon/Parameter4" /begin REF_CHARACTERISTIC TFEC_SpeedThrActivate_C /end REF_CHARACTERISTIC /end GROUP
/begin GROUP TrfInverterErrorComp_TFEC_CompInverterError_100us_sys_ISgnCalc "TrfInverterErrorComp/TFEC_CompInverterError_100us_sys/ISgnCalc"
 /begin SUB_GROUP TrfInverterErrorComp_TFEC_CompInverterError_100us_sys_ISgnCalc_Local_Variable_Storage1 TrfInverterErrorComp_TFEC_CompInverterError_100us_sys_ISgnCalc_Local_Variable_Storage2 TrfInverterErrorComp_TFEC_CompInverterError_100us_sys_ISgnCalc_Local_Variable_Storage3 TrfInverterErrorComp_TFEC_CompInverterError_100us_sys_ISgnCalc_Parameter1 TrfInverterErrorComp_TFEC_CompInverterError_100us_sys_ISgnCalc_Parameter2 TrfInverterErrorComp_TFEC_CompInverterError_100us_sys_ISgnCalc_Parameter3 /end SUB_GROUP
/end GROUP
/begin GROUP TrfInverterErrorComp_TFEC_CompInverterError_100us_sys_ISgnCalc_Local_Variable_Storage1 "TrfInverterErrorComp/TFEC_CompInverterError_100us_sys/ISgnCalc/Local Variable Storage1" /begin REF_MEASUREMENT TFEC_PhaseBCurrentSign /end REF_MEASUREMENT /end GROUP
/begin GROUP TrfInverterErrorComp_TFEC_CompInverterError_100us_sys_ISgnCalc_Local_Variable_Storage2 "TrfInverterErrorComp/TFEC_CompInverterError_100us_sys/ISgnCalc/Local Variable Storage2" /begin REF_MEASUREMENT TFEC_PhaseACurrentSign /end REF_MEASUREMENT /end GROUP
/begin GROUP TrfInverterErrorComp_TFEC_CompInverterError_100us_sys_ISgnCalc_Local_Variable_Storage3 "TrfInverterErrorComp/TFEC_CompInverterError_100us_sys/ISgnCalc/Local Variable Storage3" /begin REF_MEASUREMENT TFEC_PhaseCCurrentSign /end REF_MEASUREMENT /end GROUP
/begin GROUP TrfInverterErrorComp_TFEC_CompInverterError_100us_sys_ISgnCalc_Parameter1 "TrfInverterErrorComp/TFEC_CompInverterError_100us_sys/ISgnCalc/Parameter1" /begin REF_CHARACTERISTIC TFEC_CurrentSignMax_C /end REF_CHARACTERISTIC /end GROUP
/begin GROUP TrfInverterErrorComp_TFEC_CompInverterError_100us_sys_ISgnCalc_Parameter2 "TrfInverterErrorComp/TFEC_CompInverterError_100us_sys/ISgnCalc/Parameter2" /begin REF_CHARACTERISTIC TFEC_RampSlopeFactor_C /end REF_CHARACTERISTIC /end GROUP
/begin GROUP TrfInverterErrorComp_TFEC_CompInverterError_100us_sys_ISgnCalc_Parameter3 "TrfInverterErrorComp/TFEC_CompInverterError_100us_sys/ISgnCalc/Parameter3" /begin REF_CHARACTERISTIC TFEC_CurrentRampStart_C /end REF_CHARACTERISTIC /end GROUP
/begin GROUP TrfInverterErrorComp_TFEC_CompInverterError_100us_sys_IdIqSelect "TrfInverterErrorComp/TFEC_CompInverterError_100us_sys/IdIqSelect"
 /begin SUB_GROUP TrfInverterErrorComp_TFEC_CompInverterError_100us_sys_IdIqSelect_Local_Variable_Storage1 TrfInverterErrorComp_TFEC_CompInverterError_100us_sys_IdIqSelect_Local_Variable_Storage2 TrfInverterErrorComp_TFEC_CompInverterError_100us_sys_IdIqSelect_Local_Variable_Storage3 TrfInverterErrorComp_TFEC_CompInverterError_100us_sys_IdIqSelect_Parameter4 /end SUB_GROUP
 /begin REF_MEASUREMENT CTLC_IdSpLimited CTLC_IqSpLimited TFPD_IdMeasured TFPD_IqMeasured /end REF_MEASUREMENT
/end GROUP
/begin GROUP TrfInverterErrorComp_TFEC_CompInverterError_100us_sys_IdIqSelect_Local_Variable_Storage1 "TrfInverterErrorComp/TFEC_CompInverterError_100us_sys/IdIqSelect/Local Variable Storage1" /begin REF_MEASUREMENT TFEC_IqRead /end REF_MEASUREMENT /end GROUP
/begin GROUP TrfInverterErrorComp_TFEC_CompInverterError_100us_sys_IdIqSelect_Local_Variable_Storage2 "TrfInverterErrorComp/TFEC_CompInverterError_100us_sys/IdIqSelect/Local Variable Storage2" /begin REF_MEASUREMENT TFEC_IdRead /end REF_MEASUREMENT /end GROUP
/begin GROUP TrfInverterErrorComp_TFEC_CompInverterError_100us_sys_IdIqSelect_Local_Variable_Storage3 "TrfInverterErrorComp/TFEC_CompInverterError_100us_sys/IdIqSelect/Local Variable Storage3" /begin REF_MEASUREMENT TFEC_CurrentMagCalc /end REF_MEASUREMENT /end GROUP
/begin GROUP TrfInverterErrorComp_TFEC_CompInverterError_100us_sys_IdIqSelect_Parameter4 "TrfInverterErrorComp/TFEC_CompInverterError_100us_sys/IdIqSelect/Parameter4" /begin REF_CHARACTERISTIC TFEC_CurrentReadMode_C /end REF_CHARACTERISTIC /end GROUP
/begin GROUP TrfInverterErrorComp_TFEC_CompInverterError_100us_sys_InvParkClakeTransform "TrfInverterErrorComp/TFEC_CompInverterError_100us_sys/InvParkClakeTransform"
 /begin SUB_GROUP TrfInverterErrorComp_TFEC_CompInverterError_100us_sys_InvParkClakeTransform_InvClarkeI TrfInverterErrorComp_TFEC_CompInverterError_100us_sys_InvParkClakeTransform_InvParkIWithAngleComp /end SUB_GROUP
/end GROUP
/begin GROUP TrfInverterErrorComp_TFEC_CompInverterError_100us_sys_InvParkClakeTransform_InvClarkeI "TrfInverterErrorComp/TFEC_CompInverterError_100us_sys/InvParkClakeTransform/InvClarkeI"
 /begin SUB_GROUP TrfInverterErrorComp_TFEC_CompInverterError_100us_sys_InvParkClakeTransform_InvClarkeI_Local_Variable_Storage TrfInverterErrorComp_TFEC_CompInverterError_100us_sys_InvParkClakeTransform_InvClarkeI_Local_Variable_Storage1 TrfInverterErrorComp_TFEC_CompInverterError_100us_sys_InvParkClakeTransform_InvClarkeI_Local_Variable_Storage2 /end SUB_GROUP
/end GROUP
/begin GROUP TrfInverterErrorComp_TFEC_CompInverterError_100us_sys_InvParkClakeTransform_InvClarkeI_Local_Variable_Storage "TrfInverterErrorComp/TFEC_CompInverterError_100us_sys/InvParkClakeTransform/InvClarkeI/Local Variable Storage" /begin REF_MEASUREMENT TFEC_PhaseCCurrentCalc /end REF_MEASUREMENT /end GROUP
/begin GROUP TrfInverterErrorComp_TFEC_CompInverterError_100us_sys_InvParkClakeTransform_InvClarkeI_Local_Variable_Storage1 "TrfInverterErrorComp/TFEC_CompInverterError_100us_sys/InvParkClakeTransform/InvClarkeI/Local Variable Storage1" /begin REF_MEASUREMENT TFEC_PhaseBCurrentCalc /end REF_MEASUREMENT /end GROUP
/begin GROUP TrfInverterErrorComp_TFEC_CompInverterError_100us_sys_InvParkClakeTransform_InvClarkeI_Local_Variable_Storage2 "TrfInverterErrorComp/TFEC_CompInverterError_100us_sys/InvParkClakeTransform/InvClarkeI/Local Variable Storage2" /begin REF_MEASUREMENT TFEC_PhaseACurrentCalc /end REF_MEASUREMENT /end GROUP
/begin GROUP TrfInverterErrorComp_TFEC_CompInverterError_100us_sys_InvParkClakeTransform_InvParkIWithAngleComp "TrfInverterErrorComp/TFEC_CompInverterError_100us_sys/InvParkClakeTransform/InvParkIWithAngleComp"
 /begin SUB_GROUP TrfInverterErrorComp_TFEC_CompInverterError_100us_sys_InvParkClakeTransform_InvParkIWithAngleComp_AngleCompensate /end SUB_GROUP
/end GROUP
/begin GROUP TrfInverterErrorComp_TFEC_CompInverterError_100us_sys_InvParkClakeTransform_InvParkIWithAngleComp_AngleCompensate "TrfInverterErrorComp/TFEC_CompInverterError_100us_sys/InvParkClakeTransform/InvParkIWithAngleComp/AngleCompensate"
 /begin SUB_GROUP TrfInverterErrorComp_TFEC_CompInverterError_100us_sys_InvParkClakeTransform_InvParkIWithAngleComp_AngleCompensate_Parameter /end SUB_GROUP
 /begin REF_MEASUREMENT SGPP_ElecAngle SGPP_ElecSpeed SGPP_SampleTime1 /end REF_MEASUREMENT
/end GROUP
/begin GROUP TrfInverterErrorComp_TFEC_CompInverterError_100us_sys_InvParkClakeTransform_InvParkIWithAngleComp_AngleCompensate_Parameter "TrfInverterErrorComp/TFEC_CompInverterError_100us_sys/InvParkClakeTransform/InvParkIWithAngleComp/AngleCompensate/Parameter" /begin REF_CHARACTERISTIC TFEC_AngleFactor_C /end REF_CHARACTERISTIC /end GROUP
/end MODULE
/end PROJECT
/* (add any file trailer comments here) */
/* EOF TrfInverterErrorComp.a2l*/
