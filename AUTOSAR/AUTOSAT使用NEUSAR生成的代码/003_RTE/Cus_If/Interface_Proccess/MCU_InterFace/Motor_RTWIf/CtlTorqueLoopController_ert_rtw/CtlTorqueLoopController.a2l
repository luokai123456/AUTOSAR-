/******************************************************************************
* ASAP2 file: CtlTorqueLoopController.a2l
* Code generation for model "CtlTorqueLoopController".
* Model version : 1.21
* Simulink Coder version : 10.6 R2022b
* C source code generated on : Thu May 28 16:40:23 2026
* Target selection: ert.tlc
* Embedded hardware selection: Infineon->TriCore
* Code generation objectives: Unspecified
* Validation result: Not run
* (add additional file header information here)
******************************************************************************/ ASAP2_VERSION 1 31
/* Version 1.31 */
/begin PROJECT ProjectName "Project Comment Goes Here"
/begin HEADER "Header Comments go here" /end HEADER
/begin MODULE ModuleName "Module Comment Goes Here"
/begin MOD_PAR "MOD PAR Comment Goes Here" /end MOD_PAR
/begin MOD_COMMON "Mod Common Comment Here" BYTE_ORDER MSB_LAST ALIGNMENT_BYTE 1 ALIGNMENT_WORD 2 ALIGNMENT_LONG 4 ALIGNMENT_FLOAT32_IEEE 4 ALIGNMENT_FLOAT64_IEEE 4 /end MOD_COMMON
/begin CHARACTERISTIC CTLC_CurrentMax_C "Maximum peak phase current limit" VALUE 0x0000 /* @ECU_Address@CTLC_CurrentMax_C@ */ Record_FLOAT32_IEEE 0 CtlTorqueLoopController_CM_single_A -2000.000000 2000.000000 /end CHARACTERISTIC
/begin CHARACTERISTIC CTLC_FluxWknDeactRate_C "Ramp-down rate limit for flux controller deactivation" VALUE 0x0000 /* @ECU_Address@CTLC_FluxWknDeactRate_C@ */ Record_FLOAT32_IEEE 0 CtlTorqueLoopController_CM_single 0.000000 10000000.000000 /end CHARACTERISTIC
/begin CHARACTERISTIC CTLC_FluxWknEnable_C "Enable flag for flux weakening controller" VALUE 0x0000 /* @ECU_Address@CTLC_FluxWknEnable_C@ */ Record_UBYTE 0 CtlTorqueLoopController_CM_uint8 0.000000 255.000000 /end CHARACTERISTIC
/begin CHARACTERISTIC CTLC_FluxWknKi_C "Integral gain of flux weakening PI controller" VALUE 0x0000 /* @ECU_Address@CTLC_FluxWknKi_C@ */ Record_FLOAT32_IEEE 0 CtlTorqueLoopController_CM_single -10000.000000 10000.000000 /end CHARACTERISTIC
/begin CHARACTERISTIC CTLC_FluxWknKp_C "Proportional gain of flux weakening PI controller" VALUE 0x0000 /* @ECU_Address@CTLC_FluxWknKp_C@ */ Record_FLOAT32_IEEE 0 CtlTorqueLoopController_CM_single -100000.000000 100000.000000 /end CHARACTERISTIC
/begin CHARACTERISTIC CTLC_FluxWknVoltHyst_C "Voltage hysteresis for flux weakening activation" VALUE 0x0000 /* @ECU_Address@CTLC_FluxWknVoltHyst_C@ */ Record_FLOAT32_IEEE 0 CtlTorqueLoopController_CM_single_V -10000.000000 10000.000000 /end CHARACTERISTIC
/begin CHARACTERISTIC CTLC_IdDischargeMode_C "D-axis current setpoint for discharge operation" VALUE 0x0000 /* @ECU_Address@CTLC_IdDischargeMode_C@ */ Record_FLOAT32_IEEE 0 CtlTorqueLoopController_CM_single_A -5000.000000 5000.000000 /end CHARACTERISTIC
/begin CHARACTERISTIC CTLC_IdMapMotor_C "" /* Characteristic Type */ CUBOID 0x0000 /* @ECU_Address@CTLC_IdMapMotor_C@ */ Record_FLOAT32_IEEE /* Maxdiff */ 0 CtlTorqueLoopController_CM_single -3.4E+38 3.4E+38
 /begin AXIS_DESCR /* Description of X-Axis Points */ COM_AXIS NO_INPUT_QUANTITY CtlTorqueLoopController_CM_single 50 -3.4E+38 3.4E+38 AXIS_PTS_REF CTLC_TorqueAxis_C /end AXIS_DESCR
 /begin AXIS_DESCR /* Description of Y-Axis Points */ COM_AXIS NO_INPUT_QUANTITY CtlTorqueLoopController_CM_single 35 -3.4E+38 3.4E+38 AXIS_PTS_REF CTLC_SpeedAxis_C /end AXIS_DESCR
 /begin AXIS_DESCR /* Description of Z-Axis Points */ COM_AXIS SGPP_DcLinkVoltMeas CtlTorqueLoopController_CM_single 3 -3.4E+38 3.4E+38 AXIS_PTS_REF CTLC_VoltageAxis_C /end AXIS_DESCR
/end CHARACTERISTIC
/begin CHARACTERISTIC CTLC_IdRateLimit_C "Rate limiter for d-axis current change" VALUE 0x0000 /* @ECU_Address@CTLC_IdRateLimit_C@ */ Record_FLOAT32_IEEE 0 CtlTorqueLoopController_CM_single 0.000000 20000.000000 /end CHARACTERISTIC
/begin CHARACTERISTIC CTLC_IdSetpointCal_C "D-axis current setpoint for calibration mode" VALUE 0x0000 /* @ECU_Address@CTLC_IdSetpointCal_C@ */ Record_FLOAT32_IEEE 0 CtlTorqueLoopController_CM_single_A -2000.000000 2000.000000 /end CHARACTERISTIC
/begin CHARACTERISTIC CTLC_IqMapMotor_C "" /* Characteristic Type */ CUBOID 0x0000 /* @ECU_Address@CTLC_IqMapMotor_C@ */ Record_FLOAT32_IEEE /* Maxdiff */ 0 CtlTorqueLoopController_CM_single -3.4E+38 3.4E+38
 /begin AXIS_DESCR /* Description of X-Axis Points */ COM_AXIS NO_INPUT_QUANTITY CtlTorqueLoopController_CM_single 50 -3.4E+38 3.4E+38 AXIS_PTS_REF CTLC_TorqueAxis_C /end AXIS_DESCR
 /begin AXIS_DESCR /* Description of Y-Axis Points */ COM_AXIS NO_INPUT_QUANTITY CtlTorqueLoopController_CM_single 35 -3.4E+38 3.4E+38 AXIS_PTS_REF CTLC_SpeedAxis_C /end AXIS_DESCR
 /begin AXIS_DESCR /* Description of Z-Axis Points */ COM_AXIS SGPP_DcLinkVoltMeas CtlTorqueLoopController_CM_single 3 -3.4E+38 3.4E+38 AXIS_PTS_REF CTLC_VoltageAxis_C /end AXIS_DESCR
/end CHARACTERISTIC
/begin CHARACTERISTIC CTLC_IqRateLimit_C "Rate limiter for q-axis current change" VALUE 0x0000 /* @ECU_Address@CTLC_IqRateLimit_C@ */ Record_FLOAT32_IEEE 0 CtlTorqueLoopController_CM_single 0.000000 20000.000000 /end CHARACTERISTIC
/begin CHARACTERISTIC CTLC_IqSetpointCal_C "Q-axis current setpoint for calibration mode" VALUE 0x0000 /* @ECU_Address@CTLC_IqSetpointCal_C@ */ Record_FLOAT32_IEEE 0 CtlTorqueLoopController_CM_single_A -2000.000000 2000.000000 /end CHARACTERISTIC
/begin CHARACTERISTIC CTLC_SpeedCorrMax_C "Maximum speed correction during flux weakening" VALUE 0x0000 /* @ECU_Address@CTLC_SpeedCorrMax_C@ */ Record_FLOAT32_IEEE 0 CtlTorqueLoopController_CM_single_rpm -100000.000000 100000.000000 /end CHARACTERISTIC
/begin CHARACTERISTIC CTLC_SpeedCtrlKi_C "Integral gain of speed PI controller" VALUE 0x0000 /* @ECU_Address@CTLC_SpeedCtrlKi_C@ */ Record_FLOAT32_IEEE 0 CtlTorqueLoopController_CM_single 0.000000 10000.000000 /end CHARACTERISTIC
/begin CHARACTERISTIC CTLC_SpeedCtrlKp_C "Proportional gain of speed PI controller" VALUE 0x0000 /* @ECU_Address@CTLC_SpeedCtrlKp_C@ */ Record_FLOAT32_IEEE 0 CtlTorqueLoopController_CM_single 0.000000 10000.000000 /end CHARACTERISTIC
/begin CHARACTERISTIC CTLC_SpeedFilterFreq_C "Filter cutoff frequency for interpolation speed" VALUE 0x0000 /* @ECU_Address@CTLC_SpeedFilterFreq_C@ */ Record_FLOAT32_IEEE 0 CtlTorqueLoopController_CM_single_Hz 0.000000 100000.000000 /end CHARACTERISTIC
/begin CHARACTERISTIC CTLC_VoltReserveEarly_C "Voltage factor for early flux weakening activation" VALUE 0x0000 /* @ECU_Address@CTLC_VoltReserveEarly_C@ */ Record_FLOAT32_IEEE 0 CtlTorqueLoopController_CM_single 0.000000 10000.000000 /end CHARACTERISTIC
/begin MEASUREMENT CTCR_VoltVectorMagFiltered "" FLOAT32_IEEE CtlTorqueLoopController_CM_single 0 0 -3.4E+38 3.4E+38 ECU_ADDRESS 0x0000 /* @ECU_Address@CTCR_VoltVectorMagFiltered@ */ /end MEASUREMENT
/begin MEASUREMENT CTDM_TorqueLimitNeg "" FLOAT32_IEEE CtlTorqueLoopController_CM_single 0 0 -3.4E+38 3.4E+38 ECU_ADDRESS 0x0000 /* @ECU_Address@CTDM_TorqueLimitNeg@ */ /end MEASUREMENT
/begin MEASUREMENT CTDM_TorqueLimitPos "" FLOAT32_IEEE CtlTorqueLoopController_CM_single 0 0 -3.4E+38 3.4E+38 ECU_ADDRESS 0x0000 /* @ECU_Address@CTDM_TorqueLimitPos@ */ /end MEASUREMENT
/begin MEASUREMENT CTDM_TorqueSpLimited "" FLOAT32_IEEE CtlTorqueLoopController_CM_single 0 0 -3.4E+38 3.4E+38 ECU_ADDRESS 0x0000 /* @ECU_Address@CTDM_TorqueSpLimited@ */ /end MEASUREMENT
/begin MEASUREMENT CTLC_IdSpLimited "D-axis current reference after limitation for control loop" FLOAT32_IEEE CtlTorqueLoopController_CM_single_A 0 0 -2000.000000 2000.000000 /* Array Size */ ARRAY_SIZE 1 ECU_ADDRESS 0x0000 /* @ECU_Address@CTLC_IdSpLimited@ */ /end MEASUREMENT
/begin MEASUREMENT CTLC_IqSpLimited "Q-axis current reference after limitation for control loop" FLOAT32_IEEE CtlTorqueLoopController_CM_single_A 0 0 -2000.000000 2000.000000 /* Array Size */ ARRAY_SIZE 1 ECU_ADDRESS 0x0000 /* @ECU_Address@CTLC_IqSpLimited@ */ /end MEASUREMENT
/begin MEASUREMENT CTSO_OperationMode "" UBYTE CtlTorqueLoopController_CM_EnumCtlMode 0 0 0 14 ECU_ADDRESS 0x0000 /* @ECU_Address@CTSO_OperationMode@ */ /end MEASUREMENT
/begin MEASUREMENT CTSO_SpeedIntegralDisable "" UBYTE CtlTorqueLoopController_CM_boolean 0 0 0 1 ECU_ADDRESS 0x0000 /* @ECU_Address@CTSO_SpeedIntegralDisable@ */ /end MEASUREMENT
/begin MEASUREMENT CTSO_SpeedIntegralReset "" FLOAT32_IEEE CtlTorqueLoopController_CM_single 0 0 -3.4E+38 3.4E+38 ECU_ADDRESS 0x0000 /* @ECU_Address@CTSO_SpeedIntegralReset@ */ /end MEASUREMENT
/begin MEASUREMENT CtlTorqueLoopController_DW.Delay1_DSTATE "" FLOAT32_IEEE CtlTorqueLoopController_CM_single 0 0 -3.4E+38 3.4E+38 ECU_ADDRESS 0x0000 /* @ECU_Address@CtlTorqueLoopController_DW.Delay1_DSTATE@ */ /end MEASUREMENT
/begin MEASUREMENT CtlTorqueLoopController_DW.Delay1_DSTATE_l "" FLOAT32_IEEE CtlTorqueLoopController_CM_single 0 0 -3.4E+38 3.4E+38 ECU_ADDRESS 0x0000 /* @ECU_Address@CtlTorqueLoopController_DW.Delay1_DSTATE_l@ */ /end MEASUREMENT
/begin MEASUREMENT CtlTorqueLoopController_DW.Delay_DSTATE "" FLOAT32_IEEE CtlTorqueLoopController_CM_single 0 0 -3.4E+38 3.4E+38 ECU_ADDRESS 0x0000 /* @ECU_Address@CtlTorqueLoopController_DW.Delay_DSTATE@ */ /end MEASUREMENT
/begin MEASUREMENT CtlTorqueLoopController_DW.Delay_DSTATE_b "" UBYTE CtlTorqueLoopController_CM_uint8 0 0 0 255 ECU_ADDRESS 0x0000 /* @ECU_Address@CtlTorqueLoopController_DW.Delay_DSTATE_b@ */ /end MEASUREMENT
/begin MEASUREMENT CtlTorqueLoopController_DW.Delay_DSTATE_e "" UBYTE CtlTorqueLoopController_CM_boolean 0 0 0 1 ECU_ADDRESS 0x0000 /* @ECU_Address@CtlTorqueLoopController_DW.Delay_DSTATE_e@ */ /end MEASUREMENT
/begin MEASUREMENT CtlTorqueLoopController_DW.Delay_DSTATE_f "" FLOAT32_IEEE CtlTorqueLoopController_CM_single 0 0 -3.4E+38 3.4E+38 ECU_ADDRESS 0x0000 /* @ECU_Address@CtlTorqueLoopController_DW.Delay_DSTATE_f@ */ /end MEASUREMENT
/begin MEASUREMENT CtlTorqueLoopController_DW.Delay_DSTATE_g "" FLOAT32_IEEE CtlTorqueLoopController_CM_single 0 0 -3.4E+38 3.4E+38 ECU_ADDRESS 0x0000 /* @ECU_Address@CtlTorqueLoopController_DW.Delay_DSTATE_g@ */ /end MEASUREMENT
/begin MEASUREMENT CtlTorqueLoopController_DW.Delay_DSTATE_h "" FLOAT32_IEEE CtlTorqueLoopController_CM_single 0 0 -3.4E+38 3.4E+38 ECU_ADDRESS 0x0000 /* @ECU_Address@CtlTorqueLoopController_DW.Delay_DSTATE_h@ */ /end MEASUREMENT
/begin MEASUREMENT CtlTorqueLoopController_DW.Delay_DSTATE_p "" FLOAT32_IEEE CtlTorqueLoopController_CM_single 0 0 -3.4E+38 3.4E+38 ECU_ADDRESS 0x0000 /* @ECU_Address@CtlTorqueLoopController_DW.Delay_DSTATE_p@ */ /end MEASUREMENT
/begin MEASUREMENT CtlTorqueLoopController_DW.Delay_DSTATE_p4 "" UBYTE CtlTorqueLoopController_CM_uint8 0 0 0 255 ECU_ADDRESS 0x0000 /* @ECU_Address@CtlTorqueLoopController_DW.Delay_DSTATE_p4@ */ /end MEASUREMENT
/begin MEASUREMENT CtlTorqueLoopController_DW.UnitDelay_DSTATE "" FLOAT32_IEEE CtlTorqueLoopController_CM_single 0 0 -3.4E+38 3.4E+38 ECU_ADDRESS 0x0000 /* @ECU_Address@CtlTorqueLoopController_DW.UnitDelay_DSTATE@ */ /end MEASUREMENT
/begin MEASUREMENT CtlTorqueLoopController_DW.UnitDelay_DSTATE_a "" UBYTE CtlTorqueLoopController_CM_uint8 0 0 0 255 ECU_ADDRESS 0x0000 /* @ECU_Address@CtlTorqueLoopController_DW.UnitDelay_DSTATE_a@ */ /end MEASUREMENT
/begin MEASUREMENT CtlTorqueLoopController_DW.icLoad "" UBYTE CtlTorqueLoopController_CM_boolean 0 0 0 1 ECU_ADDRESS 0x0000 /* @ECU_Address@CtlTorqueLoopController_DW.icLoad@ */ /end MEASUREMENT
/begin MEASUREMENT CtlTorqueLoopController_DW.icLoad_e "" UBYTE CtlTorqueLoopController_CM_boolean 0 0 0 1 ECU_ADDRESS 0x0000 /* @ECU_Address@CtlTorqueLoopController_DW.icLoad_e@ */ /end MEASUREMENT
/begin MEASUREMENT CtlTorqueLoopController_DW.icLoad_g "" UBYTE CtlTorqueLoopController_CM_boolean 0 0 0 1 ECU_ADDRESS 0x0000 /* @ECU_Address@CtlTorqueLoopController_DW.icLoad_g@ */ /end MEASUREMENT
/begin MEASUREMENT CtlTorqueLoopController_DW.icLoad_h "" UBYTE CtlTorqueLoopController_CM_boolean 0 0 0 1 ECU_ADDRESS 0x0000 /* @ECU_Address@CtlTorqueLoopController_DW.icLoad_h@ */ /end MEASUREMENT
/begin MEASUREMENT CtlTorqueLoopController_DW.icLoad_h5 "" UBYTE CtlTorqueLoopController_CM_boolean 0 0 0 1 ECU_ADDRESS 0x0000 /* @ECU_Address@CtlTorqueLoopController_DW.icLoad_h5@ */ /end MEASUREMENT
/begin MEASUREMENT CtlTorqueLoopController_DW.icLoad_i "" UBYTE CtlTorqueLoopController_CM_boolean 0 0 0 1 ECU_ADDRESS 0x0000 /* @ECU_Address@CtlTorqueLoopController_DW.icLoad_i@ */ /end MEASUREMENT
/begin MEASUREMENT CtlTorqueLoopController_DW.icLoad_n "" UBYTE CtlTorqueLoopController_CM_boolean 0 0 0 1 ECU_ADDRESS 0x0000 /* @ECU_Address@CtlTorqueLoopController_DW.icLoad_n@ */ /end MEASUREMENT
/begin MEASUREMENT CtlTorqueLoopController_DW.icLoad_o "" UBYTE CtlTorqueLoopController_CM_boolean 0 0 0 1 ECU_ADDRESS 0x0000 /* @ECU_Address@CtlTorqueLoopController_DW.icLoad_o@ */ /end MEASUREMENT
/begin MEASUREMENT SGPP_DcLinkVoltMeas "" FLOAT32_IEEE CtlTorqueLoopController_CM_single 0 0 -3.4E+38 3.4E+38 ECU_ADDRESS 0x0000 /* @ECU_Address@SGPP_DcLinkVoltMeas@ */ /end MEASUREMENT
/begin MEASUREMENT SGPP_MechSpeed "" FLOAT32_IEEE CtlTorqueLoopController_CM_single 0 0 -3.4E+38 3.4E+38 ECU_ADDRESS 0x0000 /* @ECU_Address@SGPP_MechSpeed@ */ /end MEASUREMENT
/begin MEASUREMENT SGPP_SampleTime2 "" FLOAT32_IEEE CtlTorqueLoopController_CM_single 0 0 -3.4E+38 3.4E+38 ECU_ADDRESS 0x0000 /* @ECU_Address@SGPP_SampleTime2@ */ /end MEASUREMENT
/begin MEASUREMENT SGPP_SpeedSp "" FLOAT32_IEEE CtlTorqueLoopController_CM_single 0 0 -3.4E+38 3.4E+38 ECU_ADDRESS 0x0000 /* @ECU_Address@SGPP_SpeedSp@ */ /end MEASUREMENT
/begin AXIS_PTS CTLC_SpeedAxis_C "" 0x0000 /* @ECU_Address@CTLC_SpeedAxis_C@ */ NO_INPUT_QUANTITY Axis_FLOAT32_IEEE 0 CtlTorqueLoopController_CM_single 35 -3.4E+38 3.4E+38 /end AXIS_PTS
/begin AXIS_PTS CTLC_TorqueAxis_C "" 0x0000 /* @ECU_Address@CTLC_TorqueAxis_C@ */ NO_INPUT_QUANTITY Axis_FLOAT32_IEEE 0 CtlTorqueLoopController_CM_single 50 -3.4E+38 3.4E+38 /end AXIS_PTS
/begin AXIS_PTS CTLC_VoltageAxis_C "" 0x0000 /* @ECU_Address@CTLC_VoltageAxis_C@ */ NO_INPUT_QUANTITY Axis_FLOAT32_IEEE 0 CtlTorqueLoopController_CM_single 3 -3.4E+38 3.4E+38 /end AXIS_PTS
/begin COMPU_METHOD CtlTorqueLoopController_CM_EnumCtlMode "Enumerated data type: EnumCtlMode" TAB_VERB "%0.6" "" /* Conversion Table */ COMPU_TAB_REF VTAB_FOR_CtlTorqueLoopController_CM_EnumCtlMode /end COMPU_METHOD
/begin COMPU_VTAB /* Name of Table */ VTAB_FOR_CtlTorqueLoopController_CM_EnumCtlMode "Enumerated data type: EnumCtlMode" TAB_VERB /* Number of Elements */ 15 0 "Init" 1 "LowVoltReady" 2 "HighVoltStandby" 3 "Ready" 4 "HighVoltDischarge" 5 "LowVoltDischarge" 6 "Discharge" 7 "PowerDown" 8 "Fault" 9 "OpenLoopCtrl" 10 "VoltDirectCtrl" 11 "CurrCtrl" 12 "TorqueCtrl" 13 "SpeedCtrl" 14 "ZeroPointCal" /end COMPU_VTAB
/begin COMPU_METHOD CtlTorqueLoopController_CM_boolean "Q = V" RAT_FUNC "%1.0" "" COEFFS 0 1 0 0 0 1 /end COMPU_METHOD
/begin COMPU_METHOD CtlTorqueLoopController_CM_single "Q = V" RAT_FUNC "%8.6" "" COEFFS 0 1 0 0 0 1 /end COMPU_METHOD
/begin COMPU_METHOD CtlTorqueLoopController_CM_single_A "Q = V" RAT_FUNC "%8.6" "A" COEFFS 0 1 0 0 0 1 /end COMPU_METHOD
/begin COMPU_METHOD CtlTorqueLoopController_CM_single_Hz "Q = V" RAT_FUNC "%8.6" "Hz" COEFFS 0 1 0 0 0 1 /end COMPU_METHOD
/begin COMPU_METHOD CtlTorqueLoopController_CM_single_V "Q = V" RAT_FUNC "%8.6" "V" COEFFS 0 1 0 0 0 1 /end COMPU_METHOD
/begin COMPU_METHOD CtlTorqueLoopController_CM_single_rpm "Q = V" RAT_FUNC "%8.6" "rpm" COEFFS 0 1 0 0 0 1 /end COMPU_METHOD
/begin COMPU_METHOD CtlTorqueLoopController_CM_uint8 "Q = V" RAT_FUNC "%3.0" "" COEFFS 0 1 0 0 0 1 /end COMPU_METHOD
/begin RECORD_LAYOUT Record_BOOLEAN FNC_VALUES 1 UBYTE COLUMN_DIR DIRECT /end RECORD_LAYOUT
/begin RECORD_LAYOUT Record_FLOAT32_IEEE FNC_VALUES 1 FLOAT32_IEEE COLUMN_DIR DIRECT /end RECORD_LAYOUT
/begin RECORD_LAYOUT Record_UBYTE FNC_VALUES 1 UBYTE COLUMN_DIR DIRECT /end RECORD_LAYOUT
/* Record Layouts for Lookup Tables in Standard Axis format */
/begin RECORD_LAYOUT Axis_FLOAT32_IEEE AXIS_PTS_X 1 FLOAT32_IEEE INDEX_INCR DIRECT /end RECORD_LAYOUT
/begin GROUP CtlTorqueLoopController "CtlTorqueLoopController" /* Root */ ROOT /begin SUB_GROUP CtlTorqueLoopController_CTLC_CalcIdIqRef_1ms_sys /end SUB_GROUP
 /begin REF_MEASUREMENT CTCR_VoltVectorMagFiltered CTDM_TorqueLimitNeg CTDM_TorqueLimitPos CTDM_TorqueSpLimited CTSO_OperationMode CTSO_SpeedIntegralDisable CTSO_SpeedIntegralReset SGPP_DcLinkVoltMeas SGPP_MechSpeed SGPP_SampleTime2 SGPP_SpeedSp /end REF_MEASUREMENT
/end GROUP
/begin GROUP CtlTorqueLoopController_CTLC_CalcIdIqRef_1ms_sys "CtlTorqueLoopController/CTLC_CalcIdIqRef_1ms_sys"
 /begin SUB_GROUP CtlTorqueLoopController_CTLC_CalcIdIqRef_1ms_sys_IdIqRefCompute CtlTorqueLoopController_CTLC_CalcIdIqRef_1ms_sys_IdIqRefLimit /end SUB_GROUP
/end GROUP
/begin GROUP CtlTorqueLoopController_CTLC_CalcIdIqRef_1ms_sys_IdIqRefCompute "CtlTorqueLoopController/CTLC_CalcIdIqRef_1ms_sys/IdIqRefCompute"
 /begin SUB_GROUP CtlTorqueLoopController_CTLC_CalcIdIqRef_1ms_sys_IdIqRefCompute_CurrentModeGen CtlTorqueLoopController_CTLC_CalcIdIqRef_1ms_sys_IdIqRefCompute_DischargeModeGen CtlTorqueLoopController_CTLC_CalcIdIqRef_1ms_sys_IdIqRefCompute_SpeedTorqueMode /end SUB_GROUP
 /begin REF_MEASUREMENT CTSO_OperationMode CtlTorqueLoopController_DW.UnitDelay_DSTATE_a /end REF_MEASUREMENT
/end GROUP
/begin GROUP CtlTorqueLoopController_CTLC_CalcIdIqRef_1ms_sys_IdIqRefCompute_CurrentModeGen "CtlTorqueLoopController/CTLC_CalcIdIqRef_1ms_sys/IdIqRefCompute/CurrentModeGen"
 /begin SUB_GROUP CtlTorqueLoopController_CTLC_CalcIdIqRef_1ms_sys_IdIqRefCompute_CurrentModeGen_Parameter1 CtlTorqueLoopController_CTLC_CalcIdIqRef_1ms_sys_IdIqRefCompute_CurrentModeGen_Parameter2 CtlTorqueLoopController_CTLC_CalcIdIqRef_1ms_sys_IdIqRefCompute_CurrentModeGen_Parameter3 CtlTorqueLoopController_CTLC_CalcIdIqRef_1ms_sys_IdIqRefCompute_CurrentModeGen_Parameter7 CtlTorqueLoopController_CTLC_CalcIdIqRef_1ms_sys_IdIqRefCompute_CurrentModeGen_RateLimiter CtlTorqueLoopController_CTLC_CalcIdIqRef_1ms_sys_IdIqRefCompute_CurrentModeGen_RateLimiter1 /end SUB_GROUP
/end GROUP
/begin GROUP CtlTorqueLoopController_CTLC_CalcIdIqRef_1ms_sys_IdIqRefCompute_CurrentModeGen_Parameter1 "CtlTorqueLoopController/CTLC_CalcIdIqRef_1ms_sys/IdIqRefCompute/CurrentModeGen/Parameter1" /begin REF_CHARACTERISTIC CTLC_IqSetpointCal_C /end REF_CHARACTERISTIC /end GROUP
/begin GROUP CtlTorqueLoopController_CTLC_CalcIdIqRef_1ms_sys_IdIqRefCompute_CurrentModeGen_Parameter2 "CtlTorqueLoopController/CTLC_CalcIdIqRef_1ms_sys/IdIqRefCompute/CurrentModeGen/Parameter2" /begin REF_CHARACTERISTIC CTLC_IdRateLimit_C /end REF_CHARACTERISTIC /end GROUP
/begin GROUP CtlTorqueLoopController_CTLC_CalcIdIqRef_1ms_sys_IdIqRefCompute_CurrentModeGen_Parameter3 "CtlTorqueLoopController/CTLC_CalcIdIqRef_1ms_sys/IdIqRefCompute/CurrentModeGen/Parameter3" /begin REF_CHARACTERISTIC CTLC_IqRateLimit_C /end REF_CHARACTERISTIC /end GROUP
/begin GROUP CtlTorqueLoopController_CTLC_CalcIdIqRef_1ms_sys_IdIqRefCompute_CurrentModeGen_Parameter7 "CtlTorqueLoopController/CTLC_CalcIdIqRef_1ms_sys/IdIqRefCompute/CurrentModeGen/Parameter7" /begin REF_CHARACTERISTIC CTLC_IdSetpointCal_C /end REF_CHARACTERISTIC /end GROUP
/begin GROUP CtlTorqueLoopController_CTLC_CalcIdIqRef_1ms_sys_IdIqRefCompute_CurrentModeGen_RateLimiter "CtlTorqueLoopController/CTLC_CalcIdIqRef_1ms_sys/IdIqRefCompute/CurrentModeGen/RateLimiter"
 /begin REF_MEASUREMENT CtlTorqueLoopController_DW.Delay_DSTATE_g CtlTorqueLoopController_DW.icLoad_e SGPP_SampleTime2 /end REF_MEASUREMENT
/end GROUP
/begin GROUP CtlTorqueLoopController_CTLC_CalcIdIqRef_1ms_sys_IdIqRefCompute_CurrentModeGen_RateLimiter1 "CtlTorqueLoopController/CTLC_CalcIdIqRef_1ms_sys/IdIqRefCompute/CurrentModeGen/RateLimiter1"
 /begin REF_MEASUREMENT CtlTorqueLoopController_DW.Delay_DSTATE_p CtlTorqueLoopController_DW.icLoad_h5 SGPP_SampleTime2 /end REF_MEASUREMENT
/end GROUP
/begin GROUP CtlTorqueLoopController_CTLC_CalcIdIqRef_1ms_sys_IdIqRefCompute_DischargeModeGen "CtlTorqueLoopController/CTLC_CalcIdIqRef_1ms_sys/IdIqRefCompute/DischargeModeGen"
 /begin SUB_GROUP CtlTorqueLoopController_CTLC_CalcIdIqRef_1ms_sys_IdIqRefCompute_DischargeModeGen_Parameter2 /end SUB_GROUP
/end GROUP
/begin GROUP CtlTorqueLoopController_CTLC_CalcIdIqRef_1ms_sys_IdIqRefCompute_DischargeModeGen_Parameter2 "CtlTorqueLoopController/CTLC_CalcIdIqRef_1ms_sys/IdIqRefCompute/DischargeModeGen/Parameter2" /begin REF_CHARACTERISTIC CTLC_IdDischargeMode_C /end REF_CHARACTERISTIC /end GROUP
/begin GROUP CtlTorqueLoopController_CTLC_CalcIdIqRef_1ms_sys_IdIqRefCompute_SpeedTorqueMode "CtlTorqueLoopController/CTLC_CalcIdIqRef_1ms_sys/IdIqRefCompute/SpeedTorqueMode"
 /begin SUB_GROUP CtlTorqueLoopController_CTLC_CalcIdIqRef_1ms_sys_IdIqRefCompute_SpeedTorqueMode_IdIqFromTorque CtlTorqueLoopController_CTLC_CalcIdIqRef_1ms_sys_IdIqRefCompute_SpeedTorqueMode_TorqueRefCalc /end SUB_GROUP
/end GROUP
/begin GROUP CtlTorqueLoopController_CTLC_CalcIdIqRef_1ms_sys_IdIqRefCompute_SpeedTorqueMode_IdIqFromTorque "CtlTorqueLoopController/CTLC_CalcIdIqRef_1ms_sys/IdIqRefCompute/SpeedTorqueMode/IdIqFromTorque"
 /begin SUB_GROUP CtlTorqueLoopController_CTLC_CalcIdIqRef_1ms_sys_IdIqRefCompute_SpeedTorqueMode_IdIqFromTorque_IdIqCmdLookup CtlTorqueLoopController_CTLC_CalcIdIqRef_1ms_sys_IdIqRefCompute_SpeedTorqueMode_IdIqFromTorque_SpeedCalcForLookup /end SUB_GROUP
/end GROUP
/begin GROUP CtlTorqueLoopController_CTLC_CalcIdIqRef_1ms_sys_IdIqRefCompute_SpeedTorqueMode_IdIqFromTorque_IdIqCmdLookup "CtlTorqueLoopController/CTLC_CalcIdIqRef_1ms_sys/IdIqRefCompute/SpeedTorqueMode/IdIqFromTorque/IdIqCmdLookup"
 /begin REF_CHARACTERISTIC CTLC_IdMapMotor_C CTLC_IqMapMotor_C CTLC_SpeedAxis_C CTLC_TorqueAxis_C CTLC_VoltageAxis_C /end REF_CHARACTERISTIC
 /begin REF_MEASUREMENT SGPP_DcLinkVoltMeas /end REF_MEASUREMENT
/end GROUP
/begin GROUP CtlTorqueLoopController_CTLC_CalcIdIqRef_1ms_sys_IdIqRefCompute_SpeedTorqueMode_IdIqFromTorque_SpeedCalcForLookup "CtlTorqueLoopController/CTLC_CalcIdIqRef_1ms_sys/IdIqRefCompute/SpeedTorqueMode/IdIqFromTorque/SpeedCalcForLookup"
 /begin SUB_GROUP CtlTorqueLoopController_CTLC_CalcIdIqRef_1ms_sys_IdIqRefCompute_SpeedTorqueMode_IdIqFromTorque_SpeedCalcForLookup_CalcUVecMax CtlTorqueLoopController_CTLC_CalcIdIqRef_1ms_sys_IdIqRefCompute_SpeedTorqueMode_IdIqFromTorque_SpeedCalcForLookup_FwCtl CtlTorqueLoopController_CTLC_CalcIdIqRef_1ms_sys_IdIqRefCompute_SpeedTorqueMode_IdIqFromTorque_SpeedCalcForLookup_Limit CtlTorqueLoopController_CTLC_CalcIdIqRef_1ms_sys_IdIqRefCompute_SpeedTorqueMode_IdIqFromTorque_SpeedCalcForLookup_StateFw /end SUB_GROUP
/end GROUP
/begin GROUP CtlTorqueLoopController_CTLC_CalcIdIqRef_1ms_sys_IdIqRefCompute_SpeedTorqueMode_IdIqFromTorque_SpeedCalcForLookup_CalcUVecMax "CtlTorqueLoopController/CTLC_CalcIdIqRef_1ms_sys/IdIqRefCompute/SpeedTorqueMode/IdIqFromTorque/SpeedCalcForLookup/CalcUVecMax"
 /begin SUB_GROUP CtlTorqueLoopController_CTLC_CalcIdIqRef_1ms_sys_IdIqRefCompute_SpeedTorqueMode_IdIqFromTorque_SpeedCalcForLookup_CalcUVecMax_Parameter2 /end SUB_GROUP
 /begin REF_MEASUREMENT SGPP_DcLinkVoltMeas /end REF_MEASUREMENT
/end GROUP
/begin GROUP CtlTorqueLoopController_CTLC_CalcIdIqRef_1ms_sys_IdIqRefCompute_SpeedTorqueMode_IdIqFromTorque_SpeedCalcForLookup_CalcUVecMax_Parameter2 "CtlTorqueLoopController/CTLC_CalcIdIqRef_1ms_sys/IdIqRefCompute/SpeedTorqueMode/IdIqFromTorque/SpeedCalcForLookup/CalcUVecMax/Parameter2" /begin REF_CHARACTERISTIC CTLC_VoltReserveEarly_C /end REF_CHARACTERISTIC /end GROUP
/begin GROUP CtlTorqueLoopController_CTLC_CalcIdIqRef_1ms_sys_IdIqRefCompute_SpeedTorqueMode_IdIqFromTorque_SpeedCalcForLookup_FwCtl "CtlTorqueLoopController/CTLC_CalcIdIqRef_1ms_sys/IdIqRefCompute/SpeedTorqueMode/IdIqFromTorque/SpeedCalcForLookup/FwCtl"
 /begin SUB_GROUP CtlTorqueLoopController_CTLC_CalcIdIqRef_1ms_sys_IdIqRefCompute_SpeedTorqueMode_IdIqFromTorque_SpeedCalcForLookup_FwCtl_Fw_PI CtlTorqueLoopController_CTLC_CalcIdIqRef_1ms_sys_IdIqRefCompute_SpeedTorqueMode_IdIqFromTorque_SpeedCalcForLookup_FwCtl_Parameter1 CtlTorqueLoopController_CTLC_CalcIdIqRef_1ms_sys_IdIqRefCompute_SpeedTorqueMode_IdIqFromTorque_SpeedCalcForLookup_FwCtl_Parameter2 CtlTorqueLoopController_CTLC_CalcIdIqRef_1ms_sys_IdIqRefCompute_SpeedTorqueMode_IdIqFromTorque_SpeedCalcForLookup_FwCtl_Parameter3 CtlTorqueLoopController_CTLC_CalcIdIqRef_1ms_sys_IdIqRefCompute_SpeedTorqueMode_IdIqFromTorque_SpeedCalcForLookup_FwCtl_RampDown /end SUB_GROUP
 /begin REF_MEASUREMENT CTCR_VoltVectorMagFiltered /end REF_MEASUREMENT
/end GROUP
/begin GROUP CtlTorqueLoopController_CTLC_CalcIdIqRef_1ms_sys_IdIqRefCompute_SpeedTorqueMode_IdIqFromTorque_SpeedCalcForLookup_FwCtl_Fw_PI "CtlTorqueLoopController/CTLC_CalcIdIqRef_1ms_sys/IdIqRefCompute/SpeedTorqueMode/IdIqFromTorque/SpeedCalcForLookup/FwCtl/Fw_PI"
 /begin REF_MEASUREMENT CtlTorqueLoopController_DW.Delay1_DSTATE CtlTorqueLoopController_DW.Delay_DSTATE CtlTorqueLoopController_DW.icLoad CtlTorqueLoopController_DW.icLoad_o SGPP_SampleTime2 /end REF_MEASUREMENT
/end GROUP
/begin GROUP CtlTorqueLoopController_CTLC_CalcIdIqRef_1ms_sys_IdIqRefCompute_SpeedTorqueMode_IdIqFromTorque_SpeedCalcForLookup_FwCtl_Parameter1 "CtlTorqueLoopController/CTLC_CalcIdIqRef_1ms_sys/IdIqRefCompute/SpeedTorqueMode/IdIqFromTorque/SpeedCalcForLookup/FwCtl/Parameter1" /begin REF_CHARACTERISTIC CTLC_FluxWknKp_C /end REF_CHARACTERISTIC /end GROUP
/begin GROUP CtlTorqueLoopController_CTLC_CalcIdIqRef_1ms_sys_IdIqRefCompute_SpeedTorqueMode_IdIqFromTorque_SpeedCalcForLookup_FwCtl_Parameter2 "CtlTorqueLoopController/CTLC_CalcIdIqRef_1ms_sys/IdIqRefCompute/SpeedTorqueMode/IdIqFromTorque/SpeedCalcForLookup/FwCtl/Parameter2" /begin REF_CHARACTERISTIC CTLC_FluxWknEnable_C /end REF_CHARACTERISTIC /end GROUP
/begin GROUP CtlTorqueLoopController_CTLC_CalcIdIqRef_1ms_sys_IdIqRefCompute_SpeedTorqueMode_IdIqFromTorque_SpeedCalcForLookup_FwCtl_Parameter3 "CtlTorqueLoopController/CTLC_CalcIdIqRef_1ms_sys/IdIqRefCompute/SpeedTorqueMode/IdIqFromTorque/SpeedCalcForLookup/FwCtl/Parameter3" /begin REF_CHARACTERISTIC CTLC_FluxWknKi_C /end REF_CHARACTERISTIC /end GROUP
/begin GROUP CtlTorqueLoopController_CTLC_CalcIdIqRef_1ms_sys_IdIqRefCompute_SpeedTorqueMode_IdIqFromTorque_SpeedCalcForLookup_FwCtl_RampDown "CtlTorqueLoopController/CTLC_CalcIdIqRef_1ms_sys/IdIqRefCompute/SpeedTorqueMode/IdIqFromTorque/SpeedCalcForLookup/FwCtl/RampDown"
 /begin SUB_GROUP CtlTorqueLoopController_CTLC_CalcIdIqRef_1ms_sys_IdIqRefCompute_SpeedTorqueMode_IdIqFromTorque_SpeedCalcForLookup_FwCtl_RampDown_Parameter2 CtlTorqueLoopController_CTLC_CalcIdIqRef_1ms_sys_IdIqRefCompute_SpeedTorqueMode_IdIqFromTorque_SpeedCalcForLookup_FwCtl_RampDown_RateLimiter /end SUB_GROUP
/end GROUP
/begin GROUP CtlTorqueLoopController_CTLC_CalcIdIqRef_1ms_sys_IdIqRefCompute_SpeedTorqueMode_IdIqFromTorque_SpeedCalcForLookup_FwCtl_RampDown_Parameter2 "CtlTorqueLoopController/CTLC_CalcIdIqRef_1ms_sys/IdIqRefCompute/SpeedTorqueMode/IdIqFromTorque/SpeedCalcForLookup/FwCtl/RampDown/Parameter2" /begin REF_CHARACTERISTIC CTLC_FluxWknDeactRate_C /end REF_CHARACTERISTIC /end GROUP
/begin GROUP CtlTorqueLoopController_CTLC_CalcIdIqRef_1ms_sys_IdIqRefCompute_SpeedTorqueMode_IdIqFromTorque_SpeedCalcForLookup_FwCtl_RampDown_RateLimiter "CtlTorqueLoopController/CTLC_CalcIdIqRef_1ms_sys/IdIqRefCompute/SpeedTorqueMode/IdIqFromTorque/SpeedCalcForLookup/FwCtl/RampDown/RateLimiter"
 /begin REF_MEASUREMENT CtlTorqueLoopController_DW.UnitDelay_DSTATE SGPP_SampleTime2 /end REF_MEASUREMENT
/end GROUP
/begin GROUP CtlTorqueLoopController_CTLC_CalcIdIqRef_1ms_sys_IdIqRefCompute_SpeedTorqueMode_IdIqFromTorque_SpeedCalcForLookup_Limit "CtlTorqueLoopController/CTLC_CalcIdIqRef_1ms_sys/IdIqRefCompute/SpeedTorqueMode/IdIqFromTorque/SpeedCalcForLookup/Limit"
 /begin SUB_GROUP CtlTorqueLoopController_CTLC_CalcIdIqRef_1ms_sys_IdIqRefCompute_SpeedTorqueMode_IdIqFromTorque_SpeedCalcForLookup_Limit_LowPassFilter CtlTorqueLoopController_CTLC_CalcIdIqRef_1ms_sys_IdIqRefCompute_SpeedTorqueMode_IdIqFromTorque_SpeedCalcForLookup_Limit_Parameter CtlTorqueLoopController_CTLC_CalcIdIqRef_1ms_sys_IdIqRefCompute_SpeedTorqueMode_IdIqFromTorque_SpeedCalcForLookup_Limit_Saturation /end SUB_GROUP
 /begin REF_MEASUREMENT SGPP_MechSpeed /end REF_MEASUREMENT
/end GROUP
/begin GROUP CtlTorqueLoopController_CTLC_CalcIdIqRef_1ms_sys_IdIqRefCompute_SpeedTorqueMode_IdIqFromTorque_SpeedCalcForLookup_Limit_LowPassFilter "CtlTorqueLoopController/CTLC_CalcIdIqRef_1ms_sys/IdIqRefCompute/SpeedTorqueMode/IdIqFromTorque/SpeedCalcForLookup/Limit/LowPassFilter" /begin REF_MEASUREMENT CtlTorqueLoopController_DW.Delay_DSTATE_h SGPP_SampleTime2 /end REF_MEASUREMENT /end GROUP
/begin GROUP CtlTorqueLoopController_CTLC_CalcIdIqRef_1ms_sys_IdIqRefCompute_SpeedTorqueMode_IdIqFromTorque_SpeedCalcForLookup_Limit_Parameter "CtlTorqueLoopController/CTLC_CalcIdIqRef_1ms_sys/IdIqRefCompute/SpeedTorqueMode/IdIqFromTorque/SpeedCalcForLookup/Limit/Parameter" /begin REF_CHARACTERISTIC CTLC_SpeedFilterFreq_C /end REF_CHARACTERISTIC /end GROUP
/begin GROUP CtlTorqueLoopController_CTLC_CalcIdIqRef_1ms_sys_IdIqRefCompute_SpeedTorqueMode_IdIqFromTorque_SpeedCalcForLookup_Limit_Saturation "CtlTorqueLoopController/CTLC_CalcIdIqRef_1ms_sys/IdIqRefCompute/SpeedTorqueMode/IdIqFromTorque/SpeedCalcForLookup/Limit/Saturation"
 /begin SUB_GROUP CtlTorqueLoopController_CTLC_CalcIdIqRef_1ms_sys_IdIqRefCompute_SpeedTorqueMode_IdIqFromTorque_SpeedCalcForLookup_Limit_Saturation_EnaAntiWindup CtlTorqueLoopController_CTLC_CalcIdIqRef_1ms_sys_IdIqRefCompute_SpeedTorqueMode_IdIqFromTorque_SpeedCalcForLookup_Limit_Saturation_Saturation /end SUB_GROUP
/end GROUP
/begin GROUP CtlTorqueLoopController_CTLC_CalcIdIqRef_1ms_sys_IdIqRefCompute_SpeedTorqueMode_IdIqFromTorque_SpeedCalcForLookup_Limit_Saturation_EnaAntiWindup "CtlTorqueLoopController/CTLC_CalcIdIqRef_1ms_sys/IdIqRefCompute/SpeedTorqueMode/IdIqFromTorque/SpeedCalcForLookup/Limit/Saturation/EnaAntiWindup"
 /begin REF_MEASUREMENT CtlTorqueLoopController_DW.Delay_DSTATE_b CtlTorqueLoopController_DW.icLoad_n /end REF_MEASUREMENT
/end GROUP
/begin GROUP CtlTorqueLoopController_CTLC_CalcIdIqRef_1ms_sys_IdIqRefCompute_SpeedTorqueMode_IdIqFromTorque_SpeedCalcForLookup_Limit_Saturation_Saturation "CtlTorqueLoopController/CTLC_CalcIdIqRef_1ms_sys/IdIqRefCompute/SpeedTorqueMode/IdIqFromTorque/SpeedCalcForLookup/Limit/Saturation/Saturation"
 /begin SUB_GROUP CtlTorqueLoopController_CTLC_CalcIdIqRef_1ms_sys_IdIqRefCompute_SpeedTorqueMode_IdIqFromTorque_SpeedCalcForLookup_Limit_Saturation_Saturation_Parameter /end SUB_GROUP
/end GROUP
/begin GROUP CtlTorqueLoopController_CTLC_CalcIdIqRef_1ms_sys_IdIqRefCompute_SpeedTorqueMode_IdIqFromTorque_SpeedCalcForLookup_Limit_Saturation_Saturation_Parameter "CtlTorqueLoopController/CTLC_CalcIdIqRef_1ms_sys/IdIqRefCompute/SpeedTorqueMode/IdIqFromTorque/SpeedCalcForLookup/Limit/Saturation/Saturation/Parameter" /begin REF_CHARACTERISTIC CTLC_SpeedCorrMax_C /end REF_CHARACTERISTIC /end GROUP
/begin GROUP CtlTorqueLoopController_CTLC_CalcIdIqRef_1ms_sys_IdIqRefCompute_SpeedTorqueMode_IdIqFromTorque_SpeedCalcForLookup_StateFw "CtlTorqueLoopController/CTLC_CalcIdIqRef_1ms_sys/IdIqRefCompute/SpeedTorqueMode/IdIqFromTorque/SpeedCalcForLookup/StateFw"
 /begin SUB_GROUP CtlTorqueLoopController_CTLC_CalcIdIqRef_1ms_sys_IdIqRefCompute_SpeedTorqueMode_IdIqFromTorque_SpeedCalcForLookup_StateFw_HysteresisCtrl CtlTorqueLoopController_CTLC_CalcIdIqRef_1ms_sys_IdIqRefCompute_SpeedTorqueMode_IdIqFromTorque_SpeedCalcForLookup_StateFw_Parameter2 /end SUB_GROUP
 /begin REF_MEASUREMENT CTCR_VoltVectorMagFiltered /end REF_MEASUREMENT
/end GROUP
/begin GROUP CtlTorqueLoopController_CTLC_CalcIdIqRef_1ms_sys_IdIqRefCompute_SpeedTorqueMode_IdIqFromTorque_SpeedCalcForLookup_StateFw_HysteresisCtrl "CtlTorqueLoopController/CTLC_CalcIdIqRef_1ms_sys/IdIqRefCompute/SpeedTorqueMode/IdIqFromTorque/SpeedCalcForLookup/StateFw/HysteresisCtrl" /begin REF_MEASUREMENT CtlTorqueLoopController_DW.Delay_DSTATE_e /end REF_MEASUREMENT /end GROUP
/begin GROUP CtlTorqueLoopController_CTLC_CalcIdIqRef_1ms_sys_IdIqRefCompute_SpeedTorqueMode_IdIqFromTorque_SpeedCalcForLookup_StateFw_Parameter2 "CtlTorqueLoopController/CTLC_CalcIdIqRef_1ms_sys/IdIqRefCompute/SpeedTorqueMode/IdIqFromTorque/SpeedCalcForLookup/StateFw/Parameter2" /begin REF_CHARACTERISTIC CTLC_FluxWknVoltHyst_C /end REF_CHARACTERISTIC /end GROUP
/begin GROUP CtlTorqueLoopController_CTLC_CalcIdIqRef_1ms_sys_IdIqRefCompute_SpeedTorqueMode_TorqueRefCalc "CtlTorqueLoopController/CTLC_CalcIdIqRef_1ms_sys/IdIqRefCompute/SpeedTorqueMode/TorqueRefCalc"
 /begin SUB_GROUP CtlTorqueLoopController_CTLC_CalcIdIqRef_1ms_sys_IdIqRefCompute_SpeedTorqueMode_TorqueRefCalc_SpeedModeRefCalc /end SUB_GROUP
 /begin REF_MEASUREMENT CTSO_OperationMode /end REF_MEASUREMENT
/end GROUP
/begin GROUP CtlTorqueLoopController_CTLC_CalcIdIqRef_1ms_sys_IdIqRefCompute_SpeedTorqueMode_TorqueRefCalc_SpeedModeRefCalc "CtlTorqueLoopController/CTLC_CalcIdIqRef_1ms_sys/IdIqRefCompute/SpeedTorqueMode/TorqueRefCalc/SpeedModeRefCalc"
 /begin SUB_GROUP CtlTorqueLoopController_CTLC_CalcIdIqRef_1ms_sys_IdIqRefCompute_SpeedTorqueMode_TorqueRefCalc_SpeedModeRefCalc_EnAwUp CtlTorqueLoopController_CTLC_CalcIdIqRef_1ms_sys_IdIqRefCompute_SpeedTorqueMode_TorqueRefCalc_SpeedModeRefCalc_PI_SpeedLoop CtlTorqueLoopController_CTLC_CalcIdIqRef_1ms_sys_IdIqRefCompute_SpeedTorqueMode_TorqueRefCalc_SpeedModeRefCalc_Parameter1 CtlTorqueLoopController_CTLC_CalcIdIqRef_1ms_sys_IdIqRefCompute_SpeedTorqueMode_TorqueRefCalc_SpeedModeRefCalc_Parameter7 CtlTorqueLoopController_CTLC_CalcIdIqRef_1ms_sys_IdIqRefCompute_SpeedTorqueMode_TorqueRefCalc_SpeedModeRefCalc_TqSaturation /end SUB_GROUP
/end GROUP
/begin GROUP CtlTorqueLoopController_CTLC_CalcIdIqRef_1ms_sys_IdIqRefCompute_SpeedTorqueMode_TorqueRefCalc_SpeedModeRefCalc_EnAwUp "CtlTorqueLoopController/CTLC_CalcIdIqRef_1ms_sys/IdIqRefCompute/SpeedTorqueMode/TorqueRefCalc/SpeedModeRefCalc/EnAwUp"
 /begin REF_MEASUREMENT CTSO_SpeedIntegralReset CtlTorqueLoopController_DW.Delay_DSTATE_p4 CtlTorqueLoopController_DW.icLoad_i /end REF_MEASUREMENT
/end GROUP
/begin GROUP CtlTorqueLoopController_CTLC_CalcIdIqRef_1ms_sys_IdIqRefCompute_SpeedTorqueMode_TorqueRefCalc_SpeedModeRefCalc_PI_SpeedLoop "CtlTorqueLoopController/CTLC_CalcIdIqRef_1ms_sys/IdIqRefCompute/SpeedTorqueMode/TorqueRefCalc/SpeedModeRefCalc/PI_SpeedLoop"
 /begin REF_MEASUREMENT CTSO_SpeedIntegralDisable CTSO_SpeedIntegralReset CtlTorqueLoopController_DW.Delay1_DSTATE_l CtlTorqueLoopController_DW.Delay_DSTATE_f CtlTorqueLoopController_DW.icLoad_g CtlTorqueLoopController_DW.icLoad_h SGPP_MechSpeed SGPP_SampleTime2 SGPP_SpeedSp /end REF_MEASUREMENT
/end GROUP
/begin GROUP CtlTorqueLoopController_CTLC_CalcIdIqRef_1ms_sys_IdIqRefCompute_SpeedTorqueMode_TorqueRefCalc_SpeedModeRefCalc_Parameter1 "CtlTorqueLoopController/CTLC_CalcIdIqRef_1ms_sys/IdIqRefCompute/SpeedTorqueMode/TorqueRefCalc/SpeedModeRefCalc/Parameter1" /begin REF_CHARACTERISTIC CTLC_SpeedCtrlKi_C /end REF_CHARACTERISTIC /end GROUP
/begin GROUP CtlTorqueLoopController_CTLC_CalcIdIqRef_1ms_sys_IdIqRefCompute_SpeedTorqueMode_TorqueRefCalc_SpeedModeRefCalc_Parameter7 "CtlTorqueLoopController/CTLC_CalcIdIqRef_1ms_sys/IdIqRefCompute/SpeedTorqueMode/TorqueRefCalc/SpeedModeRefCalc/Parameter7" /begin REF_CHARACTERISTIC CTLC_SpeedCtrlKp_C /end REF_CHARACTERISTIC /end GROUP
/begin GROUP CtlTorqueLoopController_CTLC_CalcIdIqRef_1ms_sys_IdIqRefCompute_SpeedTorqueMode_TorqueRefCalc_SpeedModeRefCalc_TqSaturation "CtlTorqueLoopController/CTLC_CalcIdIqRef_1ms_sys/IdIqRefCompute/SpeedTorqueMode/TorqueRefCalc/SpeedModeRefCalc/TqSaturation"
 /begin SUB_GROUP CtlTorqueLoopController_CTLC_CalcIdIqRef_1ms_sys_IdIqRefCompute_SpeedTorqueMode_TorqueRefCalc_SpeedModeRefCalc_TqSaturation_Saturation_Dynamic /end SUB_GROUP
/end GROUP
/begin GROUP CtlTorqueLoopController_CTLC_CalcIdIqRef_1ms_sys_IdIqRefCompute_SpeedTorqueMode_TorqueRefCalc_SpeedModeRefCalc_TqSaturation_Saturation_Dynamic "CtlTorqueLoopController/CTLC_CalcIdIqRef_1ms_sys/IdIqRefCompute/SpeedTorqueMode/TorqueRefCalc/SpeedModeRefCalc/TqSaturation/Saturation
Dynamic" /begin REF_MEASUREMENT CTDM_TorqueLimitNeg CTDM_TorqueLimitPos /end REF_MEASUREMENT /end GROUP
/begin GROUP CtlTorqueLoopController_CTLC_CalcIdIqRef_1ms_sys_IdIqRefLimit "CtlTorqueLoopController/CTLC_CalcIdIqRef_1ms_sys/IdIqRefLimit"
 /begin SUB_GROUP CtlTorqueLoopController_CTLC_CalcIdIqRef_1ms_sys_IdIqRefLimit_Parameter7 /end SUB_GROUP
/end GROUP
/begin GROUP CtlTorqueLoopController_CTLC_CalcIdIqRef_1ms_sys_IdIqRefLimit_Parameter7 "CtlTorqueLoopController/CTLC_CalcIdIqRef_1ms_sys/IdIqRefLimit/Parameter7" /begin REF_CHARACTERISTIC CTLC_CurrentMax_C /end REF_CHARACTERISTIC /end GROUP
/end MODULE
/end PROJECT
/* (add any file trailer comments here) */
/* EOF CtlTorqueLoopController.a2l*/
