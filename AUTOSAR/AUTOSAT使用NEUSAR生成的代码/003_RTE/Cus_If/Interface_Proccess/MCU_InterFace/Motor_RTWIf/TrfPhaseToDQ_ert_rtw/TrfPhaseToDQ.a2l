/******************************************************************************
* ASAP2 file: TrfPhaseToDQ.a2l
* Code generation for model "TrfPhaseToDQ".
* Model version : 1.6
* Simulink Coder version : 10.6 R2022b
* C source code generated on : Thu May 28 16:28:24 2026
* Target selection: ert.tlc
* Embedded hardware selection: Infineon->TriCore
* Code generation objectives: Unspecified
* Validation result: Not run
* (add additional file header information here)
******************************************************************************/ ASAP2_VERSION 1 31
/* Version 1.31 */
/begin PROJECT ProjectName "Project Comment Goes Here"
/begin HEADER "Header Comments go here" /end HEADER
/begin MODULE ModuleName "Module Comment Goes Here"
/begin MOD_PAR "MOD PAR Comment Goes Here" /end MOD_PAR
/begin MOD_COMMON "Mod Common Comment Here" BYTE_ORDER MSB_LAST ALIGNMENT_BYTE 1 ALIGNMENT_WORD 2 ALIGNMENT_LONG 4 ALIGNMENT_FLOAT32_IEEE 4 ALIGNMENT_FLOAT64_IEEE 4 /end MOD_COMMON
/begin CHARACTERISTIC TFPD_DAxisFiltFreq_C "Cutoff frequency for d-axis current filter" VALUE 0x0000 /* @ECU_Address@TFPD_DAxisFiltFreq_C@ */ Record_FLOAT32_IEEE 0 TrfPhaseToDQ_CM_single_Hz 0.000000 50000.000000 /end CHARACTERISTIC
/begin CHARACTERISTIC TFPD_QAxisFiltFreq_C "Cutoff frequency for q-axis current filter" VALUE 0x0000 /* @ECU_Address@TFPD_QAxisFiltFreq_C@ */ Record_FLOAT32_IEEE 0 TrfPhaseToDQ_CM_single_Hz 0.000000 50000.000000 /end CHARACTERISTIC
/begin CHARACTERISTIC TFPD_SensorSelection_C "Current sensor configuration selection (1-4)" VALUE 0x0000 /* @ECU_Address@TFPD_SensorSelection_C@ */ Record_UBYTE 0 TrfPhaseToDQ_CM_uint8_dash_ 0.000000 4.000000 /end CHARACTERISTIC
/begin MEASUREMENT SGPP_ElecAngle "" FLOAT32_IEEE TrfPhaseToDQ_CM_single 0 0 -3.4E+38 3.4E+38 ARRAY_SIZE 1 ECU_ADDRESS 0x0000 /* @ECU_Address@SGPP_ElecAngle@ */ /end MEASUREMENT
/begin MEASUREMENT SGPP_PhaseACurrent "" FLOAT32_IEEE TrfPhaseToDQ_CM_single_A 0 0 -3.4E+38 3.4E+38 ARRAY_SIZE 1 ECU_ADDRESS 0x0000 /* @ECU_Address@SGPP_PhaseACurrent@ */ /end MEASUREMENT
/begin MEASUREMENT SGPP_PhaseBCurrent "" FLOAT32_IEEE TrfPhaseToDQ_CM_single 0 0 -3.4E+38 3.4E+38 ARRAY_SIZE 1 ECU_ADDRESS 0x0000 /* @ECU_Address@SGPP_PhaseBCurrent@ */ /end MEASUREMENT
/begin MEASUREMENT SGPP_PhaseCCurrent "" FLOAT32_IEEE TrfPhaseToDQ_CM_single 0 0 -3.4E+38 3.4E+38 ARRAY_SIZE 1 ECU_ADDRESS 0x0000 /* @ECU_Address@SGPP_PhaseCCurrent@ */ /end MEASUREMENT
/begin MEASUREMENT SGPP_SampleTime1 "" FLOAT32_IEEE TrfPhaseToDQ_CM_single 0 0 -3.4E+38 3.4E+38 ARRAY_SIZE 1 ECU_ADDRESS 0x0000 /* @ECU_Address@SGPP_SampleTime1@ */ /end MEASUREMENT
/begin MEASUREMENT TFPD_AlphaCurrent "Alpha-axis current in stationary reference frame" FLOAT32_IEEE TrfPhaseToDQ_CM_single_A 0 0 -2000.000000 2000.000000 ECU_ADDRESS 0x0000 /* @ECU_Address@TFPD_AlphaCurrent@ */ /end MEASUREMENT
/begin MEASUREMENT TFPD_BetaCurrent "Beta-axis current in stationary reference frame" FLOAT32_IEEE TrfPhaseToDQ_CM_single_A 0 0 -2000.000000 2000.000000 ECU_ADDRESS 0x0000 /* @ECU_Address@TFPD_BetaCurrent@ */ /end MEASUREMENT
/begin MEASUREMENT TFPD_CurrentMagFilt "Filtered magnitude of current vector" FLOAT32_IEEE TrfPhaseToDQ_CM_single_A 0 0 -2000.000000 2000.000000 ARRAY_SIZE 1 ECU_ADDRESS 0x0000 /* @ECU_Address@TFPD_CurrentMagFilt@ */ /end MEASUREMENT
/begin MEASUREMENT TFPD_IdFiltered "Filtered d-axis current after low-pass filtering" FLOAT32_IEEE TrfPhaseToDQ_CM_single_A 0 0 -2000.000000 2000.000000 ARRAY_SIZE 1 ECU_ADDRESS 0x0000 /* @ECU_Address@TFPD_IdFiltered@ */ /end MEASUREMENT
/begin MEASUREMENT TFPD_IdMeasured "Measured d-axis current" FLOAT32_IEEE TrfPhaseToDQ_CM_single_A 0 0 -2000.000000 2000.000000 ARRAY_SIZE 1 ECU_ADDRESS 0x0000 /* @ECU_Address@TFPD_IdMeasured@ */ /end MEASUREMENT
/begin MEASUREMENT TFPD_IqFiltered "Filtered q-axis current after low-pass filtering" FLOAT32_IEEE TrfPhaseToDQ_CM_single_A 0 0 -2000.000000 2000.000000 ARRAY_SIZE 1 ECU_ADDRESS 0x0000 /* @ECU_Address@TFPD_IqFiltered@ */ /end MEASUREMENT
/begin MEASUREMENT TFPD_IqMeasured "Measured q-axis current" FLOAT32_IEEE TrfPhaseToDQ_CM_single_A 0 0 -2000.000000 2000.000000 ARRAY_SIZE 1 ECU_ADDRESS 0x0000 /* @ECU_Address@TFPD_IqMeasured@ */ /end MEASUREMENT
/begin COMPU_METHOD TrfPhaseToDQ_CM_single "Q = V" RAT_FUNC "%8.6" "" COEFFS 0 1 0 0 0 1 /end COMPU_METHOD
/begin COMPU_METHOD TrfPhaseToDQ_CM_single_A "Q = V" RAT_FUNC "%8.6" "A" COEFFS 0 1 0 0 0 1 /end COMPU_METHOD
/begin COMPU_METHOD TrfPhaseToDQ_CM_single_Hz "Q = V" RAT_FUNC "%8.6" "Hz" COEFFS 0 1 0 0 0 1 /end COMPU_METHOD
/begin COMPU_METHOD TrfPhaseToDQ_CM_uint8_dash_ "Q = V" RAT_FUNC "%3.0" "-" COEFFS 0 1 0 0 0 1 /end COMPU_METHOD
/begin RECORD_LAYOUT Record_FLOAT32_IEEE FNC_VALUES 1 FLOAT32_IEEE COLUMN_DIR DIRECT /end RECORD_LAYOUT
/begin RECORD_LAYOUT Record_UBYTE FNC_VALUES 1 UBYTE COLUMN_DIR DIRECT /end RECORD_LAYOUT
/begin GROUP TrfPhaseToDQ "TrfPhaseToDQ" /* Root */ ROOT /begin SUB_GROUP TrfPhaseToDQ_TFPD_ClarkeParkTransform_100us_sys /end SUB_GROUP
 /begin REF_MEASUREMENT SGPP_ElecAngle SGPP_PhaseACurrent SGPP_PhaseBCurrent SGPP_PhaseCCurrent SGPP_SampleTime1 /end REF_MEASUREMENT
/end GROUP
/begin GROUP TrfPhaseToDQ_TFPD_ClarkeParkTransform_100us_sys "TrfPhaseToDQ/TFPD_ClarkeParkTransform_100us_sys"
 /begin SUB_GROUP TrfPhaseToDQ_TFPD_ClarkeParkTransform_100us_sys_ClarkeTransform TrfPhaseToDQ_TFPD_ClarkeParkTransform_100us_sys_ParkTransform /end SUB_GROUP
/end GROUP
/begin GROUP TrfPhaseToDQ_TFPD_ClarkeParkTransform_100us_sys_ClarkeTransform "TrfPhaseToDQ/TFPD_ClarkeParkTransform_100us_sys/ClarkeTransform"
 /begin SUB_GROUP TrfPhaseToDQ_TFPD_ClarkeParkTransform_100us_sys_ClarkeTransform_ClarkAB_AmpInv TrfPhaseToDQ_TFPD_ClarkeParkTransform_100us_sys_ClarkeTransform_ClarkeABC_AmpInv TrfPhaseToDQ_TFPD_ClarkeParkTransform_100us_sys_ClarkeTransform_ClarkeAC_AmpInv TrfPhaseToDQ_TFPD_ClarkeParkTransform_100us_sys_ClarkeTransform_ClarkeBC_AmpInv TrfPhaseToDQ_TFPD_ClarkeParkTransform_100us_sys_ClarkeTransform_Local_Variable_Storage TrfPhaseToDQ_TFPD_ClarkeParkTransform_100us_sys_ClarkeTransform_Local_Variable_Storage1 TrfPhaseToDQ_TFPD_ClarkeParkTransform_100us_sys_ClarkeTransform_Parameter /end SUB_GROUP
/end GROUP
/begin GROUP TrfPhaseToDQ_TFPD_ClarkeParkTransform_100us_sys_ClarkeTransform_ClarkAB_AmpInv "TrfPhaseToDQ/TFPD_ClarkeParkTransform_100us_sys/ClarkeTransform/ClarkAB_AmpInv" /begin REF_MEASUREMENT SGPP_PhaseACurrent SGPP_PhaseBCurrent /end REF_MEASUREMENT /end GROUP
/begin GROUP TrfPhaseToDQ_TFPD_ClarkeParkTransform_100us_sys_ClarkeTransform_ClarkeABC_AmpInv "TrfPhaseToDQ/TFPD_ClarkeParkTransform_100us_sys/ClarkeTransform/ClarkeABC_AmpInv" /begin REF_MEASUREMENT SGPP_PhaseACurrent SGPP_PhaseBCurrent SGPP_PhaseCCurrent /end REF_MEASUREMENT /end GROUP
/begin GROUP TrfPhaseToDQ_TFPD_ClarkeParkTransform_100us_sys_ClarkeTransform_ClarkeAC_AmpInv "TrfPhaseToDQ/TFPD_ClarkeParkTransform_100us_sys/ClarkeTransform/ClarkeAC_AmpInv" /begin REF_MEASUREMENT SGPP_PhaseACurrent SGPP_PhaseCCurrent /end REF_MEASUREMENT /end GROUP
/begin GROUP TrfPhaseToDQ_TFPD_ClarkeParkTransform_100us_sys_ClarkeTransform_ClarkeBC_AmpInv "TrfPhaseToDQ/TFPD_ClarkeParkTransform_100us_sys/ClarkeTransform/ClarkeBC_AmpInv" /begin REF_MEASUREMENT SGPP_PhaseBCurrent SGPP_PhaseCCurrent /end REF_MEASUREMENT /end GROUP
/begin GROUP TrfPhaseToDQ_TFPD_ClarkeParkTransform_100us_sys_ClarkeTransform_Local_Variable_Storage "TrfPhaseToDQ/TFPD_ClarkeParkTransform_100us_sys/ClarkeTransform/Local Variable Storage" /begin REF_MEASUREMENT TFPD_AlphaCurrent /end REF_MEASUREMENT /end GROUP
/begin GROUP TrfPhaseToDQ_TFPD_ClarkeParkTransform_100us_sys_ClarkeTransform_Local_Variable_Storage1 "TrfPhaseToDQ/TFPD_ClarkeParkTransform_100us_sys/ClarkeTransform/Local Variable Storage1" /begin REF_MEASUREMENT TFPD_BetaCurrent /end REF_MEASUREMENT /end GROUP
/begin GROUP TrfPhaseToDQ_TFPD_ClarkeParkTransform_100us_sys_ClarkeTransform_Parameter "TrfPhaseToDQ/TFPD_ClarkeParkTransform_100us_sys/ClarkeTransform/Parameter" /begin REF_CHARACTERISTIC TFPD_SensorSelection_C /end REF_CHARACTERISTIC /end GROUP
/begin GROUP TrfPhaseToDQ_TFPD_ClarkeParkTransform_100us_sys_ParkTransform "TrfPhaseToDQ/TFPD_ClarkeParkTransform_100us_sys/ParkTransform"
 /begin SUB_GROUP TrfPhaseToDQ_TFPD_ClarkeParkTransform_100us_sys_ParkTransform_LowPassFilter TrfPhaseToDQ_TFPD_ClarkeParkTransform_100us_sys_ParkTransform_LowPassFilter1 TrfPhaseToDQ_TFPD_ClarkeParkTransform_100us_sys_ParkTransform_Parameter TrfPhaseToDQ_TFPD_ClarkeParkTransform_100us_sys_ParkTransform_Parameter1 /end SUB_GROUP
 /begin REF_MEASUREMENT SGPP_ElecAngle /end REF_MEASUREMENT
/end GROUP
/begin GROUP TrfPhaseToDQ_TFPD_ClarkeParkTransform_100us_sys_ParkTransform_LowPassFilter "TrfPhaseToDQ/TFPD_ClarkeParkTransform_100us_sys/ParkTransform/LowPassFilter" /begin REF_MEASUREMENT SGPP_SampleTime1 /end REF_MEASUREMENT /end GROUP
/begin GROUP TrfPhaseToDQ_TFPD_ClarkeParkTransform_100us_sys_ParkTransform_LowPassFilter1 "TrfPhaseToDQ/TFPD_ClarkeParkTransform_100us_sys/ParkTransform/LowPassFilter1" /begin REF_MEASUREMENT SGPP_SampleTime1 /end REF_MEASUREMENT /end GROUP
/begin GROUP TrfPhaseToDQ_TFPD_ClarkeParkTransform_100us_sys_ParkTransform_Parameter "TrfPhaseToDQ/TFPD_ClarkeParkTransform_100us_sys/ParkTransform/Parameter" /begin REF_CHARACTERISTIC TFPD_DAxisFiltFreq_C /end REF_CHARACTERISTIC /end GROUP
/begin GROUP TrfPhaseToDQ_TFPD_ClarkeParkTransform_100us_sys_ParkTransform_Parameter1 "TrfPhaseToDQ/TFPD_ClarkeParkTransform_100us_sys/ParkTransform/Parameter1" /begin REF_CHARACTERISTIC TFPD_QAxisFiltFreq_C /end REF_CHARACTERISTIC /end GROUP
/end MODULE
/end PROJECT
/* (add any file trailer comments here) */
/* EOF TrfPhaseToDQ.a2l*/
