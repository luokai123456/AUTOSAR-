/******************************************************************************
* ASAP2 file: SigSignalAdapter.a2l
* Code generation for model "SigSignalAdapter".
* Model version : 1.342
* Simulink Coder version : 10.6 R2022b
* C source code generated on : Tue Oct 13 17:10:44 2026
* Target selection: ert.tlc
* Embedded hardware selection: Infineon->TriCore
* Code generation objectives: Unspecified
* Validation result: Not run
* (add additional file header information here)
******************************************************************************/ ASAP2_VERSION 1 71
/* Version 1.71 */
/begin PROJECT ProjectName "Project Comment Goes Here"
/begin HEADER "Header Comments go here" /end HEADER
/begin MODULE ModuleName "Module Comment Goes Here"
/begin MOD_PAR "MOD PAR Comment Goes Here" /end MOD_PAR
/begin MOD_COMMON "Mod Common Comment Here" BYTE_ORDER MSB_LAST ALIGNMENT_BYTE 1 ALIGNMENT_WORD 2 ALIGNMENT_LONG 4 ALIGNMENT_FLOAT32_IEEE 4 ALIGNMENT_FLOAT64_IEEE 8 ALIGNMENT_INT64 8 /end MOD_COMMON
/begin CHARACTERISTIC SGSA_BatteryVoltGain_C "Battery voltage sensor gain calibration" VALUE 0x0000 /* @ECU_Address@SGSA_BatteryVoltGain_C@ */ Record_FLOAT32_IEEE 0 SigSignalAdapter_CM_single -3.4E+38 3.4E+38 /end CHARACTERISTIC
/begin CHARACTERISTIC SGSA_BatteryVoltOffset_C "Battery voltage sensor offset calibration" VALUE 0x0000 /* @ECU_Address@SGSA_BatteryVoltOffset_C@ */ Record_FLOAT32_IEEE 0 SigSignalAdapter_CM_single -3.4E+38 3.4E+38 /end CHARACTERISTIC
/begin CHARACTERISTIC SGSA_ClrHWFaultEnable_C "" VALUE 0x0000 /* @ECU_Address@SGSA_ClrHWFaultEnable_C@ */ Record_UBYTE 0 SigSignalAdapter_CM_uint8 0.000000 200.000000 /end CHARACTERISTIC
/begin CHARACTERISTIC SGSA_ClrHWFault_C "" VALUE 0x0000 /* @ECU_Address@SGSA_ClrHWFault_C@ */ Record_BOOLEAN 0 SigSignalAdapter_CM_logical 0.000000 1.000000 /end CHARACTERISTIC
/begin CHARACTERISTIC SGSA_DcLinkVoltGain_C "DC-link voltage sensor gain calibration" VALUE 0x0000 /* @ECU_Address@SGSA_DcLinkVoltGain_C@ */ Record_FLOAT32_IEEE 0 SigSignalAdapter_CM_single -3.4E+38 3.4E+38 /end CHARACTERISTIC
/begin CHARACTERISTIC SGSA_DcLinkVoltOffset_C "DC-link voltage sensor offset calibration" VALUE 0x0000 /* @ECU_Address@SGSA_DcLinkVoltOffset_C@ */ Record_FLOAT32_IEEE 0 SigSignalAdapter_CM_single -3.4E+38 3.4E+38 /end CHARACTERISTIC
/begin CHARACTERISTIC SGSA_IgnitionAVoltGain_C "" VALUE 0x0000 /* @ECU_Address@SGSA_IgnitionAVoltGain_C@ */ Record_FLOAT32_IEEE 0 SigSignalAdapter_CM_single -3.4E+38 3.4E+38 /end CHARACTERISTIC
/begin CHARACTERISTIC SGSA_IgnitionAVoltOffset_C "" VALUE 0x0000 /* @ECU_Address@SGSA_IgnitionAVoltOffset_C@ */ Record_FLOAT32_IEEE 0 SigSignalAdapter_CM_single -3.4E+38 3.4E+38 /end CHARACTERISTIC
/begin CHARACTERISTIC SGSA_IgnitionBVoltGain_C "" VALUE 0x0000 /* @ECU_Address@SGSA_IgnitionBVoltGain_C@ */ Record_FLOAT32_IEEE 0 SigSignalAdapter_CM_single -3.4E+38 3.4E+38 /end CHARACTERISTIC
/begin CHARACTERISTIC SGSA_IgnitionBVoltOffset_C "" VALUE 0x0000 /* @ECU_Address@SGSA_IgnitionBVoltOffset_C@ */ Record_FLOAT32_IEEE 0 SigSignalAdapter_CM_single -3.4E+38 3.4E+38 /end CHARACTERISTIC
/begin CHARACTERISTIC SGSA_IgnitionCVoltGain_C "Ignition voltage sensor gain calibration" VALUE 0x0000 /* @ECU_Address@SGSA_IgnitionCVoltGain_C@ */ Record_FLOAT32_IEEE 0 SigSignalAdapter_CM_single -3.4E+38 3.4E+38 /end CHARACTERISTIC
/begin CHARACTERISTIC SGSA_IgnitionCVoltOffset_C "Ignition voltage sensor offset calibration" VALUE 0x0000 /* @ECU_Address@SGSA_IgnitionCVoltOffset_C@ */ Record_FLOAT32_IEEE 0 SigSignalAdapter_CM_single -3.4E+38 3.4E+38 /end CHARACTERISTIC
/begin CHARACTERISTIC SGSA_KL15VoltGain_C "" VALUE 0x0000 /* @ECU_Address@SGSA_KL15VoltGain_C@ */ Record_FLOAT32_IEEE 0 SigSignalAdapter_CM_single -3.4E+38 3.4E+38 /end CHARACTERISTIC
/begin CHARACTERISTIC SGSA_Kl15VoltOffset_C "" VALUE 0x0000 /* @ECU_Address@SGSA_Kl15VoltOffset_C@ */ Record_FLOAT32_IEEE 0 SigSignalAdapter_CM_single -3.4E+38 3.4E+38 /end CHARACTERISTIC
/begin CHARACTERISTIC SGSA_MotorInitAngleOffset_C "Initial angle offset for motor alignment" VALUE 0x0000 /* @ECU_Address@SGSA_MotorInitAngleOffset_C@ */ Record_FLOAT32_IEEE 0 SigSignalAdapter_CM_single -3.4E+38 3.4E+38 /end CHARACTERISTIC
/begin CHARACTERISTIC SGSA_MotorTempGain_C "Motor temperature sensor gain calibration" VALUE 0x0000 /* @ECU_Address@SGSA_MotorTempGain_C@ */ Record_FLOAT32_IEEE 0 SigSignalAdapter_CM_single -3.4E+38 3.4E+38 /end CHARACTERISTIC
/begin CHARACTERISTIC SGSA_MotorTempOffset_C "Motor temperature sensor offset calibration" VALUE 0x0000 /* @ECU_Address@SGSA_MotorTempOffset_C@ */ Record_FLOAT32_IEEE 0 SigSignalAdapter_CM_single -3.4E+38 3.4E+38 /end CHARACTERISTIC
/begin CHARACTERISTIC SGSA_PhaseACurrentGain_C "Phase A current sensor gain calibration value" VALUE 0x0000 /* @ECU_Address@SGSA_PhaseACurrentGain_C@ */ Record_FLOAT32_IEEE 0 SigSignalAdapter_CM_single -100.000000 100.000000 /end CHARACTERISTIC
/begin CHARACTERISTIC SGSA_PhaseAPwmDuty_C "Phase A PWM duty cycle parameter setpoint" VALUE 0x0000 /* @ECU_Address@SGSA_PhaseAPwmDuty_C@ */ Record_FLOAT32_IEEE 0 SigSignalAdapter_CM_single_percent_ 0.000000 200.000000 /end CHARACTERISTIC
/begin CHARACTERISTIC SGSA_PhaseBPwmDuty_C "Phase B PWM duty cycle parameter setpoint" VALUE 0x0000 /* @ECU_Address@SGSA_PhaseBPwmDuty_C@ */ Record_FLOAT32_IEEE 0 SigSignalAdapter_CM_single_percent_ 0.000000 200.000000 /end CHARACTERISTIC
/begin CHARACTERISTIC SGSA_PhaseCCurrentGain_C "" VALUE 0x0000 /* @ECU_Address@SGSA_PhaseCCurrentGain_C@ */ Record_FLOAT32_IEEE 0 SigSignalAdapter_CM_single -3.4E+38 3.4E+38 /end CHARACTERISTIC
/begin CHARACTERISTIC SGSA_PhaseCPwmDuty_C "Phase C PWM duty cycle parameter setpoint" VALUE 0x0000 /* @ECU_Address@SGSA_PhaseCPwmDuty_C@ */ Record_FLOAT32_IEEE 0 SigSignalAdapter_CM_single_percent_ 0.000000 200.000000 /end CHARACTERISTIC
/begin CHARACTERISTIC SGSA_PowerChipVoltGain_C "Battery voltage sensor gain calibration" VALUE 0x0000 /* @ECU_Address@SGSA_PowerChipVoltGain_C@ */ Record_FLOAT32_IEEE 0 SigSignalAdapter_CM_single -3.4E+38 3.4E+38 /end CHARACTERISTIC
/begin CHARACTERISTIC SGSA_PowerChipVoltOffset_C "" VALUE 0x0000 /* @ECU_Address@SGSA_PowerChipVoltOffset_C@ */ Record_FLOAT32_IEEE 0 SigSignalAdapter_CM_single -3.4E+38 3.4E+38 /end CHARACTERISTIC
/begin CHARACTERISTIC SGSA_PwmParamEnable_C "Enable flag for PWM parameter setpoint mode" VALUE 0x0000 /* @ECU_Address@SGSA_PwmParamEnable_C@ */ Record_UBYTE 0 SigSignalAdapter_CM_uint8_dash_ 0.000000 255.000000 /end CHARACTERISTIC
/begin CHARACTERISTIC SGSA_SetDriverStsEnable_C "" VALUE 0x0000 /* @ECU_Address@SGSA_SetDriverStsEnable_C@ */ Record_UBYTE 0 SigSignalAdapter_CM_uint8 0.000000 200.000000 /end CHARACTERISTIC
/begin CHARACTERISTIC SGSA_SetDriverSts_C "" VALUE 0x0000 /* @ECU_Address@SGSA_SetDriverSts_C@ */ Record_UBYTE 0 SigSignalAdapter_CM_uint8 0.000000 200.000000 /end CHARACTERISTIC
/begin CHARACTERISTIC SGSA_SetFreqEnable_C "" VALUE 0x0000 /* @ECU_Address@SGSA_SetFreqEnable_C@ */ Record_UBYTE 0 SigSignalAdapter_CM_uint8 0.000000 200.000000 /end CHARACTERISTIC
/begin CHARACTERISTIC SGSA_SetFreq_C "" VALUE 0x0000 /* @ECU_Address@SGSA_SetFreq_C@ */ Record_FLOAT32_IEEE 0 SigSignalAdapter_CM_single 0.000000 20000.000000 /end CHARACTERISTIC
/begin CHARACTERISTIC SGSA_SetHighASCFlgEnable_C "" VALUE 0x0000 /* @ECU_Address@SGSA_SetHighASCFlgEnable_C@ */ Record_UBYTE 0 SigSignalAdapter_CM_uint8 0.000000 200.000000 /end CHARACTERISTIC
/begin CHARACTERISTIC SGSA_SetHighASCFlg_C "" VALUE 0x0000 /* @ECU_Address@SGSA_SetHighASCFlg_C@ */ Record_UBYTE 0 SigSignalAdapter_CM_uint8 0.000000 200.000000 /end CHARACTERISTIC
/begin CHARACTERISTIC SGSA_SetPwrOffDlyFlgEnable_C "" VALUE 0x0000 /* @ECU_Address@SGSA_SetPwrOffDlyFlgEnable_C@ */ Record_UBYTE 0 SigSignalAdapter_CM_uint8 0.000000 200.000000 /end CHARACTERISTIC
/begin CHARACTERISTIC SGSA_SetPwrOffDlyFlg_C "" VALUE 0x0000 /* @ECU_Address@SGSA_SetPwrOffDlyFlg_C@ */ Record_BOOLEAN 0 SigSignalAdapter_CM_logical 0.000000 1.000000 /end CHARACTERISTIC
/begin CHARACTERISTIC SGSA_TMotSnsr1TableHigh_M "" /* Characteristic Type */ CURVE 0x0000 /* @ECU_Address@SGSA_TMotSnsr1TableHigh_M@ */ Record_FLOAT32_IEEE /* Maxdiff */ 0 SigSignalAdapter_CM_single -3.4E+38 3.4E+38
 /begin AXIS_DESCR /* Description of X-Axis Points */ /* Axis Type */ COM_AXIS /* Reference to Input */ NO_INPUT_QUANTITY SigSignalAdapter_CM_single 301 -3.4E+38 3.4E+38 AXIS_PTS_REF SGSA_UTMotSnsr1SampleHighTemp_A /end AXIS_DESCR
/end CHARACTERISTIC
/begin CHARACTERISTIC SGSA_UTIgbtPha123Table_M "" /* Characteristic Type */ CURVE 0x0000 /* @ECU_Address@SGSA_UTIgbtPha123Table_M@ */ Record_FLOAT32_IEEE /* Maxdiff */ 0 SigSignalAdapter_CM_single -3.4E+38 3.4E+38
 /begin AXIS_DESCR /* Description of X-Axis Points */ /* Axis Type */ COM_AXIS /* Reference to Input */ NO_INPUT_QUANTITY SigSignalAdapter_CM_single 44 -3.4E+38 3.4E+38 AXIS_PTS_REF SGSA_UTIgbtPha123SampleTemp_A /end AXIS_DESCR
/end CHARACTERISTIC
/begin MEASUREMENT HWAL_AdcIAZero "Phase A current ADC raw value" FLOAT32_IEEE SigSignalAdapter_CM_single 0 0 -3.4E+38 3.4E+38 ECU_ADDRESS 0x0000 /* @ECU_Address@HWAL_AdcIAZero@ */ /end MEASUREMENT
/begin MEASUREMENT HWAL_AdcICZero "Phase A current ADC raw value" FLOAT32_IEEE SigSignalAdapter_CM_single 0 0 -3.4E+38 3.4E+38 ECU_ADDRESS 0x0000 /* @ECU_Address@HWAL_AdcICZero@ */ /end MEASUREMENT
/begin MEASUREMENT HWAL_BatteryVoltAdc "Battery supply voltage ADC raw value" FLOAT32_IEEE SigSignalAdapter_CM_single 0 0 0.000000 4095.000000 ECU_ADDRESS 0x0000 /* @ECU_Address@HWAL_BatteryVoltAdc@ */ /end MEASUREMENT
/begin MEASUREMENT HWAL_DcLinkVoltAdc "DC-link voltage ADC raw value" FLOAT32_IEEE SigSignalAdapter_CM_single 0 0 0.000000 4095.000000 ECU_ADDRESS 0x0000 /* @ECU_Address@HWAL_DcLinkVoltAdc@ */ /end MEASUREMENT
/begin MEASUREMENT HWAL_DcLinkVoltAdcBkUp "DC-link voltage ADC raw value" FLOAT32_IEEE SigSignalAdapter_CM_single 0 0 0.000000 4095.000000 ECU_ADDRESS 0x0000 /* @ECU_Address@HWAL_DcLinkVoltAdcBkUp@ */ /end MEASUREMENT
/begin MEASUREMENT HWAL_IgnitionVoltAdc "Ignition supply voltage ADC raw value" FLOAT32_IEEE SigSignalAdapter_CM_single 0 0 0.000000 4095.000000 ECU_ADDRESS 0x0000 /* @ECU_Address@HWAL_IgnitionVoltAdc@ */ /end MEASUREMENT
/begin MEASUREMENT HWAL_MotorTempAdc "Motor temperature ADC raw value" FLOAT32_IEEE SigSignalAdapter_CM_single 0 0 0.000000 4095.000000 ECU_ADDRESS 0x0000 /* @ECU_Address@HWAL_MotorTempAdc@ */ /end MEASUREMENT
/begin MEASUREMENT HWAL_MotorTempAdcBkUp "Motor temperature ADC raw value" FLOAT32_IEEE SigSignalAdapter_CM_single 0 0 0.000000 4095.000000 ECU_ADDRESS 0x0000 /* @ECU_Address@HWAL_MotorTempAdcBkUp@ */ /end MEASUREMENT
/begin MEASUREMENT HWAL_PhaseACurrentAdc "Phase A current ADC raw value" FLOAT32_IEEE SigSignalAdapter_CM_single 0 0 0.000000 4095.000000 ECU_ADDRESS 0x0000 /* @ECU_Address@HWAL_PhaseACurrentAdc@ */ /end MEASUREMENT
/begin MEASUREMENT HWAL_PhaseACurrentAdcBkUp "Phase A current ADC raw value" FLOAT32_IEEE SigSignalAdapter_CM_single 0 0 0.000000 4095.000000 ECU_ADDRESS 0x0000 /* @ECU_Address@HWAL_PhaseACurrentAdcBkUp@ */ /end MEASUREMENT
/begin MEASUREMENT HWAL_PhaseASwitchTempAdc "Phase A power switch temperature ADC raw value" FLOAT32_IEEE SigSignalAdapter_CM_single 0 0 0.000000 4095.000000 ECU_ADDRESS 0x0000 /* @ECU_Address@HWAL_PhaseASwitchTempAdc@ */ /end MEASUREMENT
/begin MEASUREMENT HWAL_PhaseASwitchTempAdcBkUp "Phase A power switch temperature ADC raw value" FLOAT32_IEEE SigSignalAdapter_CM_single 0 0 0.000000 4095.000000 ECU_ADDRESS 0x0000 /* @ECU_Address@HWAL_PhaseASwitchTempAdcBkUp@ */ /end MEASUREMENT
/begin MEASUREMENT HWAL_PhaseBSwitchTempAdc "Phase B power switch temperature ADC raw value" FLOAT32_IEEE SigSignalAdapter_CM_single 0 0 0.000000 4095.000000 ECU_ADDRESS 0x0000 /* @ECU_Address@HWAL_PhaseBSwitchTempAdc@ */ /end MEASUREMENT
/begin MEASUREMENT HWAL_PhaseBSwitchTempAdcBkUp "Phase A power switch temperature ADC raw value" FLOAT32_IEEE SigSignalAdapter_CM_single 0 0 0.000000 4095.000000 ECU_ADDRESS 0x0000 /* @ECU_Address@HWAL_PhaseBSwitchTempAdcBkUp@ */ /end MEASUREMENT
/begin MEASUREMENT HWAL_PhaseCCurrentAdc "Phase C current ADC raw value" FLOAT32_IEEE SigSignalAdapter_CM_single 0 0 0.000000 4095.000000 ECU_ADDRESS 0x0000 /* @ECU_Address@HWAL_PhaseCCurrentAdc@ */ /end MEASUREMENT
/begin MEASUREMENT HWAL_PhaseCCurrentAdcBkUp "Phase A current ADC raw value" FLOAT32_IEEE SigSignalAdapter_CM_single 0 0 0.000000 4095.000000 ECU_ADDRESS 0x0000 /* @ECU_Address@HWAL_PhaseCCurrentAdcBkUp@ */ /end MEASUREMENT
/begin MEASUREMENT HWAL_PhaseCSwitchTempAdc "Phase C power switch temperature ADC raw value" FLOAT32_IEEE SigSignalAdapter_CM_single 0 0 0.000000 4095.000000 ECU_ADDRESS 0x0000 /* @ECU_Address@HWAL_PhaseCSwitchTempAdc@ */ /end MEASUREMENT
/begin MEASUREMENT HWAL_PhaseCSwitchTempAdcBkUp "Phase A power switch temperature ADC raw value" FLOAT32_IEEE SigSignalAdapter_CM_single 0 0 0.000000 4095.000000 ECU_ADDRESS 0x0000 /* @ECU_Address@HWAL_PhaseCSwitchTempAdcBkUp@ */ /end MEASUREMENT
/begin MEASUREMENT HWAL_PowerChipVoltAdc "Battery supply voltage ADC raw value" FLOAT32_IEEE SigSignalAdapter_CM_single 0 0 0.000000 4095.000000 ECU_ADDRESS 0x0000 /* @ECU_Address@HWAL_PowerChipVoltAdc@ */ /end MEASUREMENT
/begin MEASUREMENT SGPP_ClrHWFault "" UBYTE SigSignalAdapter_CM_logical 0 0 0 1 MATRIX_DIM 1 1 ECU_ADDRESS 0x0000 /* @ECU_Address@SGPP_ClrHWFault@ */ /end MEASUREMENT
/begin MEASUREMENT SGPP_PhaseADuty "" FLOAT32_IEEE SigSignalAdapter_CM_single 0 0 -3.4E+38 3.4E+38 ECU_ADDRESS 0x0000 /* @ECU_Address@SGPP_PhaseADuty@ */ /end MEASUREMENT
/begin MEASUREMENT SGPP_PhaseBDuty "" FLOAT32_IEEE SigSignalAdapter_CM_single 0 0 -3.4E+38 3.4E+38 ECU_ADDRESS 0x0000 /* @ECU_Address@SGPP_PhaseBDuty@ */ /end MEASUREMENT
/begin MEASUREMENT SGPP_PhaseCDuty "" FLOAT32_IEEE SigSignalAdapter_CM_single 0 0 -3.4E+38 3.4E+38 ECU_ADDRESS 0x0000 /* @ECU_Address@SGPP_PhaseCDuty@ */ /end MEASUREMENT
/begin MEASUREMENT SGPP_SetDriverSts "" UBYTE SigSignalAdapter_CM_uint8 0 0 0 255 MATRIX_DIM 1 1 ECU_ADDRESS 0x0000 /* @ECU_Address@SGPP_SetDriverSts@ */ /end MEASUREMENT
/begin MEASUREMENT SGPP_SetFreq "" FLOAT32_IEEE SigSignalAdapter_CM_single 0 0 -3.4E+38 3.4E+38 MATRIX_DIM 1 1 ECU_ADDRESS 0x0000 /* @ECU_Address@SGPP_SetFreq@ */ /end MEASUREMENT
/begin MEASUREMENT SGPP_SetHighASCFlg "" UBYTE SigSignalAdapter_CM_uint8 0 0 0 255 ECU_ADDRESS 0x0000 /* @ECU_Address@SGPP_SetHighASCFlg@ */ /end MEASUREMENT
/begin MEASUREMENT SGPP_SetPwrOffDlyFlg "" UBYTE SigSignalAdapter_CM_logical 0 0 0 1 MATRIX_DIM 1 1 ECU_ADDRESS 0x0000 /* @ECU_Address@SGPP_SetPwrOffDlyFlg@ */ /end MEASUREMENT
/begin MEASUREMENT SGRD_ElecAngle "" FLOAT32_IEEE SigSignalAdapter_CM_single 0 0 -3.4E+38 3.4E+38 ECU_ADDRESS 0x0000 /* @ECU_Address@SGRD_ElecAngle@ */ /end MEASUREMENT
/begin MEASUREMENT SGRD_ResolverErr "" UBYTE SigSignalAdapter_CM_uint8_dash_ 0 0 0 255 ECU_ADDRESS 0x0000 /* @ECU_Address@SGRD_ResolverErr@ */ /end MEASUREMENT
/begin MEASUREMENT SGSA_BatteryVolt "Battery supply voltage measurement" FLOAT32_IEEE SigSignalAdapter_CM_single_V 0 0 0.000000 50.000000 MATRIX_DIM 1 1 ECU_ADDRESS 0x0000 /* @ECU_Address@SGSA_BatteryVolt@ */ /end MEASUREMENT
/begin MEASUREMENT SGSA_DcLinkVoltMeas "DC-link voltage measurement" FLOAT32_IEEE SigSignalAdapter_CM_single_V 0 0 0.000000 10000.000000 MATRIX_DIM 1 1 ECU_ADDRESS 0x0000 /* @ECU_Address@SGSA_DcLinkVoltMeas@ */ /end MEASUREMENT
/begin MEASUREMENT SGSA_DcLinkVoltMeasAD "DC-link voltage measurement AD" FLOAT32_IEEE SigSignalAdapter_CM_single_V 0 0 0.000000 10000.000000 MATRIX_DIM 1 1 ECU_ADDRESS 0x0000 /* @ECU_Address@SGSA_DcLinkVoltMeasAD@ */ /end MEASUREMENT
/begin MEASUREMENT SGSA_DriveErr "" UBYTE SigSignalAdapter_CM_uint8 0 0 0.000000 255.000000 MATRIX_DIM 1 1 ECU_ADDRESS 0x0000 /* @ECU_Address@SGSA_DriveErr@ */ /end MEASUREMENT
/begin MEASUREMENT SGSA_ElecAngle "Electrical rotor angle" FLOAT32_IEEE SigSignalAdapter_CM_single_rad 0 0 -65535.000000 65535.000000 ECU_ADDRESS 0x0000 /* @ECU_Address@SGSA_ElecAngle@ */ /end MEASUREMENT
/begin MEASUREMENT SGSA_HDriFault "" UBYTE SigSignalAdapter_CM_uint8 0 0 0.000000 255.000000 MATRIX_DIM 1 1 ECU_ADDRESS 0x0000 /* @ECU_Address@SGSA_HDriFault@ */ /end MEASUREMENT
/begin MEASUREMENT SGSA_HwOvercurSt "" UBYTE SigSignalAdapter_CM_uint8 0 0 0.000000 255.000000 MATRIX_DIM 1 1 ECU_ADDRESS 0x0000 /* @ECU_Address@SGSA_HwOvercurSt@ */ /end MEASUREMENT
/begin MEASUREMENT SGSA_HwOvervoltSt "" UBYTE SigSignalAdapter_CM_uint8 0 0 0.000000 255.000000 MATRIX_DIM 1 1 ECU_ADDRESS 0x0000 /* @ECU_Address@SGSA_HwOvervoltSt@ */ /end MEASUREMENT
/begin MEASUREMENT SGSA_IgnitionVolt "Ignition supply voltage measurement" FLOAT32_IEEE SigSignalAdapter_CM_single_V 0 0 0.000000 50.000000 MATRIX_DIM 1 1 ECU_ADDRESS 0x0000 /* @ECU_Address@SGSA_IgnitionVolt@ */ /end MEASUREMENT
/begin MEASUREMENT SGSA_LDriFault "" UBYTE SigSignalAdapter_CM_uint8 0 0 0.000000 255.000000 MATRIX_DIM 1 1 ECU_ADDRESS 0x0000 /* @ECU_Address@SGSA_LDriFault@ */ /end MEASUREMENT
/begin MEASUREMENT SGSA_MotorTemp1 "Motor temperature sensor 1 reading" FLOAT32_IEEE SigSignalAdapter_CM_single 0 0 -50.000000 250.000000 MATRIX_DIM 1 1 ECU_ADDRESS 0x0000 /* @ECU_Address@SGSA_MotorTemp1@ */ /end MEASUREMENT
/begin MEASUREMENT SGSA_MotorTemp1AD "Motor temperature sensor 1 reading" FLOAT32_IEEE SigSignalAdapter_CM_single 0 0 -50.000000 250.000000 MATRIX_DIM 1 1 ECU_ADDRESS 0x0000 /* @ECU_Address@SGSA_MotorTemp1AD@ */ /end MEASUREMENT
/begin MEASUREMENT SGSA_PWMSts "PWM State" UBYTE SigSignalAdapter_CM_uint8_A 0 0 0.000000 10.000000 ECU_ADDRESS 0x0000 /* @ECU_Address@SGSA_PWMSts@ */ /end MEASUREMENT
/begin MEASUREMENT SGSA_PhaseACurrent "Phase A current measurement" FLOAT32_IEEE SigSignalAdapter_CM_single_A 0 0 -2000.000000 2000.000000 MATRIX_DIM 1 1 ECU_ADDRESS 0x0000 /* @ECU_Address@SGSA_PhaseACurrent@ */ /end MEASUREMENT
/begin MEASUREMENT SGSA_PhaseACurrentAD "Phase C current measurement" FLOAT32_IEEE SigSignalAdapter_CM_single_A 0 0 -2000.000000 2000.000000 MATRIX_DIM 1 1 ECU_ADDRESS 0x0000 /* @ECU_Address@SGSA_PhaseACurrentAD@ */ /end MEASUREMENT
/begin MEASUREMENT SGSA_PhaseASwitchTemp "Phase A power switch temperature measurement" FLOAT32_IEEE SigSignalAdapter_CM_single 0 0 -50.000000 450.000000 MATRIX_DIM 1 1 ECU_ADDRESS 0x0000 /* @ECU_Address@SGSA_PhaseASwitchTemp@ */ /end MEASUREMENT
/begin MEASUREMENT SGSA_PhaseASwitchTempAD "Phase A power switch temperature measurement" FLOAT32_IEEE SigSignalAdapter_CM_single 0 0 -50.000000 450.000000 MATRIX_DIM 1 1 ECU_ADDRESS 0x0000 /* @ECU_Address@SGSA_PhaseASwitchTempAD@ */ /end MEASUREMENT
/begin MEASUREMENT SGSA_PhaseBSwitchTemp "Phase B power switch temperature measurement" FLOAT32_IEEE SigSignalAdapter_CM_single 0 0 -50.000000 450.000000 MATRIX_DIM 1 1 ECU_ADDRESS 0x0000 /* @ECU_Address@SGSA_PhaseBSwitchTemp@ */ /end MEASUREMENT
/begin MEASUREMENT SGSA_PhaseBSwitchTempAD "Phase A power switch temperature measurement" FLOAT32_IEEE SigSignalAdapter_CM_single 0 0 -50.000000 450.000000 MATRIX_DIM 1 1 ECU_ADDRESS 0x0000 /* @ECU_Address@SGSA_PhaseBSwitchTempAD@ */ /end MEASUREMENT
/begin MEASUREMENT SGSA_PhaseCCurrent "Phase C current measurement" FLOAT32_IEEE SigSignalAdapter_CM_single_A 0 0 -2000.000000 2000.000000 MATRIX_DIM 1 1 ECU_ADDRESS 0x0000 /* @ECU_Address@SGSA_PhaseCCurrent@ */ /end MEASUREMENT
/begin MEASUREMENT SGSA_PhaseCCurrentAD "Phase C current measurement" FLOAT32_IEEE SigSignalAdapter_CM_single_A 0 0 -2000.000000 2000.000000 MATRIX_DIM 1 1 ECU_ADDRESS 0x0000 /* @ECU_Address@SGSA_PhaseCCurrentAD@ */ /end MEASUREMENT
/begin MEASUREMENT SGSA_PhaseCSwitchTemp "Phase C power switch temperature measurement" FLOAT32_IEEE SigSignalAdapter_CM_single 0 0 -50.000000 450.000000 MATRIX_DIM 1 1 ECU_ADDRESS 0x0000 /* @ECU_Address@SGSA_PhaseCSwitchTemp@ */ /end MEASUREMENT
/begin MEASUREMENT SGSA_PhaseCSwitchTempAD "Phase A power switch temperature measurement" FLOAT32_IEEE SigSignalAdapter_CM_single 0 0 -50.000000 450.000000 MATRIX_DIM 1 1 ECU_ADDRESS 0x0000 /* @ECU_Address@SGSA_PhaseCSwitchTempAD@ */ /end MEASUREMENT
/begin MEASUREMENT SGSA_PwrChipVolt "" FLOAT32_IEEE SigSignalAdapter_CM_single 0 0 -2000.000000 2000.000000 MATRIX_DIM 1 1 ECU_ADDRESS 0x0000 /* @ECU_Address@SGSA_PwrChipVolt@ */ /end MEASUREMENT
/begin MEASUREMENT SGSA_ResolverError "Resolver fault detection status" UBYTE SigSignalAdapter_CM_uint8_dash_ 0 0 0.000000 255.000000 ECU_ADDRESS 0x0000 /* @ECU_Address@SGSA_ResolverError@ */ /end MEASUREMENT
/begin MEASUREMENT SigSignalAdapter_B.Switch2 "" UBYTE SigSignalAdapter_CM_uint8 0 0 0 255 MATRIX_DIM 1 1 ECU_ADDRESS 0x0000 /* @ECU_Address@SigSignalAdapter_B.Switch2@ */ /end MEASUREMENT
/begin MEASUREMENT SigSignalAdapter_B.output "" UBYTE SigSignalAdapter_CM_uint8 0 0 0 255 ECU_ADDRESS 0x0000 /* @ECU_Address@SigSignalAdapter_B.output@ */ /end MEASUREMENT
/begin AXIS_PTS SGSA_UTIgbtPha123SampleTemp_A "" 0x0000 /* @ECU_Address@SGSA_UTIgbtPha123SampleTemp_A@ */ /* Input Quantity */ NO_INPUT_QUANTITY Axis_FLOAT32_IEEE 0 SigSignalAdapter_CM_single 44 -3.4E+38 3.4E+38 /end AXIS_PTS
/begin AXIS_PTS SGSA_UTMotSnsr1SampleHighTemp_A "" 0x0000 /* @ECU_Address@SGSA_UTMotSnsr1SampleHighTemp_A@ */ /* Input Quantity */ NO_INPUT_QUANTITY Axis_FLOAT32_IEEE 0 SigSignalAdapter_CM_single 301 -3.4E+38 3.4E+38 /end AXIS_PTS
/begin COMPU_METHOD SigSignalAdapter_CM_logical "Q = V" IDENTICAL "%1.0" "" /end COMPU_METHOD
/begin COMPU_METHOD SigSignalAdapter_CM_single "Q = V" IDENTICAL "%8.6" "" /end COMPU_METHOD
/begin COMPU_METHOD SigSignalAdapter_CM_single_A "Q = V" IDENTICAL "%8.6" "A" /end COMPU_METHOD
/begin COMPU_METHOD SigSignalAdapter_CM_single_V "Q = V" IDENTICAL "%8.6" "V" /end COMPU_METHOD
/begin COMPU_METHOD SigSignalAdapter_CM_single_percent_ "Q = V" IDENTICAL "%8.6" "%" /end COMPU_METHOD
/begin COMPU_METHOD SigSignalAdapter_CM_single_rad "Q = V" IDENTICAL "%8.6" "rad" /end COMPU_METHOD
/begin COMPU_METHOD SigSignalAdapter_CM_uint8 "Q = V" IDENTICAL "%3.0" "" /end COMPU_METHOD
/begin COMPU_METHOD SigSignalAdapter_CM_uint8_A "Q = V" IDENTICAL "%3.0" "A" /end COMPU_METHOD
/begin COMPU_METHOD SigSignalAdapter_CM_uint8_dash_ "Q = V" IDENTICAL "%3.0" "-" /end COMPU_METHOD
/begin RECORD_LAYOUT Record_BOOLEAN FNC_VALUES 1 UBYTE COLUMN_DIR DIRECT /end RECORD_LAYOUT
/begin RECORD_LAYOUT Record_FLOAT32_IEEE FNC_VALUES 1 FLOAT32_IEEE COLUMN_DIR DIRECT /end RECORD_LAYOUT
/begin RECORD_LAYOUT Record_UBYTE FNC_VALUES 1 UBYTE COLUMN_DIR DIRECT /end RECORD_LAYOUT
/* Record Layouts for Lookup Tables in Standard Axis format */
/begin RECORD_LAYOUT Axis_FLOAT32_IEEE AXIS_PTS_X 1 FLOAT32_IEEE INDEX_INCR DIRECT /end RECORD_LAYOUT
/begin GROUP SigSignalAdapter "SigSignalAdapter" /* Root */ ROOT
 /begin SUB_GROUP SigSignalAdapter_SGSA_ReadTempVolt_1ms_sys SigSignalAdapter_SGSA_Read_100us_sys SigSignalAdapter_SGSA_WriteCommand_100us_sys /end SUB_GROUP
 /begin REF_MEASUREMENT SGPP_ClrHWFault SGPP_PhaseADuty SGPP_PhaseBDuty SGPP_PhaseCDuty SGPP_SetDriverSts SGPP_SetFreq SGPP_SetHighASCFlg SGPP_SetPwrOffDlyFlg SGRD_ElecAngle SGRD_ResolverErr /end REF_MEASUREMENT
/end GROUP
/begin GROUP SigSignalAdapter_SGSA_ReadTempVolt_1ms_sys "SigSignalAdapter/SGSA_ReadTempVolt_1ms_sys"
 /begin SUB_GROUP SigSignalAdapter_SGSA_ReadTempVolt_1ms_sys_AdcToPhysicalAndGetAD SigSignalAdapter_SGSA_ReadTempVolt_1ms_sys_AdcToPhysicalAndGetAD1 SigSignalAdapter_SGSA_ReadTempVolt_1ms_sys_AdcToPhysicalAndGetAD2 SigSignalAdapter_SGSA_ReadTempVolt_1ms_sys_ConvPowerChipVolt SigSignalAdapter_SGSA_ReadTempVolt_1ms_sys_Subsystem /end SUB_GROUP
/end GROUP
/begin GROUP SigSignalAdapter_SGSA_ReadTempVolt_1ms_sys_AdcToPhysicalAndGetAD "SigSignalAdapter/SGSA_ReadTempVolt_1ms_sys/AdcToPhysicalAndGetAD"
 /begin SUB_GROUP SigSignalAdapter_SGSA_ReadTempVolt_1ms_sys_AdcToPhysicalAndGetAD_1D_LUT SigSignalAdapter_SGSA_ReadTempVolt_1ms_sys_AdcToPhysicalAndGetAD_1D_LUT1 SigSignalAdapter_SGSA_ReadTempVolt_1ms_sys_AdcToPhysicalAndGetAD_1D_LUT2 SigSignalAdapter_SGSA_ReadTempVolt_1ms_sys_AdcToPhysicalAndGetAD_Local_Variable_Storage3 SigSignalAdapter_SGSA_ReadTempVolt_1ms_sys_AdcToPhysicalAndGetAD_Local_Variable_Storage4 SigSignalAdapter_SGSA_ReadTempVolt_1ms_sys_AdcToPhysicalAndGetAD_Local_Variable_Storage5 SigSignalAdapter_SGSA_ReadTempVolt_1ms_sys_AdcToPhysicalAndGetAD_Local_Variable_Storage6 SigSignalAdapter_SGSA_ReadTempVolt_1ms_sys_AdcToPhysicalAndGetAD_Local_Variable_Storage7 SigSignalAdapter_SGSA_ReadTempVolt_1ms_sys_AdcToPhysicalAndGetAD_Local_Variable_Storage8 SigSignalAdapter_SGSA_ReadTempVolt_1ms_sys_AdcToPhysicalAndGetAD_Parameter10 SigSignalAdapter_SGSA_ReadTempVolt_1ms_sys_AdcToPhysicalAndGetAD_Parameter11 SigSignalAdapter_SGSA_ReadTempVolt_1ms_sys_AdcToPhysicalAndGetAD_Parameter12 SigSignalAdapter_SGSA_ReadTempVolt_1ms_sys_AdcToPhysicalAndGetAD_Parameter7 SigSignalAdapter_SGSA_ReadTempVolt_1ms_sys_AdcToPhysicalAndGetAD_Parameter8 SigSignalAdapter_SGSA_ReadTempVolt_1ms_sys_AdcToPhysicalAndGetAD_Parameter9 /end SUB_GROUP
/end GROUP
/begin GROUP SigSignalAdapter_SGSA_ReadTempVolt_1ms_sys_AdcToPhysicalAndGetAD1 "SigSignalAdapter/SGSA_ReadTempVolt_1ms_sys/AdcToPhysicalAndGetAD1"
 /begin SUB_GROUP SigSignalAdapter_SGSA_ReadTempVolt_1ms_sys_AdcToPhysicalAndGetAD1_Local_Variable_Storage1 SigSignalAdapter_SGSA_ReadTempVolt_1ms_sys_AdcToPhysicalAndGetAD1_Parameter2 SigSignalAdapter_SGSA_ReadTempVolt_1ms_sys_AdcToPhysicalAndGetAD1_Parameter3 /end SUB_GROUP
/end GROUP
/begin GROUP SigSignalAdapter_SGSA_ReadTempVolt_1ms_sys_AdcToPhysicalAndGetAD1_Local_Variable_Storage1 "SigSignalAdapter/SGSA_ReadTempVolt_1ms_sys/AdcToPhysicalAndGetAD1/Local Variable Storage1" /begin REF_MEASUREMENT HWAL_BatteryVoltAdc /end REF_MEASUREMENT /end GROUP
/begin GROUP SigSignalAdapter_SGSA_ReadTempVolt_1ms_sys_AdcToPhysicalAndGetAD1_Parameter2 "SigSignalAdapter/SGSA_ReadTempVolt_1ms_sys/AdcToPhysicalAndGetAD1/Parameter2" /begin REF_CHARACTERISTIC SGSA_BatteryVoltGain_C /end REF_CHARACTERISTIC /end GROUP
/begin GROUP SigSignalAdapter_SGSA_ReadTempVolt_1ms_sys_AdcToPhysicalAndGetAD1_Parameter3 "SigSignalAdapter/SGSA_ReadTempVolt_1ms_sys/AdcToPhysicalAndGetAD1/Parameter3" /begin REF_CHARACTERISTIC SGSA_BatteryVoltOffset_C /end REF_CHARACTERISTIC /end GROUP
/begin GROUP SigSignalAdapter_SGSA_ReadTempVolt_1ms_sys_AdcToPhysicalAndGetAD2 "SigSignalAdapter/SGSA_ReadTempVolt_1ms_sys/AdcToPhysicalAndGetAD2"
 /begin SUB_GROUP SigSignalAdapter_SGSA_ReadTempVolt_1ms_sys_AdcToPhysicalAndGetAD2_Local_Variable_Storage2 SigSignalAdapter_SGSA_ReadTempVolt_1ms_sys_AdcToPhysicalAndGetAD2_Parameter5 SigSignalAdapter_SGSA_ReadTempVolt_1ms_sys_AdcToPhysicalAndGetAD2_Parameter6 /end SUB_GROUP
/end GROUP
/begin GROUP SigSignalAdapter_SGSA_ReadTempVolt_1ms_sys_AdcToPhysicalAndGetAD2_Local_Variable_Storage2 "SigSignalAdapter/SGSA_ReadTempVolt_1ms_sys/AdcToPhysicalAndGetAD2/Local Variable Storage2" /begin REF_MEASUREMENT HWAL_IgnitionVoltAdc /end REF_MEASUREMENT /end GROUP
/begin GROUP SigSignalAdapter_SGSA_ReadTempVolt_1ms_sys_AdcToPhysicalAndGetAD2_Parameter5 "SigSignalAdapter/SGSA_ReadTempVolt_1ms_sys/AdcToPhysicalAndGetAD2/Parameter5" /begin REF_CHARACTERISTIC SGSA_KL15VoltGain_C /end REF_CHARACTERISTIC /end GROUP
/begin GROUP SigSignalAdapter_SGSA_ReadTempVolt_1ms_sys_AdcToPhysicalAndGetAD2_Parameter6 "SigSignalAdapter/SGSA_ReadTempVolt_1ms_sys/AdcToPhysicalAndGetAD2/Parameter6" /begin REF_CHARACTERISTIC SGSA_Kl15VoltOffset_C /end REF_CHARACTERISTIC /end GROUP
/begin GROUP SigSignalAdapter_SGSA_ReadTempVolt_1ms_sys_AdcToPhysicalAndGetAD_1D_LUT "SigSignalAdapter/SGSA_ReadTempVolt_1ms_sys/AdcToPhysicalAndGetAD/1D LUT" /begin REF_CHARACTERISTIC SGSA_UTIgbtPha123SampleTemp_A SGSA_UTIgbtPha123Table_M /end REF_CHARACTERISTIC /end GROUP
/begin GROUP SigSignalAdapter_SGSA_ReadTempVolt_1ms_sys_AdcToPhysicalAndGetAD_1D_LUT1 "SigSignalAdapter/SGSA_ReadTempVolt_1ms_sys/AdcToPhysicalAndGetAD/1D LUT1" /begin REF_CHARACTERISTIC SGSA_UTIgbtPha123SampleTemp_A SGSA_UTIgbtPha123Table_M /end REF_CHARACTERISTIC /end GROUP
/begin GROUP SigSignalAdapter_SGSA_ReadTempVolt_1ms_sys_AdcToPhysicalAndGetAD_1D_LUT2 "SigSignalAdapter/SGSA_ReadTempVolt_1ms_sys/AdcToPhysicalAndGetAD/1D LUT2" /begin REF_CHARACTERISTIC SGSA_UTIgbtPha123SampleTemp_A SGSA_UTIgbtPha123Table_M /end REF_CHARACTERISTIC /end GROUP
/begin GROUP SigSignalAdapter_SGSA_ReadTempVolt_1ms_sys_AdcToPhysicalAndGetAD_Local_Variable_Storage3 "SigSignalAdapter/SGSA_ReadTempVolt_1ms_sys/AdcToPhysicalAndGetAD/Local Variable Storage3" /begin REF_MEASUREMENT HWAL_PhaseASwitchTempAdc /end REF_MEASUREMENT /end GROUP
/begin GROUP SigSignalAdapter_SGSA_ReadTempVolt_1ms_sys_AdcToPhysicalAndGetAD_Local_Variable_Storage4 "SigSignalAdapter/SGSA_ReadTempVolt_1ms_sys/AdcToPhysicalAndGetAD/Local Variable Storage4" /begin REF_MEASUREMENT HWAL_PhaseBSwitchTempAdc /end REF_MEASUREMENT /end GROUP
/begin GROUP SigSignalAdapter_SGSA_ReadTempVolt_1ms_sys_AdcToPhysicalAndGetAD_Local_Variable_Storage5 "SigSignalAdapter/SGSA_ReadTempVolt_1ms_sys/AdcToPhysicalAndGetAD/Local Variable Storage5" /begin REF_MEASUREMENT HWAL_PhaseCSwitchTempAdc /end REF_MEASUREMENT /end GROUP
/begin GROUP SigSignalAdapter_SGSA_ReadTempVolt_1ms_sys_AdcToPhysicalAndGetAD_Local_Variable_Storage6 "SigSignalAdapter/SGSA_ReadTempVolt_1ms_sys/AdcToPhysicalAndGetAD/Local Variable Storage6" /begin REF_MEASUREMENT HWAL_PhaseASwitchTempAdcBkUp /end REF_MEASUREMENT /end GROUP
/begin GROUP SigSignalAdapter_SGSA_ReadTempVolt_1ms_sys_AdcToPhysicalAndGetAD_Local_Variable_Storage7 "SigSignalAdapter/SGSA_ReadTempVolt_1ms_sys/AdcToPhysicalAndGetAD/Local Variable Storage7" /begin REF_MEASUREMENT HWAL_PhaseBSwitchTempAdcBkUp /end REF_MEASUREMENT /end GROUP
/begin GROUP SigSignalAdapter_SGSA_ReadTempVolt_1ms_sys_AdcToPhysicalAndGetAD_Local_Variable_Storage8 "SigSignalAdapter/SGSA_ReadTempVolt_1ms_sys/AdcToPhysicalAndGetAD/Local Variable Storage8" /begin REF_MEASUREMENT HWAL_PhaseCSwitchTempAdcBkUp /end REF_MEASUREMENT /end GROUP
/begin GROUP SigSignalAdapter_SGSA_ReadTempVolt_1ms_sys_AdcToPhysicalAndGetAD_Parameter10 "SigSignalAdapter/SGSA_ReadTempVolt_1ms_sys/AdcToPhysicalAndGetAD/Parameter10" /begin REF_CHARACTERISTIC SGSA_IgnitionAVoltOffset_C /end REF_CHARACTERISTIC /end GROUP
/begin GROUP SigSignalAdapter_SGSA_ReadTempVolt_1ms_sys_AdcToPhysicalAndGetAD_Parameter11 "SigSignalAdapter/SGSA_ReadTempVolt_1ms_sys/AdcToPhysicalAndGetAD/Parameter11" /begin REF_CHARACTERISTIC SGSA_IgnitionCVoltGain_C /end REF_CHARACTERISTIC /end GROUP
/begin GROUP SigSignalAdapter_SGSA_ReadTempVolt_1ms_sys_AdcToPhysicalAndGetAD_Parameter12 "SigSignalAdapter/SGSA_ReadTempVolt_1ms_sys/AdcToPhysicalAndGetAD/Parameter12" /begin REF_CHARACTERISTIC SGSA_IgnitionCVoltOffset_C /end REF_CHARACTERISTIC /end GROUP
/begin GROUP SigSignalAdapter_SGSA_ReadTempVolt_1ms_sys_AdcToPhysicalAndGetAD_Parameter7 "SigSignalAdapter/SGSA_ReadTempVolt_1ms_sys/AdcToPhysicalAndGetAD/Parameter7" /begin REF_CHARACTERISTIC SGSA_IgnitionAVoltGain_C /end REF_CHARACTERISTIC /end GROUP
/begin GROUP SigSignalAdapter_SGSA_ReadTempVolt_1ms_sys_AdcToPhysicalAndGetAD_Parameter8 "SigSignalAdapter/SGSA_ReadTempVolt_1ms_sys/AdcToPhysicalAndGetAD/Parameter8" /begin REF_CHARACTERISTIC SGSA_IgnitionBVoltGain_C /end REF_CHARACTERISTIC /end GROUP
/begin GROUP SigSignalAdapter_SGSA_ReadTempVolt_1ms_sys_AdcToPhysicalAndGetAD_Parameter9 "SigSignalAdapter/SGSA_ReadTempVolt_1ms_sys/AdcToPhysicalAndGetAD/Parameter9" /begin REF_CHARACTERISTIC SGSA_IgnitionBVoltOffset_C /end REF_CHARACTERISTIC /end GROUP
/begin GROUP SigSignalAdapter_SGSA_ReadTempVolt_1ms_sys_ConvPowerChipVolt "SigSignalAdapter/SGSA_ReadTempVolt_1ms_sys/ConvPowerChipVolt"
 /begin SUB_GROUP SigSignalAdapter_SGSA_ReadTempVolt_1ms_sys_ConvPowerChipVolt_Local_Variable_Storage1 SigSignalAdapter_SGSA_ReadTempVolt_1ms_sys_ConvPowerChipVolt_Parameter2 SigSignalAdapter_SGSA_ReadTempVolt_1ms_sys_ConvPowerChipVolt_Parameter3 /end SUB_GROUP
/end GROUP
/begin GROUP SigSignalAdapter_SGSA_ReadTempVolt_1ms_sys_ConvPowerChipVolt_Local_Variable_Storage1 "SigSignalAdapter/SGSA_ReadTempVolt_1ms_sys/ConvPowerChipVolt/Local Variable Storage1" /begin REF_MEASUREMENT HWAL_PowerChipVoltAdc /end REF_MEASUREMENT /end GROUP
/begin GROUP SigSignalAdapter_SGSA_ReadTempVolt_1ms_sys_ConvPowerChipVolt_Parameter2 "SigSignalAdapter/SGSA_ReadTempVolt_1ms_sys/ConvPowerChipVolt/Parameter2" /begin REF_CHARACTERISTIC SGSA_PowerChipVoltGain_C /end REF_CHARACTERISTIC /end GROUP
/begin GROUP SigSignalAdapter_SGSA_ReadTempVolt_1ms_sys_ConvPowerChipVolt_Parameter3 "SigSignalAdapter/SGSA_ReadTempVolt_1ms_sys/ConvPowerChipVolt/Parameter3" /begin REF_CHARACTERISTIC SGSA_PowerChipVoltOffset_C /end REF_CHARACTERISTIC /end GROUP
/begin GROUP SigSignalAdapter_SGSA_ReadTempVolt_1ms_sys_Subsystem "SigSignalAdapter/SGSA_ReadTempVolt_1ms_sys/Subsystem"
 /begin SUB_GROUP SigSignalAdapter_SGSA_ReadTempVolt_1ms_sys_Subsystem_1D_LUT SigSignalAdapter_SGSA_ReadTempVolt_1ms_sys_Subsystem_Local_Variable_Storage1 SigSignalAdapter_SGSA_ReadTempVolt_1ms_sys_Subsystem_Local_Variable_Storage3 SigSignalAdapter_SGSA_ReadTempVolt_1ms_sys_Subsystem_Parameter10 SigSignalAdapter_SGSA_ReadTempVolt_1ms_sys_Subsystem_Parameter7 /end SUB_GROUP
/end GROUP
/begin GROUP SigSignalAdapter_SGSA_ReadTempVolt_1ms_sys_Subsystem_1D_LUT "SigSignalAdapter/SGSA_ReadTempVolt_1ms_sys/Subsystem/1D LUT" /begin REF_CHARACTERISTIC SGSA_TMotSnsr1TableHigh_M SGSA_UTMotSnsr1SampleHighTemp_A /end REF_CHARACTERISTIC /end GROUP
/begin GROUP SigSignalAdapter_SGSA_ReadTempVolt_1ms_sys_Subsystem_Local_Variable_Storage1 "SigSignalAdapter/SGSA_ReadTempVolt_1ms_sys/Subsystem/Local Variable Storage1" /begin REF_MEASUREMENT HWAL_MotorTempAdcBkUp /end REF_MEASUREMENT /end GROUP
/begin GROUP SigSignalAdapter_SGSA_ReadTempVolt_1ms_sys_Subsystem_Local_Variable_Storage3 "SigSignalAdapter/SGSA_ReadTempVolt_1ms_sys/Subsystem/Local Variable Storage3" /begin REF_MEASUREMENT HWAL_MotorTempAdc /end REF_MEASUREMENT /end GROUP
/begin GROUP SigSignalAdapter_SGSA_ReadTempVolt_1ms_sys_Subsystem_Parameter10 "SigSignalAdapter/SGSA_ReadTempVolt_1ms_sys/Subsystem/Parameter10" /begin REF_CHARACTERISTIC SGSA_MotorTempOffset_C /end REF_CHARACTERISTIC /end GROUP
/begin GROUP SigSignalAdapter_SGSA_ReadTempVolt_1ms_sys_Subsystem_Parameter7 "SigSignalAdapter/SGSA_ReadTempVolt_1ms_sys/Subsystem/Parameter7" /begin REF_CHARACTERISTIC SGSA_MotorTempGain_C /end REF_CHARACTERISTIC /end GROUP
/begin GROUP SigSignalAdapter_SGSA_Read_100us_sys "SigSignalAdapter/SGSA_Read_100us_sys"
 /begin SUB_GROUP SigSignalAdapter_SGSA_Read_100us_sys_AdcToPhysicalAndGetAD SigSignalAdapter_SGSA_Read_100us_sys_PhaseCurrentAdcToPhysicalAndGetAD SigSignalAdapter_SGSA_Read_100us_sys_PwmStateGet SigSignalAdapter_SGSA_Read_100us_sys_ResolverAngleZeroAdjust /end SUB_GROUP
/end GROUP
/begin GROUP SigSignalAdapter_SGSA_Read_100us_sys_AdcToPhysicalAndGetAD "SigSignalAdapter/SGSA_Read_100us_sys/AdcToPhysicalAndGetAD"
 /begin SUB_GROUP SigSignalAdapter_SGSA_Read_100us_sys_AdcToPhysicalAndGetAD_Local_Variable_Storage SigSignalAdapter_SGSA_Read_100us_sys_AdcToPhysicalAndGetAD_Local_Variable_Storage9 SigSignalAdapter_SGSA_Read_100us_sys_AdcToPhysicalAndGetAD_Parameter1 SigSignalAdapter_SGSA_Read_100us_sys_AdcToPhysicalAndGetAD_Parameter4 /end SUB_GROUP
/end GROUP
/begin GROUP SigSignalAdapter_SGSA_Read_100us_sys_AdcToPhysicalAndGetAD_Local_Variable_Storage "SigSignalAdapter/SGSA_Read_100us_sys/AdcToPhysicalAndGetAD/Local Variable Storage" /begin REF_MEASUREMENT HWAL_DcLinkVoltAdc /end REF_MEASUREMENT /end GROUP
/begin GROUP SigSignalAdapter_SGSA_Read_100us_sys_AdcToPhysicalAndGetAD_Local_Variable_Storage9 "SigSignalAdapter/SGSA_Read_100us_sys/AdcToPhysicalAndGetAD/Local Variable Storage9" /begin REF_MEASUREMENT HWAL_DcLinkVoltAdcBkUp /end REF_MEASUREMENT /end GROUP
/begin GROUP SigSignalAdapter_SGSA_Read_100us_sys_AdcToPhysicalAndGetAD_Parameter1 "SigSignalAdapter/SGSA_Read_100us_sys/AdcToPhysicalAndGetAD/Parameter1" /begin REF_CHARACTERISTIC SGSA_DcLinkVoltGain_C /end REF_CHARACTERISTIC /end GROUP
/begin GROUP SigSignalAdapter_SGSA_Read_100us_sys_AdcToPhysicalAndGetAD_Parameter4 "SigSignalAdapter/SGSA_Read_100us_sys/AdcToPhysicalAndGetAD/Parameter4" /begin REF_CHARACTERISTIC SGSA_DcLinkVoltOffset_C /end REF_CHARACTERISTIC /end GROUP
/begin GROUP SigSignalAdapter_SGSA_Read_100us_sys_PhaseCurrentAdcToPhysicalAndGetAD "SigSignalAdapter/SGSA_Read_100us_sys/PhaseCurrentAdcToPhysicalAndGetAD"
 /begin SUB_GROUP SigSignalAdapter_SGSA_Read_100us_sys_PhaseCurrentAdcToPhysicalAndGetAD_Local_Variable_Storage SigSignalAdapter_SGSA_Read_100us_sys_PhaseCurrentAdcToPhysicalAndGetAD_Local_Variable_Storage1 SigSignalAdapter_SGSA_Read_100us_sys_PhaseCurrentAdcToPhysicalAndGetAD_Local_Variable_Storage2 SigSignalAdapter_SGSA_Read_100us_sys_PhaseCurrentAdcToPhysicalAndGetAD_Local_Variable_Storage3 SigSignalAdapter_SGSA_Read_100us_sys_PhaseCurrentAdcToPhysicalAndGetAD_Local_Variable_Storage4 SigSignalAdapter_SGSA_Read_100us_sys_PhaseCurrentAdcToPhysicalAndGetAD_Local_Variable_Storage5 SigSignalAdapter_SGSA_Read_100us_sys_PhaseCurrentAdcToPhysicalAndGetAD_Parameter1 SigSignalAdapter_SGSA_Read_100us_sys_PhaseCurrentAdcToPhysicalAndGetAD_Parameter5 /end SUB_GROUP
/end GROUP
/begin GROUP SigSignalAdapter_SGSA_Read_100us_sys_PhaseCurrentAdcToPhysicalAndGetAD_Local_Variable_Storage "SigSignalAdapter/SGSA_Read_100us_sys/PhaseCurrentAdcToPhysicalAndGetAD/Local Variable Storage" /begin REF_MEASUREMENT HWAL_PhaseACurrentAdc /end REF_MEASUREMENT /end GROUP
/begin GROUP SigSignalAdapter_SGSA_Read_100us_sys_PhaseCurrentAdcToPhysicalAndGetAD_Local_Variable_Storage1 "SigSignalAdapter/SGSA_Read_100us_sys/PhaseCurrentAdcToPhysicalAndGetAD/Local Variable Storage1" /begin REF_MEASUREMENT HWAL_AdcIAZero /end REF_MEASUREMENT /end GROUP
/begin GROUP SigSignalAdapter_SGSA_Read_100us_sys_PhaseCurrentAdcToPhysicalAndGetAD_Local_Variable_Storage2 "SigSignalAdapter/SGSA_Read_100us_sys/PhaseCurrentAdcToPhysicalAndGetAD/Local Variable Storage2" /begin REF_MEASUREMENT HWAL_PhaseCCurrentAdc /end REF_MEASUREMENT /end GROUP
/begin GROUP SigSignalAdapter_SGSA_Read_100us_sys_PhaseCurrentAdcToPhysicalAndGetAD_Local_Variable_Storage3 "SigSignalAdapter/SGSA_Read_100us_sys/PhaseCurrentAdcToPhysicalAndGetAD/Local Variable Storage3" /begin REF_MEASUREMENT HWAL_PhaseACurrentAdcBkUp /end REF_MEASUREMENT /end GROUP
/begin GROUP SigSignalAdapter_SGSA_Read_100us_sys_PhaseCurrentAdcToPhysicalAndGetAD_Local_Variable_Storage4 "SigSignalAdapter/SGSA_Read_100us_sys/PhaseCurrentAdcToPhysicalAndGetAD/Local Variable Storage4" /begin REF_MEASUREMENT HWAL_AdcICZero /end REF_MEASUREMENT /end GROUP
/begin GROUP SigSignalAdapter_SGSA_Read_100us_sys_PhaseCurrentAdcToPhysicalAndGetAD_Local_Variable_Storage5 "SigSignalAdapter/SGSA_Read_100us_sys/PhaseCurrentAdcToPhysicalAndGetAD/Local Variable Storage5" /begin REF_MEASUREMENT HWAL_PhaseCCurrentAdcBkUp /end REF_MEASUREMENT /end GROUP
/begin GROUP SigSignalAdapter_SGSA_Read_100us_sys_PhaseCurrentAdcToPhysicalAndGetAD_Parameter1 "SigSignalAdapter/SGSA_Read_100us_sys/PhaseCurrentAdcToPhysicalAndGetAD/Parameter1" /begin REF_CHARACTERISTIC SGSA_PhaseACurrentGain_C /end REF_CHARACTERISTIC /end GROUP
/begin GROUP SigSignalAdapter_SGSA_Read_100us_sys_PhaseCurrentAdcToPhysicalAndGetAD_Parameter5 "SigSignalAdapter/SGSA_Read_100us_sys/PhaseCurrentAdcToPhysicalAndGetAD/Parameter5" /begin REF_CHARACTERISTIC SGSA_PhaseCCurrentGain_C /end REF_CHARACTERISTIC /end GROUP
/begin GROUP SigSignalAdapter_SGSA_Read_100us_sys_PwmStateGet "SigSignalAdapter/SGSA_Read_100us_sys/PwmStateGet" /begin REF_MEASUREMENT SigSignalAdapter_B.Switch2 SigSignalAdapter_B.output /end REF_MEASUREMENT /end GROUP
/begin GROUP SigSignalAdapter_SGSA_Read_100us_sys_ResolverAngleZeroAdjust "SigSignalAdapter/SGSA_Read_100us_sys/ResolverAngleZeroAdjust"
 /begin SUB_GROUP SigSignalAdapter_SGSA_Read_100us_sys_ResolverAngleZeroAdjust_Parameter4 /end SUB_GROUP
 /begin REF_MEASUREMENT SGRD_ElecAngle /end REF_MEASUREMENT
/end GROUP
/begin GROUP SigSignalAdapter_SGSA_Read_100us_sys_ResolverAngleZeroAdjust_Parameter4 "SigSignalAdapter/SGSA_Read_100us_sys/ResolverAngleZeroAdjust/Parameter4" /begin REF_CHARACTERISTIC SGSA_MotorInitAngleOffset_C /end REF_CHARACTERISTIC /end GROUP
/begin GROUP SigSignalAdapter_SGSA_WriteCommand_100us_sys "SigSignalAdapter/SGSA_WriteCommand_100us_sys"
 /begin SUB_GROUP SigSignalAdapter_SGSA_WriteCommand_100us_sys_Clear_HW_Fault SigSignalAdapter_SGSA_WriteCommand_100us_sys_Set_Driver_State SigSignalAdapter_SGSA_WriteCommand_100us_sys_Set_High_ASC_Flag SigSignalAdapter_SGSA_WriteCommand_100us_sys_Set_PWM_Frequency SigSignalAdapter_SGSA_WriteCommand_100us_sys_Set_PWM_Run SigSignalAdapter_SGSA_WriteCommand_100us_sys_Set_Power_Off_Delay_Flag /end SUB_GROUP
 /begin REF_MEASUREMENT SGPP_SetDriverSts /end REF_MEASUREMENT
/end GROUP
/begin GROUP SigSignalAdapter_SGSA_WriteCommand_100us_sys_Clear_HW_Fault "SigSignalAdapter/SGSA_WriteCommand_100us_sys/Clear HW Fault"
 /begin SUB_GROUP SigSignalAdapter_SGSA_WriteCommand_100us_sys_Clear_HW_Fault_Parameter2 SigSignalAdapter_SGSA_WriteCommand_100us_sys_Clear_HW_Fault_Parameter3 /end SUB_GROUP
 /begin REF_MEASUREMENT SGPP_ClrHWFault /end REF_MEASUREMENT
/end GROUP
/begin GROUP SigSignalAdapter_SGSA_WriteCommand_100us_sys_Clear_HW_Fault_Parameter2 "SigSignalAdapter/SGSA_WriteCommand_100us_sys/Clear HW Fault/Parameter2" /begin REF_CHARACTERISTIC SGSA_ClrHWFault_C /end REF_CHARACTERISTIC /end GROUP
/begin GROUP SigSignalAdapter_SGSA_WriteCommand_100us_sys_Clear_HW_Fault_Parameter3 "SigSignalAdapter/SGSA_WriteCommand_100us_sys/Clear HW Fault/Parameter3" /begin REF_CHARACTERISTIC SGSA_ClrHWFaultEnable_C /end REF_CHARACTERISTIC /end GROUP
/begin GROUP SigSignalAdapter_SGSA_WriteCommand_100us_sys_Set_Driver_State "SigSignalAdapter/SGSA_WriteCommand_100us_sys/Set Driver State"
 /begin SUB_GROUP SigSignalAdapter_SGSA_WriteCommand_100us_sys_Set_Driver_State_Parameter2 SigSignalAdapter_SGSA_WriteCommand_100us_sys_Set_Driver_State_Parameter3 /end SUB_GROUP
 /begin REF_MEASUREMENT SigSignalAdapter_B.Switch2 /end REF_MEASUREMENT
/end GROUP
/begin GROUP SigSignalAdapter_SGSA_WriteCommand_100us_sys_Set_Driver_State_Parameter2 "SigSignalAdapter/SGSA_WriteCommand_100us_sys/Set Driver State/Parameter2" /begin REF_CHARACTERISTIC SGSA_SetDriverSts_C /end REF_CHARACTERISTIC /end GROUP
/begin GROUP SigSignalAdapter_SGSA_WriteCommand_100us_sys_Set_Driver_State_Parameter3 "SigSignalAdapter/SGSA_WriteCommand_100us_sys/Set Driver State/Parameter3" /begin REF_CHARACTERISTIC SGSA_SetDriverStsEnable_C /end REF_CHARACTERISTIC /end GROUP
/begin GROUP SigSignalAdapter_SGSA_WriteCommand_100us_sys_Set_High_ASC_Flag "SigSignalAdapter/SGSA_WriteCommand_100us_sys/Set High ASC Flag"
 /begin SUB_GROUP SigSignalAdapter_SGSA_WriteCommand_100us_sys_Set_High_ASC_Flag_Parameter2 SigSignalAdapter_SGSA_WriteCommand_100us_sys_Set_High_ASC_Flag_Parameter3 SigSignalAdapter_SGSA_WriteCommand_100us_sys_Set_High_ASC_Flag_Subsystem /end SUB_GROUP
 /begin REF_MEASUREMENT SGPP_SetHighASCFlg SigSignalAdapter_B.output /end REF_MEASUREMENT
/end GROUP
/begin GROUP SigSignalAdapter_SGSA_WriteCommand_100us_sys_Set_High_ASC_Flag_Parameter2 "SigSignalAdapter/SGSA_WriteCommand_100us_sys/Set High ASC Flag/Parameter2" /begin REF_CHARACTERISTIC SGSA_SetHighASCFlg_C /end REF_CHARACTERISTIC /end GROUP
/begin GROUP SigSignalAdapter_SGSA_WriteCommand_100us_sys_Set_High_ASC_Flag_Parameter3 "SigSignalAdapter/SGSA_WriteCommand_100us_sys/Set High ASC Flag/Parameter3" /begin REF_CHARACTERISTIC SGSA_SetHighASCFlgEnable_C /end REF_CHARACTERISTIC /end GROUP
/begin GROUP SigSignalAdapter_SGSA_WriteCommand_100us_sys_Set_High_ASC_Flag_Subsystem "SigSignalAdapter/SGSA_WriteCommand_100us_sys/Set High ASC Flag/Subsystem" /begin REF_MEASUREMENT SigSignalAdapter_B.output /end REF_MEASUREMENT /end GROUP
/begin GROUP SigSignalAdapter_SGSA_WriteCommand_100us_sys_Set_PWM_Frequency "SigSignalAdapter/SGSA_WriteCommand_100us_sys/Set PWM Frequency"
 /begin SUB_GROUP SigSignalAdapter_SGSA_WriteCommand_100us_sys_Set_PWM_Frequency_Parameter2 SigSignalAdapter_SGSA_WriteCommand_100us_sys_Set_PWM_Frequency_Parameter3 /end SUB_GROUP
 /begin REF_MEASUREMENT SGPP_SetFreq /end REF_MEASUREMENT
/end GROUP
/begin GROUP SigSignalAdapter_SGSA_WriteCommand_100us_sys_Set_PWM_Frequency_Parameter2 "SigSignalAdapter/SGSA_WriteCommand_100us_sys/Set PWM Frequency/Parameter2" /begin REF_CHARACTERISTIC SGSA_SetFreq_C /end REF_CHARACTERISTIC /end GROUP
/begin GROUP SigSignalAdapter_SGSA_WriteCommand_100us_sys_Set_PWM_Frequency_Parameter3 "SigSignalAdapter/SGSA_WriteCommand_100us_sys/Set PWM Frequency/Parameter3" /begin REF_CHARACTERISTIC SGSA_SetFreqEnable_C /end REF_CHARACTERISTIC /end GROUP
/begin GROUP SigSignalAdapter_SGSA_WriteCommand_100us_sys_Set_PWM_Run "SigSignalAdapter/SGSA_WriteCommand_100us_sys/Set PWM Run"
 /begin SUB_GROUP SigSignalAdapter_SGSA_WriteCommand_100us_sys_Set_PWM_Run_Parameter1 SigSignalAdapter_SGSA_WriteCommand_100us_sys_Set_PWM_Run_Parameter2 SigSignalAdapter_SGSA_WriteCommand_100us_sys_Set_PWM_Run_Parameter3 SigSignalAdapter_SGSA_WriteCommand_100us_sys_Set_PWM_Run_Parameter4 /end SUB_GROUP
 /begin REF_MEASUREMENT SGPP_PhaseADuty SGPP_PhaseBDuty SGPP_PhaseCDuty /end REF_MEASUREMENT
/end GROUP
/begin GROUP SigSignalAdapter_SGSA_WriteCommand_100us_sys_Set_PWM_Run_Parameter1 "SigSignalAdapter/SGSA_WriteCommand_100us_sys/Set PWM Run/Parameter1" /begin REF_CHARACTERISTIC SGSA_PhaseBPwmDuty_C /end REF_CHARACTERISTIC /end GROUP
/begin GROUP SigSignalAdapter_SGSA_WriteCommand_100us_sys_Set_PWM_Run_Parameter2 "SigSignalAdapter/SGSA_WriteCommand_100us_sys/Set PWM Run/Parameter2" /begin REF_CHARACTERISTIC SGSA_PhaseCPwmDuty_C /end REF_CHARACTERISTIC /end GROUP
/begin GROUP SigSignalAdapter_SGSA_WriteCommand_100us_sys_Set_PWM_Run_Parameter3 "SigSignalAdapter/SGSA_WriteCommand_100us_sys/Set PWM Run/Parameter3" /begin REF_CHARACTERISTIC SGSA_PwmParamEnable_C /end REF_CHARACTERISTIC /end GROUP
/begin GROUP SigSignalAdapter_SGSA_WriteCommand_100us_sys_Set_PWM_Run_Parameter4 "SigSignalAdapter/SGSA_WriteCommand_100us_sys/Set PWM Run/Parameter4" /begin REF_CHARACTERISTIC SGSA_PhaseAPwmDuty_C /end REF_CHARACTERISTIC /end GROUP
/begin GROUP SigSignalAdapter_SGSA_WriteCommand_100us_sys_Set_Power_Off_Delay_Flag "SigSignalAdapter/SGSA_WriteCommand_100us_sys/Set Power Off Delay Flag"
 /begin SUB_GROUP SigSignalAdapter_SGSA_WriteCommand_100us_sys_Set_Power_Off_Delay_Flag_Parameter2 SigSignalAdapter_SGSA_WriteCommand_100us_sys_Set_Power_Off_Delay_Flag_Parameter3 /end SUB_GROUP
 /begin REF_MEASUREMENT SGPP_SetPwrOffDlyFlg /end REF_MEASUREMENT
/end GROUP
/begin GROUP SigSignalAdapter_SGSA_WriteCommand_100us_sys_Set_Power_Off_Delay_Flag_Parameter2 "SigSignalAdapter/SGSA_WriteCommand_100us_sys/Set Power Off Delay Flag/Parameter2" /begin REF_CHARACTERISTIC SGSA_SetPwrOffDlyFlg_C /end REF_CHARACTERISTIC /end GROUP
/begin GROUP SigSignalAdapter_SGSA_WriteCommand_100us_sys_Set_Power_Off_Delay_Flag_Parameter3 "SigSignalAdapter/SGSA_WriteCommand_100us_sys/Set Power Off Delay Flag/Parameter3" /begin REF_CHARACTERISTIC SGSA_SetPwrOffDlyFlgEnable_C /end REF_CHARACTERISTIC /end GROUP
/end MODULE
/end PROJECT
/* (add any file trailer comments here) */
/* EOF SigSignalAdapter.a2l*/
